VERSION "v0.0.1"

NS_ :

BS_:

BU_:

BO_ 2024 RX: 64 ECU
 SG_ RXLEN : 0|8@1+ (1,0) [0|0] "" TOOL
 SG_ SERVICE M : 8|4@1+ (1,0) [0|0] "" TOOL
 SG_ RXACK : 12|4@1+ (1,0) [0|0] "" TOOL
 SG_ S01_PID m1M : 16|8@1+ (1,0) [0|0] "" TOOL
 SG_ S02_PID m2M : 16|8@1+ (1,0) [0|0] "" TOOL
 SG_ S03_PID m3M : 16|8@1+ (1,0) [0|0] "" TOOL
 SG_ S04_PID m4M : 16|8@1+ (1,0) [0|0] "" TOOL
 SG_ S05_PID m5M : 16|8@1+ (1,0) [0|0] "" TOOL
 SG_ S06_PID m6M : 16|8@1+ (1,0) [0|0] "" TOOL
 SG_ S07_PID m7M : 16|8@1+ (1,0) [0|0] "" TOOL
 SG_ S08_PID m8M : 16|8@1+ (1,0) [0|0] "" TOOL
 SG_ S09_PID m9M : 16|8@1+ (1,0) [0|0] "" TOOL
 SG_ S0A_PID m10M : 16|8@1+ (1,0) [0|0] "" TOOL
 SG_ S01_PID00_SupportedIDs_01_20 m0 : 24|32@1+ (1,0) [0|0] "" TOOL
 SG_ S02_PID00_SupportedIDs_01_20 m0 : 24|32@1+ (1,0) [0|0] "" TOOL
 SG_ S03_PID00_SupportedIDs_01_20 m0 : 24|32@1+ (1,0) [0|0] "" TOOL
 SG_ S04_PID00_SupportedIDs_01_20 m0 : 24|32@1+ (1,0) [0|0] "" TOOL
 SG_ S05_PID00_SupportedIDs_01_20 m0 : 24|32@1+ (1,0) [0|0] "" TOOL
 SG_ S06_PID00_SupportedIDs_01_20 m0 : 24|32@1+ (1,0) [0|0] "" TOOL
 SG_ S07_PID00_SupportedIDs_01_20 m0 : 24|32@1+ (1,0) [0|0] "" TOOL
 SG_ S08_PID00_SupportedIDs_01_20 m0 : 24|32@1+ (1,0) [0|0] "" TOOL
 SG_ S09_PID00_SupportedIDs_01_20 m0 : 24|32@1+ (1,0) [0|0] "" TOOL
 SG_ S0A_PID00_SupportedIDs_01_20 m0 : 24|32@1+ (1,0) [0|0] "" TOOL
 SG_ S01_PID20_SupportedIDs_21_40 m32 : 24|32@1+ (1,0) [0|0] "" TOOL
 SG_ S02_PID20_SupportedIDs_21_40 m32 : 24|32@1+ (1,0) [0|0] "" TOOL
 SG_ S03_PID20_SupportedIDs_21_40 m32 : 24|32@1+ (1,0) [0|0] "" TOOL
 SG_ S04_PID20_SupportedIDs_21_40 m32 : 24|32@1+ (1,0) [0|0] "" TOOL
 SG_ S05_PID20_SupportedIDs_21_40 m32 : 24|32@1+ (1,0) [0|0] "" TOOL
 SG_ S06_PID20_SupportedIDs_21_40 m32 : 24|32@1+ (1,0) [0|0] "" TOOL
 SG_ S07_PID20_SupportedIDs_21_40 m32 : 24|32@1+ (1,0) [0|0] "" TOOL
 SG_ S08_PID20_SupportedIDs_21_40 m32 : 24|32@1+ (1,0) [0|0] "" TOOL
 SG_ S09_PID20_SupportedIDs_21_40 m32 : 24|32@1+ (1,0) [0|0] "" TOOL
 SG_ S0A_PID20_SupportedIDs_21_40 m32 : 24|32@1+ (1,0) [0|0] "" TOOL
 SG_ S01_PID40_SupportedIDs_41_60 m64 : 24|32@1+ (1,0) [0|0] "" TOOL
 SG_ S02_PID40_SupportedIDs_41_60 m64 : 24|32@1+ (1,0) [0|0] "" TOOL
 SG_ S03_PID40_SupportedIDs_41_60 m64 : 24|32@1+ (1,0) [0|0] "" TOOL
 SG_ S04_PID40_SupportedIDs_41_60 m64 : 24|32@1+ (1,0) [0|0] "" TOOL
 SG_ S05_PID40_SupportedIDs_41_60 m64 : 24|32@1+ (1,0) [0|0] "" TOOL
 SG_ S06_PID40_SupportedIDs_41_60 m64 : 24|32@1+ (1,0) [0|0] "" TOOL
 SG_ S07_PID40_SupportedIDs_41_60 m64 : 24|32@1+ (1,0) [0|0] "" TOOL
 SG_ S08_PID40_SupportedIDs_41_60 m64 : 24|32@1+ (1,0) [0|0] "" TOOL
 SG_ S09_PID40_SupportedIDs_41_60 m64 : 24|32@1+ (1,0) [0|0] "" TOOL
 SG_ S0A_PID40_SupportedIDs_41_60 m64 : 24|32@1+ (1,0) [0|0] "" TOOL
 SG_ S01_PID60_SupportedIDs_61_80 m96 : 24|32@1+ (1,0) [0|0] "" TOOL
 SG_ S02_PID60_SupportedIDs_61_80 m96 : 24|32@1+ (1,0) [0|0] "" TOOL
 SG_ S03_PID60_SupportedIDs_61_80 m96 : 24|32@1+ (1,0) [0|0] "" TOOL
 SG_ S04_PID60_SupportedIDs_61_80 m96 : 24|32@1+ (1,0) [0|0] "" TOOL
 SG_ S05_PID60_SupportedIDs_61_80 m96 : 24|32@1+ (1,0) [0|0] "" TOOL
 SG_ S06_PID60_SupportedIDs_61_80 m96 : 24|32@1+ (1,0) [0|0] "" TOOL
 SG_ S07_PID60_SupportedIDs_61_80 m96 : 24|32@1+ (1,0) [0|0] "" TOOL
 SG_ S08_PID60_SupportedIDs_61_80 m96 : 24|32@1+ (1,0) [0|0] "" TOOL
 SG_ S09_PID60_SupportedIDs_61_80 m96 : 24|32@1+ (1,0) [0|0] "" TOOL
 SG_ S0A_PID60_SupportedIDs_61_80 m96 : 24|32@1+ (1,0) [0|0] "" TOOL
 SG_ S01_PID80_SupportedIDs_81_A0 m128 : 24|32@1+ (1,0) [0|0] "" TOOL
 SG_ S02_PID80_SupportedIDs_81_A0 m128 : 24|32@1+ (1,0) [0|0] "" TOOL
 SG_ S03_PID80_SupportedIDs_81_A0 m128 : 24|32@1+ (1,0) [0|0] "" TOOL
 SG_ S04_PID80_SupportedIDs_81_A0 m128 : 24|32@1+ (1,0) [0|0] "" TOOL
 SG_ S05_PID80_SupportedIDs_81_A0 m128 : 24|32@1+ (1,0) [0|0] "" TOOL
 SG_ S06_PID80_SupportedIDs_81_A0 m128 : 24|32@1+ (1,0) [0|0] "" TOOL
 SG_ S07_PID80_SupportedIDs_81_A0 m128 : 24|32@1+ (1,0) [0|0] "" TOOL
 SG_ S08_PID80_SupportedIDs_81_A0 m128 : 24|32@1+ (1,0) [0|0] "" TOOL
 SG_ S09_PID80_SupportedIDs_81_A0 m128 : 24|32@1+ (1,0) [0|0] "" TOOL
 SG_ S0A_PID80_SupportedIDs_81_A0 m128 : 24|32@1+ (1,0) [0|0] "" TOOL
 SG_ S01_PIDA0_SupportedIDs_A1_C0 m160 : 24|32@1+ (1,0) [0|0] "" TOOL
 SG_ S02_PIDA0_SupportedIDs_A1_C0 m160 : 24|32@1+ (1,0) [0|0] "" TOOL
 SG_ S03_PIDA0_SupportedIDs_A1_C0 m160 : 24|32@1+ (1,0) [0|0] "" TOOL
 SG_ S04_PIDA0_SupportedIDs_A1_C0 m160 : 24|32@1+ (1,0) [0|0] "" TOOL
 SG_ S05_PIDA0_SupportedIDs_A1_C0 m160 : 24|32@1+ (1,0) [0|0] "" TOOL
 SG_ S06_PIDA0_SupportedIDs_A1_C0 m160 : 24|32@1+ (1,0) [0|0] "" TOOL
 SG_ S07_PIDA0_SupportedIDs_A1_C0 m160 : 24|32@1+ (1,0) [0|0] "" TOOL
 SG_ S08_PIDA0_SupportedIDs_A1_C0 m160 : 24|32@1+ (1,0) [0|0] "" TOOL
 SG_ S09_PIDA0_SupportedIDs_A1_C0 m160 : 24|32@1+ (1,0) [0|0] "" TOOL
 SG_ S0A_PIDA0_SupportedIDs_A1_C0 m160 : 24|32@1+ (1,0) [0|0] "" TOOL
 SG_ S01_PIDC0_SupportedIDs_C1_E0 m192 : 24|32@1+ (1,0) [0|0] "" TOOL
 SG_ S02_PIDC0_SupportedIDs_C1_E0 m192 : 24|32@1+ (1,0) [0|0] "" TOOL
 SG_ S03_PIDC0_SupportedIDs_C1_E0 m192 : 24|32@1+ (1,0) [0|0] "" TOOL
 SG_ S04_PIDC0_SupportedIDs_C1_E0 m192 : 24|32@1+ (1,0) [0|0] "" TOOL
 SG_ S05_PIDC0_SupportedIDs_C1_E0 m192 : 24|32@1+ (1,0) [0|0] "" TOOL
 SG_ S06_PIDC0_SupportedIDs_C1_E0 m192 : 24|32@1+ (1,0) [0|0] "" TOOL
 SG_ S07_PIDC0_SupportedIDs_C1_E0 m192 : 24|32@1+ (1,0) [0|0] "" TOOL
 SG_ S08_PIDC0_SupportedIDs_C1_E0 m192 : 24|32@1+ (1,0) [0|0] "" TOOL
 SG_ S09_PIDC0_SupportedIDs_C1_E0 m192 : 24|32@1+ (1,0) [0|0] "" TOOL
 SG_ S0A_PIDC0_SupportedIDs_C1_E0 m192 : 24|32@1+ (1,0) [0|0] "" TOOL
 SG_ DTC_CNT m1 : 24|7@1+ (1,0) [0|0] "" TOOL
 SG_ MIL m1 : 31|1@1+ (1,0) [0|0] "" TOOL
 SG_ MIS_SUP m1 : 32|1@1+ (1,0) [0|0] "" TOOL
 SG_ FUEL_SUP m1 : 33|1@1+ (1,0) [0|0] "" TOOL
 SG_ CCM_SUP m1 : 34|1@1+ (1,0) [0|0] "" TOOL
 SG_ CIM_SUP m1M : 35|1@1+ (1,0) [0|0] "" TOOL
 SG_ MIS_RDY m1 : 36|1@1+ (1,0) [0|0] "" TOOL
 SG_ FUEL_RDY m1 : 37|1@1+ (1,0) [0|0] "" TOOL
 SG_ CCM_RDY m1 : 38|1@1+ (1,0) [0|0] "" TOOL
 SG_ CAT_SUP m0 : 40|1@1+ (1,0) [0|0] "" TOOL
 SG_ HCAT_SUP m0 : 41|1@1+ (1,0) [0|0] "" TOOL
 SG_ EVAP_SUP m0 : 42|1@1+ (1,0) [0|0] "" TOOL
 SG_ AIR_SUP m0 : 43|1@1+ (1,0) [0|0] "" TOOL
 SG_ GPF_SUP m0 : 44|1@1+ (1,0) [0|0] "" TOOL
 SG_ O2S_SUP m0 : 45|1@1+ (1,0) [0|0] "" TOOL
 SG_ HTR_SUP m0 : 46|1@1+ (1,0) [0|0] "" TOOL
 SG_ EGR_SUP m0 : 47|1@1+ (1,0) [0|0] "" TOOL
 SG_ CAT_RDY m0 : 48|1@1+ (1,0) [0|0] "" TOOL
 SG_ HCAT_RDY m0 : 49|1@1+ (1,0) [0|0] "" TOOL
 SG_ EVAP_RDY m0 : 50|1@1+ (1,0) [0|0] "" TOOL
 SG_ AIR_RDY m0 : 51|1@1+ (1,0) [0|0] "" TOOL
 SG_ GPF_RDY m0 : 52|1@1+ (1,0) [0|0] "" TOOL
 SG_ O2S_RDY m0 : 53|1@1+ (1,0) [0|0] "" TOOL
 SG_ HTR_RDY m0 : 54|1@1+ (1,0) [0|0] "" TOOL
 SG_ EGR_RDY m0 : 55|1@1+ (1,0) [0|0] "" TOOL
 SG_ HCCATSUP m1 : 56|1@1+ (1,0) [0|0] "" TOOL
 SG_ NCAT_SUP m1 : 57|1@1+ (1,0) [0|0] "" TOOL
 SG_ BP_SUP m1 : 59|1@1+ (1,0) [0|0] "" TOOL
 SG_ EGS_SUP m1 : 61|1@1+ (1,0) [0|0] "" TOOL
 SG_ PM_SUP m1 : 62|1@1+ (1,0) [0|0] "" TOOL
 SG_ HCCATRDY m1 : 64|1@1+ (1,0) [0|0] "" TOOL
 SG_ NCAT_RDY m1 : 65|1@1+ (1,0) [0|0] "" TOOL
 SG_ BP_RDY m1 : 67|1@1+ (1,0) [0|0] "" TOOL
 SG_ EGS_RDY m1 : 69|1@1+ (1,0) [0|0] "" TOOL
 SG_ PM_RDY m1 : 70|1@1+ (1,0) [0|0] "" TOOL
 SG_ DTCFRZF m2 : 31|16@0+ (1,0) [0|0] "" TOOL
 SG_ FUELSYSA_OL m3 : 24|1@1+ (1,0) [0|0] "" TOOL
 SG_ FUELSYSA_CL m3 : 25|1@1+ (1,0) [0|0] "" TOOL
 SG_ FUELSYSA_OL_Drive m3 : 26|1@1+ (1,0) [0|0] "" TOOL
 SG_ FUELSYSA_OL_Fault m3 : 27|1@1+ (1,0) [0|0] "" TOOL
 SG_ FUELSYSA_CL_Fault m3 : 28|1@1+ (1,0) [0|0] "" TOOL
 SG_ FUELSYSA_OL_B2 m3 : 29|1@1+ (1,0) [0|0] "" TOOL
 SG_ FUELSYSA_OL_Drive_B2 m3 : 30|1@1+ (1,0) [0|0] "" TOOL
 SG_ FUELSYSA_OL_Fault_B2 m3 : 31|1@1+ (1,0) [0|0] "" TOOL
 SG_ FUELSYSB_OL m3 : 32|1@1+ (1,0) [0|0] "" TOOL
 SG_ FUELSYSB_CL m3 : 33|1@1+ (1,0) [0|0] "" TOOL
 SG_ FUELSYSB_OL_Drive m3 : 34|1@1+ (1,0) [0|0] "" TOOL
 SG_ FUELSYSB_OL_Fault m3 : 35|1@1+ (1,0) [0|0] "" TOOL
 SG_ FUELSYSB_CL_Fault m3 : 36|1@1+ (1,0) [0|0] "" TOOL
 SG_ FUELSYSB_OL_B2 m3 : 37|1@1+ (1,0) [0|0] "" TOOL
 SG_ FUELSYSB_OL_Drive_B2 m3 : 38|1@1+ (1,0) [0|0] "" TOOL
 SG_ FUELSYSB_OL_Fault_B2 m3 : 39|1@1+ (1,0) [0|0] "" TOOL
 SG_ LOAD_PCT m4 : 24|8@1+ (0.3921569,0) [0|100] "%" TOOL
 SG_ ECT m5 : 24|8@1+ (1,-40) [-40|215] "°C " TOOL
 SG_ SHRTFT1 m6 : 24|8@1+ (0.78125,-100) [-100|99.21875] "%" TOOL
 SG_ SHRTFT3 m6 : 32|8@1+ (0.78125,-100) [-100|99.21875] "%" TOOL
 SG_ LONGFT1 m7 : 24|8@1+ (0.78125,-100) [-100|99.21875] "%" TOOL
 SG_ LONGFT3 m7 : 32|8@1+ (0.78125,-100) [-100|99.21875] "%" TOOL
 SG_ SHRTFT2 m8 : 24|8@1+ (0.78125,-100) [-100|99.21875] "%" TOOL
 SG_ SHRTFT4 m8 : 32|8@1+ (0.78125,-100) [-100|99.21875] "%" TOOL
 SG_ LONGFT2 m9 : 24|8@1+ (0.78125,-100) [-100|99.21875] "%" TOOL
 SG_ LONGFT4 m9 : 32|8@1+ (0.78125,-100) [-100|99.21875] "%" TOOL
 SG_ FPGAUGE m10 : 24|8@1+ (3,0) [0|0] "kPa" TOOL
 SG_ MAP m11 : 24|8@1+ (1,0) [0|0] "kPa" TOOL
 SG_ RPM m12 : 31|16@0+ (0.25,0) [0|0] "rpm" TOOL
 SG_ VSS m13 : 24|8@1+ (1,0) [0|0] "km/h" TOOL
 SG_ SPARKADV m14 : 24|8@1- (0.5,0) [0|0] "°" TOOL
 SG_ IAT m15 : 24|8@1+ (1,-40) [0|0] "°C " TOOL
 SG_ MAF m16 : 31|16@0+ (0.01,0) [0|0] "g/s" TOOL
 SG_ TP m17 : 24|8@1+ (0.3921569,0) [0|0] "%" TOOL
 SG_ AIR_STAT_UPS m18 : 24|1@1+ (1,0) [0|0] "" TOOL
 SG_ AIR_STAT_DNS m18 : 25|1@1+ (1,0) [0|0] "" TOOL
 SG_ AIR_STAT_OFF m18 : 26|1@1+ (1,0) [0|0] "" TOOL
 SG_ AIR_STAT_DIAG m18 : 27|1@1+ (1,0) [0|0] "" TOOL
 SG_ O2SLOC_A1 m19 : 24|1@1+ (1,0) [0|0] "" TOOL
 SG_ O2SLOC_A2 m19 : 25|1@1+ (1,0) [0|0] "" TOOL
 SG_ O2SLOC_A3 m19 : 26|1@1+ (1,0) [0|0] "" TOOL
 SG_ O2SLOC_A4 m19 : 27|1@1+ (1,0) [0|0] "" TOOL
 SG_ O2SLOC_A5 m19 : 28|1@1+ (1,0) [0|0] "" TOOL
 SG_ O2SLOC_A6 m19 : 29|1@1+ (1,0) [0|0] "" TOOL
 SG_ O2SLOC_A7 m19 : 30|1@1+ (1,0) [0|0] "" TOOL
 SG_ O2SLOC_A8 m19 : 31|1@1+ (1,0) [0|0] "" TOOL
 SG_ O2S1 m20 : 24|8@1+ (0.005,0) [0|0] "V" TOOL
 SG_ SHRTFT11 m20 : 32|8@1- (0.78125,0) [0|0] "%" TOOL
 SG_ O2S2 m21 : 24|8@1+ (0.005,0) [0|0] "V" TOOL
 SG_ SHRTFT12 m21 : 32|8@1- (0.78125,0) [0|0] "%" TOOL
 SG_ O2S3 m22 : 24|8@1+ (0.005,0) [0|0] "V" TOOL
 SG_ SHRTFT13 m22 : 32|8@1- (0.78125,0) [0|0] "%" TOOL
 SG_ O2S4 m23 : 24|8@1+ (0.005,0) [0|0] "V" TOOL
 SG_ SHRTFT14 m23 : 32|8@1- (0.78125,0) [0|0] "%" TOOL
 SG_ O2S5 m24 : 24|8@1+ (0.005,0) [0|0] "V" TOOL
 SG_ SHRTFT15 m24 : 32|8@1- (0.78125,0) [0|0] "%" TOOL
 SG_ O2S6 m25 : 24|8@1+ (0.005,0) [0|0] "V" TOOL
 SG_ SHRTFT16 m25 : 32|8@1- (0.78125,0) [0|0] "%" TOOL
 SG_ O2S7 m26 : 24|8@1+ (0.005,0) [0|0] "V" TOOL
 SG_ SHRTFT17 m26 : 32|8@1- (0.78125,0) [0|0] "%" TOOL
 SG_ O2S8 m27 : 24|8@1+ (0.005,0) [0|0] "V" TOOL
 SG_ SHRTFT8 m27 : 32|8@1- (0.78125,0) [0|0] "%" TOOL
 SG_ OBDSUP m28 : 24|8@1+ (1,0) [0|0] "" TOOL
 SG_ O2SLOC_B1 m29 : 24|1@1+ (1,0) [0|0] "" TOOL
 SG_ O2SLOC_B2 m29 : 25|1@1+ (1,0) [0|0] "" TOOL
 SG_ O2SLOC_B3 m29 : 26|1@1+ (1,0) [0|0] "" TOOL
 SG_ O2SLOC_B4 m29 : 27|1@1+ (1,0) [0|0] "" TOOL
 SG_ O2SLOC_B5 m29 : 28|1@1+ (1,0) [0|0] "" TOOL
 SG_ O2SLOC_B6 m29 : 29|1@1+ (1,0) [0|0] "" TOOL
 SG_ O2SLOC_B7 m29 : 30|1@1+ (1,0) [0|0] "" TOOL
 SG_ O2SLOC_B8 m29 : 31|1@1+ (1,0) [0|0] "" TOOL
 SG_ PTO_STAT m30 : 24|1@1+ (1,0) [0|0] "" TOOL
 SG_ RUNTM m31 : 31|16@0+ (1,0) [0|0] "sec" TOOL
 SG_ MIL_DIST m33 : 31|16@0+ (1,0) [0|0] "km" TOOL
 SG_ FP m34 : 31|16@0+ (0.079,0) [0|0] "kPa" TOOL
 SG_ FRP m35 : 31|16@0+ (10,0) [0|0] "kPa" TOOL
 SG_ LAMBDA1 m36 : 31|16@0+ (0.0000305,0) [0|0] "" TOOL
 SG_ O2SWRV1 m36 : 47|16@0+ (0.000122,0) [0|0] "V" TOOL
 SG_ LAMBDA2 m37 : 31|16@0+ (0.0000305,0) [0|0] "" TOOL
 SG_ O2SWRV2 m37 : 47|16@0+ (0.000122,0) [0|0] "V" TOOL
 SG_ LAMBDA3 m38 : 31|16@0+ (0.0000305,0) [0|0] "" TOOL
 SG_ O2SWRV3 m38 : 47|16@0+ (0.000122,0) [0|0] "V" TOOL
 SG_ LAMBDA4 m39 : 31|16@0+ (0.0000305,0) [0|0] "" TOOL
 SG_ O2SWRV4 m39 : 47|16@0+ (0.000122,0) [0|0] "V" TOOL
 SG_ LAMBDA5 m40 : 31|16@0+ (0.0000305,0) [0|0] "" TOOL
 SG_ O2SWRV5 m40 : 47|16@0+ (0.000122,0) [0|0] "V" TOOL
 SG_ LAMBDA6 m41 : 31|16@0+ (0.0000305,0) [0|0] "" TOOL
 SG_ O2SWRV6 m41 : 47|16@0+ (0.000122,0) [0|0] "V" TOOL
 SG_ LAMBDA7 m42 : 31|16@0+ (0.0000305,0) [0|0] "" TOOL
 SG_ O2SWRV7 m42 : 47|16@0+ (0.000122,0) [0|0] "V" TOOL
 SG_ LAMBDA8 m43 : 31|16@0+ (0.0000305,0) [0|0] "" TOOL
 SG_ O2SWRV8 m43 : 47|16@0+ (0.000122,0) [0|0] "V" TOOL
 SG_ VIN m2 : 32|136@1+ (1,0) [0|0] "" TOOL
SG_MUL_VAL_ 2024 S01_PID SERVICE 1-1;
SG_MUL_VAL_ 2024 S02_PID SERVICE 2-2;
SG_MUL_VAL_ 2024 S03_PID SERVICE 3-3;
SG_MUL_VAL_ 2024 S04_PID SERVICE 4-4;
SG_MUL_VAL_ 2024 S05_PID SERVICE 5-5;
SG_MUL_VAL_ 2024 S06_PID SERVICE 6-6;
SG_MUL_VAL_ 2024 S07_PID SERVICE 7-7;
SG_MUL_VAL_ 2024 S08_PID SERVICE 8-8;
SG_MUL_VAL_ 2024 S09_PID SERVICE 9-9;
SG_MUL_VAL_ 2024 S0A_PID SERVICE 10-10;
SG_MUL_VAL_ 2024 S01_PID00_SupportedIDs_01_20 S01_PID 0-0;
SG_MUL_VAL_ 2024 S02_PID00_SupportedIDs_01_20 S02_PID 0-0;
SG_MUL_VAL_ 2024 S03_PID00_SupportedIDs_01_20 S03_PID 0-0;
SG_MUL_VAL_ 2024 S04_PID00_SupportedIDs_01_20 S04_PID 0-0;
SG_MUL_VAL_ 2024 S05_PID00_SupportedIDs_01_20 S05_PID 0-0;
SG_MUL_VAL_ 2024 S06_PID00_SupportedIDs_01_20 S06_PID 0-0;
SG_MUL_VAL_ 2024 S07_PID00_SupportedIDs_01_20 S07_PID 0-0;
SG_MUL_VAL_ 2024 S08_PID00_SupportedIDs_01_20 S08_PID 0-0;
SG_MUL_VAL_ 2024 S09_PID00_SupportedIDs_01_20 S09_PID 0-0;
SG_MUL_VAL_ 2024 S0A_PID00_SupportedIDs_01_20 S0A_PID 0-0;
SG_MUL_VAL_ 2024 S01_PID20_SupportedIDs_21_40 S01_PID 32-32;
SG_MUL_VAL_ 2024 S02_PID20_SupportedIDs_21_40 S02_PID 32-32;
SG_MUL_VAL_ 2024 S03_PID20_SupportedIDs_21_40 S03_PID 32-32;
SG_MUL_VAL_ 2024 S04_PID20_SupportedIDs_21_40 S04_PID 32-32;
SG_MUL_VAL_ 2024 S05_PID20_SupportedIDs_21_40 S05_PID 32-32;
SG_MUL_VAL_ 2024 S06_PID20_SupportedIDs_21_40 S06_PID 32-32;
SG_MUL_VAL_ 2024 S07_PID20_SupportedIDs_21_40 S07_PID 32-32;
SG_MUL_VAL_ 2024 S08_PID20_SupportedIDs_21_40 S08_PID 32-32;
SG_MUL_VAL_ 2024 S09_PID20_SupportedIDs_21_40 S09_PID 32-32;
SG_MUL_VAL_ 2024 S0A_PID20_SupportedIDs_21_40 S0A_PID 32-32;
SG_MUL_VAL_ 2024 S01_PID40_SupportedIDs_41_60 S01_PID 64-64;
SG_MUL_VAL_ 2024 S02_PID40_SupportedIDs_41_60 S02_PID 64-64;
SG_MUL_VAL_ 2024 S03_PID40_SupportedIDs_41_60 S03_PID 64-64;
SG_MUL_VAL_ 2024 S04_PID40_SupportedIDs_41_60 S04_PID 64-64;
SG_MUL_VAL_ 2024 S05_PID40_SupportedIDs_41_60 S05_PID 64-64;
SG_MUL_VAL_ 2024 S06_PID40_SupportedIDs_41_60 S06_PID 64-64;
SG_MUL_VAL_ 2024 S07_PID40_SupportedIDs_41_60 S07_PID 64-64;
SG_MUL_VAL_ 2024 S08_PID40_SupportedIDs_41_60 S08_PID 64-64;
SG_MUL_VAL_ 2024 S09_PID40_SupportedIDs_41_60 S09_PID 64-64;
SG_MUL_VAL_ 2024 S0A_PID40_SupportedIDs_41_60 S0A_PID 64-64;
SG_MUL_VAL_ 2024 S01_PID60_SupportedIDs_61_80 S01_PID 96-96;
SG_MUL_VAL_ 2024 S02_PID60_SupportedIDs_61_80 S02_PID 96-96;
SG_MUL_VAL_ 2024 S03_PID60_SupportedIDs_61_80 S03_PID 96-96;
SG_MUL_VAL_ 2024 S04_PID60_SupportedIDs_61_80 S04_PID 96-96;
SG_MUL_VAL_ 2024 S05_PID60_SupportedIDs_61_80 S05_PID 96-96;
SG_MUL_VAL_ 2024 S06_PID60_SupportedIDs_61_80 S06_PID 96-96;
SG_MUL_VAL_ 2024 S07_PID60_SupportedIDs_61_80 S07_PID 96-96;
SG_MUL_VAL_ 2024 S08_PID60_SupportedIDs_61_80 S08_PID 96-96;
SG_MUL_VAL_ 2024 S09_PID60_SupportedIDs_61_80 S09_PID 96-96;
SG_MUL_VAL_ 2024 S0A_PID60_SupportedIDs_61_80 S0A_PID 96-96;
SG_MUL_VAL_ 2024 S01_PID80_SupportedIDs_81_A0 S01_PID 128-128;
SG_MUL_VAL_ 2024 S02_PID80_SupportedIDs_81_A0 S02_PID 128-128;
SG_MUL_VAL_ 2024 S03_PID80_SupportedIDs_81_A0 S03_PID 128-128;
SG_MUL_VAL_ 2024 S04_PID80_SupportedIDs_81_A0 S04_PID 128-128;
SG_MUL_VAL_ 2024 S05_PID80_SupportedIDs_81_A0 S05_PID 128-128;
SG_MUL_VAL_ 2024 S06_PID80_SupportedIDs_81_A0 S06_PID 128-128;
SG_MUL_VAL_ 2024 S07_PID80_SupportedIDs_81_A0 S07_PID 128-128;
SG_MUL_VAL_ 2024 S08_PID80_SupportedIDs_81_A0 S08_PID 128-128;
SG_MUL_VAL_ 2024 S09_PID80_SupportedIDs_81_A0 S09_PID 128-128;
SG_MUL_VAL_ 2024 S0A_PID80_SupportedIDs_81_A0 S0A_PID 128-128;
SG_MUL_VAL_ 2024 S01_PIDA0_SupportedIDs_A1_C0 S01_PID 160-160;
SG_MUL_VAL_ 2024 S02_PIDA0_SupportedIDs_A1_C0 S02_PID 160-160;
SG_MUL_VAL_ 2024 S03_PIDA0_SupportedIDs_A1_C0 S03_PID 160-160;
SG_MUL_VAL_ 2024 S04_PIDA0_SupportedIDs_A1_C0 S04_PID 160-160;
SG_MUL_VAL_ 2024 S05_PIDA0_SupportedIDs_A1_C0 S05_PID 160-160;
SG_MUL_VAL_ 2024 S06_PIDA0_SupportedIDs_A1_C0 S06_PID 160-160;
SG_MUL_VAL_ 2024 S07_PIDA0_SupportedIDs_A1_C0 S07_PID 160-160;
SG_MUL_VAL_ 2024 S08_PIDA0_SupportedIDs_A1_C0 S08_PID 160-160;
SG_MUL_VAL_ 2024 S09_PIDA0_SupportedIDs_A1_C0 S09_PID 160-160;
SG_MUL_VAL_ 2024 S0A_PIDA0_SupportedIDs_A1_C0 S0A_PID 160-160;
SG_MUL_VAL_ 2024 S01_PIDC0_SupportedIDs_C1_E0 S01_PID 192-192;
SG_MUL_VAL_ 2024 S02_PIDC0_SupportedIDs_C1_E0 S02_PID 192-192;
SG_MUL_VAL_ 2024 S03_PIDC0_SupportedIDs_C1_E0 S03_PID 192-192;
SG_MUL_VAL_ 2024 S04_PIDC0_SupportedIDs_C1_E0 S04_PID 192-192;
SG_MUL_VAL_ 2024 S05_PIDC0_SupportedIDs_C1_E0 S05_PID 192-192;
SG_MUL_VAL_ 2024 S06_PIDC0_SupportedIDs_C1_E0 S06_PID 192-192;
SG_MUL_VAL_ 2024 S07_PIDC0_SupportedIDs_C1_E0 S07_PID 192-192;
SG_MUL_VAL_ 2024 S08_PIDC0_SupportedIDs_C1_E0 S08_PID 192-192;
SG_MUL_VAL_ 2024 S09_PIDC0_SupportedIDs_C1_E0 S09_PID 192-192;
SG_MUL_VAL_ 2024 S0A_PIDC0_SupportedIDs_C1_E0 S0A_PID 192-192;
SG_MUL_VAL_ 2024 DTC_CNT S01_PID 1-1;
SG_MUL_VAL_ 2024 MIL S01_PID 1-1;
SG_MUL_VAL_ 2024 MIS_SUP S01_PID 1-1;
SG_MUL_VAL_ 2024 FUEL_SUP S01_PID 1-1;
SG_MUL_VAL_ 2024 CCM_SUP S01_PID 1-1;
SG_MUL_VAL_ 2024 CIM_SUP S01_PID 1-1;
SG_MUL_VAL_ 2024 MIS_RDY S01_PID 1-1;
SG_MUL_VAL_ 2024 FUEL_RDY S01_PID 1-1;
SG_MUL_VAL_ 2024 CCM_RDY S01_PID 1-1;
SG_MUL_VAL_ 2024 CAT_SUP CIM_SUP 0-0;
SG_MUL_VAL_ 2024 HCAT_SUP CIM_SUP 0-0;
SG_MUL_VAL_ 2024 EVAP_SUP CIM_SUP 0-0;
SG_MUL_VAL_ 2024 AIR_SUP CIM_SUP 0-0;
SG_MUL_VAL_ 2024 GPF_SUP CIM_SUP 0-0;
SG_MUL_VAL_ 2024 O2S_SUP CIM_SUP 0-0;
SG_MUL_VAL_ 2024 HTR_SUP CIM_SUP 0-0;
SG_MUL_VAL_ 2024 EGR_SUP CIM_SUP 0-0;
SG_MUL_VAL_ 2024 CAT_RDY CIM_SUP 0-0;
SG_MUL_VAL_ 2024 HCAT_RDY CIM_SUP 0-0;
SG_MUL_VAL_ 2024 EVAP_RDY CIM_SUP 0-0;
SG_MUL_VAL_ 2024 AIR_RDY CIM_SUP 0-0;
SG_MUL_VAL_ 2024 GPF_RDY CIM_SUP 0-0;
SG_MUL_VAL_ 2024 O2S_RDY CIM_SUP 0-0;
SG_MUL_VAL_ 2024 HTR_RDY CIM_SUP 0-0;
SG_MUL_VAL_ 2024 EGR_RDY CIM_SUP 0-0;
SG_MUL_VAL_ 2024 HCCATSUP CIM_SUP 1-1;
SG_MUL_VAL_ 2024 NCAT_SUP CIM_SUP 1-1;
SG_MUL_VAL_ 2024 BP_SUP CIM_SUP 1-1;
SG_MUL_VAL_ 2024 EGS_SUP CIM_SUP 1-1;
SG_MUL_VAL_ 2024 PM_SUP CIM_SUP 1-1;
SG_MUL_VAL_ 2024 HCCATRDY CIM_SUP 1-1;
SG_MUL_VAL_ 2024 NCAT_RDY CIM_SUP 1-1;
SG_MUL_VAL_ 2024 BP_RDY CIM_SUP 1-1;
SG_MUL_VAL_ 2024 EGS_RDY CIM_SUP 1-1;
SG_MUL_VAL_ 2024 PM_RDY CIM_SUP 1-1;
SG_MUL_VAL_ 2024 DTCFRZF S01_PID 2-2;
SG_MUL_VAL_ 2024 FUELSYSA_OL S01_PID 3-3;
SG_MUL_VAL_ 2024 FUELSYSA_CL S01_PID 3-3;
SG_MUL_VAL_ 2024 FUELSYSA_OL_Drive S01_PID 3-3;
SG_MUL_VAL_ 2024 FUELSYSA_OL_Fault S01_PID 3-3;
SG_MUL_VAL_ 2024 FUELSYSA_CL_Fault S01_PID 3-3;
SG_MUL_VAL_ 2024 FUELSYSA_OL_B2 S01_PID 3-3;
SG_MUL_VAL_ 2024 FUELSYSA_OL_Drive_B2 S01_PID 3-3;
SG_MUL_VAL_ 2024 FUELSYSA_OL_Fault_B2 S01_PID 3-3;
SG_MUL_VAL_ 2024 FUELSYSB_OL S01_PID 3-3;
SG_MUL_VAL_ 2024 FUELSYSB_CL S01_PID 3-3;
SG_MUL_VAL_ 2024 FUELSYSB_OL_Drive S01_PID 3-3;
SG_MUL_VAL_ 2024 FUELSYSB_OL_Fault S01_PID 3-3;
SG_MUL_VAL_ 2024 FUELSYSB_CL_Fault S01_PID 3-3;
SG_MUL_VAL_ 2024 FUELSYSB_OL_B2 S01_PID 3-3;
SG_MUL_VAL_ 2024 FUELSYSB_OL_Drive_B2 S01_PID 3-3;
SG_MUL_VAL_ 2024 FUELSYSB_OL_Fault_B2 S01_PID 3-3;
SG_MUL_VAL_ 2024 LOAD_PCT S01_PID 4-4;
SG_MUL_VAL_ 2024 ECT S01_PID 5-5;
SG_MUL_VAL_ 2024 SHRTFT1 S01_PID 6-6;
SG_MUL_VAL_ 2024 SHRTFT3 S01_PID 6-6;
SG_MUL_VAL_ 2024 LONGFT1 S01_PID 7-7;
SG_MUL_VAL_ 2024 LONGFT3 S01_PID 7-7;
SG_MUL_VAL_ 2024 SHRTFT2 S01_PID 8-8;
SG_MUL_VAL_ 2024 SHRTFT4 S01_PID 8-8;
SG_MUL_VAL_ 2024 LONGFT2 S01_PID 9-9;
SG_MUL_VAL_ 2024 LONGFT4 S01_PID 9-9;
SG_MUL_VAL_ 2024 FPGAUGE S01_PID 10-10;
SG_MUL_VAL_ 2024 MAP S01_PID 11-11;
SG_MUL_VAL_ 2024 RPM S01_PID 12-12;
SG_MUL_VAL_ 2024 VSS S01_PID 13-13;
SG_MUL_VAL_ 2024 SPARKADV S01_PID 14-14;
SG_MUL_VAL_ 2024 IAT S01_PID 15-15;
SG_MUL_VAL_ 2024 MAF S01_PID 16-16;
SG_MUL_VAL_ 2024 TP S01_PID 17-17;
SG_MUL_VAL_ 2024 AIR_STAT_UPS S01_PID 18-18;
SG_MUL_VAL_ 2024 AIR_STAT_DNS S01_PID 18-18;
SG_MUL_VAL_ 2024 AIR_STAT_OFF S01_PID 18-18;
SG_MUL_VAL_ 2024 AIR_STAT_DIAG S01_PID 18-18;
SG_MUL_VAL_ 2024 O2SLOC_A1 S01_PID 19-19;
SG_MUL_VAL_ 2024 O2SLOC_A2 S01_PID 19-19;
SG_MUL_VAL_ 2024 O2SLOC_A3 S01_PID 19-19;
SG_MUL_VAL_ 2024 O2SLOC_A4 S01_PID 19-19;
SG_MUL_VAL_ 2024 O2SLOC_A5 S01_PID 19-19;
SG_MUL_VAL_ 2024 O2SLOC_A6 S01_PID 19-19;
SG_MUL_VAL_ 2024 O2SLOC_A7 S01_PID 19-19;
SG_MUL_VAL_ 2024 O2SLOC_A8 S01_PID 19-19;
SG_MUL_VAL_ 2024 O2S1 S01_PID 20-20;
SG_MUL_VAL_ 2024 SHRTFT11 S01_PID 20-20;
SG_MUL_VAL_ 2024 O2S2 S01_PID 21-21;
SG_MUL_VAL_ 2024 SHRTFT12 S01_PID 21-21;
SG_MUL_VAL_ 2024 O2S3 S01_PID 22-22;
SG_MUL_VAL_ 2024 SHRTFT13 S01_PID 22-22;
SG_MUL_VAL_ 2024 O2S4 S01_PID 23-23;
SG_MUL_VAL_ 2024 SHRTFT14 S01_PID 23-23;
SG_MUL_VAL_ 2024 O2S5 S01_PID 24-24;
SG_MUL_VAL_ 2024 SHRTFT15 S01_PID 24-24;
SG_MUL_VAL_ 2024 O2S6 S01_PID 25-25;
SG_MUL_VAL_ 2024 SHRTFT16 S01_PID 25-25;
SG_MUL_VAL_ 2024 O2S7 S01_PID 26-26;
SG_MUL_VAL_ 2024 SHRTFT17 S01_PID 26-26;
SG_MUL_VAL_ 2024 O2S8 S01_PID 27-27;
SG_MUL_VAL_ 2024 SHRTFT8 S01_PID 27-27;
SG_MUL_VAL_ 2024 OBDSUP S01_PID 28-28;
SG_MUL_VAL_ 2024 O2SLOC_B1 S01_PID 29-29;
SG_MUL_VAL_ 2024 O2SLOC_B2 S01_PID 29-29;
SG_MUL_VAL_ 2024 O2SLOC_B3 S01_PID 29-29;
SG_MUL_VAL_ 2024 O2SLOC_B4 S01_PID 29-29;
SG_MUL_VAL_ 2024 O2SLOC_B5 S01_PID 29-29;
SG_MUL_VAL_ 2024 O2SLOC_B6 S01_PID 29-29;
SG_MUL_VAL_ 2024 O2SLOC_B7 S01_PID 29-29;
SG_MUL_VAL_ 2024 O2SLOC_B8 S01_PID 29-29;
SG_MUL_VAL_ 2024 PTO_STAT S01_PID 30-30;
SG_MUL_VAL_ 2024 RUNTM S01_PID 31-31;
SG_MUL_VAL_ 2024 MIL_DIST S01_PID 33-33;
SG_MUL_VAL_ 2024 FP S01_PID 34-34;
SG_MUL_VAL_ 2024 FRP S01_PID 35-35;
SG_MUL_VAL_ 2024 LAMBDA1 S01_PID 36-36;
SG_MUL_VAL_ 2024 O2SWRV1 S01_PID 36-36;
SG_MUL_VAL_ 2024 LAMBDA2 S01_PID 37-37;
SG_MUL_VAL_ 2024 O2SWRV2 S01_PID 37-37;
SG_MUL_VAL_ 2024 LAMBDA3 S01_PID 38-38;
SG_MUL_VAL_ 2024 O2SWRV3 S01_PID 38-38;
SG_MUL_VAL_ 2024 LAMBDA4 S01_PID 39-39;
SG_MUL_VAL_ 2024 O2SWRV4 S01_PID 39-39;
SG_MUL_VAL_ 2024 LAMBDA5 S01_PID 40-40;
SG_MUL_VAL_ 2024 O2SWRV5 S01_PID 40-40;
SG_MUL_VAL_ 2024 LAMBDA6 S01_PID 41-41;
SG_MUL_VAL_ 2024 O2SWRV6 S01_PID 41-41;
SG_MUL_VAL_ 2024 LAMBDA7 S01_PID 42-42;
SG_MUL_VAL_ 2024 O2SWRV7 S01_PID 42-42;
SG_MUL_VAL_ 2024 LAMBDA8 S01_PID 43-43;
SG_MUL_VAL_ 2024 O2SWRV8 S01_PID 43-43;
SG_MUL_VAL_ 2024 VIN S09_PID 2-2;
