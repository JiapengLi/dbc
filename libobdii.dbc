VERSION "v0.0.1"

NS_ :

BS_:

BU_:

BO_ 2024 RX: 64 ECU
 SG_ LEN : 0|8@1+ (1,0) [0|0] "" TOOL
 SG_ SID M : 8|4@1+ (1,0) [0|0] "" TOOL
 SG_ SIDPR : 12|4@1+ (1,0) [0|0] "" TOOL
 SG_ S01_PID m1M : 16|8@1+ (1,0) [0|0] "" TOOL
 SG_ S02_PID m2M : 16|8@1+ (1,0) [0|0] "" TOOL
 SG_ S04_PID m4M : 16|8@1+ (1,0) [0|0] "" TOOL
 SG_ S05_PID m5M : 16|8@1+ (1,0) [0|0] "" TOOL
 SG_ S06_PID m6M : 16|8@1+ (1,0) [0|0] "" TOOL
 SG_ S07_PID m7M : 16|8@1+ (1,0) [0|0] "" TOOL
 SG_ S08_PID m8M : 16|8@1+ (1,0) [0|0] "" TOOL
 SG_ S09_PID m9M : 16|8@1+ (1,0) [0|0] "" TOOL
 SG_ S0A_PID m10M : 16|8@1+ (1,0) [0|0] "" TOOL
 SG_ S01_PID00_SupportedIDs_01_20 m0 : 24|32@1+ (1,0) [0|0] "" TOOL
 SG_ S02_PID00_SupportedIDs_01_20 m0 : 24|32@1+ (1,0) [0|0] "" TOOL
 SG_ S03_PID00_SupportedIDs_01_20 m0 : 24|32@1+ (1,0) [0|0] "" TOOL
 SG_ S04_PID00_SupportedIDs_01_20 m0 : 24|32@1+ (1,0) [0|0] "" TOOL
 SG_ S05_PID00_SupportedIDs_01_20 m0 : 24|32@1+ (1,0) [0|0] "" TOOL
 SG_ S06_PID00_SupportedIDs_01_20 m0 : 24|32@1+ (1,0) [0|0] "" TOOL
 SG_ S07_PID00_SupportedIDs_01_20 m0 : 24|32@1+ (1,0) [0|0] "" TOOL
 SG_ S08_PID00_SupportedIDs_01_20 m0 : 24|32@1+ (1,0) [0|0] "" TOOL
 SG_ S09_PID00_SupportedIDs_01_20 m0 : 24|32@1+ (1,0) [0|0] "" TOOL
 SG_ S0A_PID00_SupportedIDs_01_20 m0 : 24|32@1+ (1,0) [0|0] "" TOOL
 SG_ S01_PID20_SupportedIDs_21_40 m32 : 24|32@1+ (1,0) [0|0] "" TOOL
 SG_ S02_PID20_SupportedIDs_21_40 m32 : 24|32@1+ (1,0) [0|0] "" TOOL
 SG_ S03_PID20_SupportedIDs_21_40 m32 : 24|32@1+ (1,0) [0|0] "" TOOL
 SG_ S04_PID20_SupportedIDs_21_40 m32 : 24|32@1+ (1,0) [0|0] "" TOOL
 SG_ S05_PID20_SupportedIDs_21_40 m32 : 24|32@1+ (1,0) [0|0] "" TOOL
 SG_ S06_PID20_SupportedIDs_21_40 m32 : 24|32@1+ (1,0) [0|0] "" TOOL
 SG_ S07_PID20_SupportedIDs_21_40 m32 : 24|32@1+ (1,0) [0|0] "" TOOL
 SG_ S08_PID20_SupportedIDs_21_40 m32 : 24|32@1+ (1,0) [0|0] "" TOOL
 SG_ S09_PID20_SupportedIDs_21_40 m32 : 24|32@1+ (1,0) [0|0] "" TOOL
 SG_ S0A_PID20_SupportedIDs_21_40 m32 : 24|32@1+ (1,0) [0|0] "" TOOL
 SG_ S01_PID40_SupportedIDs_41_60 m64 : 24|32@1+ (1,0) [0|0] "" TOOL
 SG_ S02_PID40_SupportedIDs_41_60 m64 : 24|32@1+ (1,0) [0|0] "" TOOL
 SG_ S03_PID40_SupportedIDs_41_60 m64 : 24|32@1+ (1,0) [0|0] "" TOOL
 SG_ S04_PID40_SupportedIDs_41_60 m64 : 24|32@1+ (1,0) [0|0] "" TOOL
 SG_ S05_PID40_SupportedIDs_41_60 m64 : 24|32@1+ (1,0) [0|0] "" TOOL
 SG_ S06_PID40_SupportedIDs_41_60 m64 : 24|32@1+ (1,0) [0|0] "" TOOL
 SG_ S07_PID40_SupportedIDs_41_60 m64 : 24|32@1+ (1,0) [0|0] "" TOOL
 SG_ S08_PID40_SupportedIDs_41_60 m64 : 24|32@1+ (1,0) [0|0] "" TOOL
 SG_ S09_PID40_SupportedIDs_41_60 m64 : 24|32@1+ (1,0) [0|0] "" TOOL
 SG_ S0A_PID40_SupportedIDs_41_60 m64 : 24|32@1+ (1,0) [0|0] "" TOOL
 SG_ S01_PID60_SupportedIDs_61_80 m96 : 24|32@1+ (1,0) [0|0] "" TOOL
 SG_ S02_PID60_SupportedIDs_61_80 m96 : 24|32@1+ (1,0) [0|0] "" TOOL
 SG_ S03_PID60_SupportedIDs_61_80 m96 : 24|32@1+ (1,0) [0|0] "" TOOL
 SG_ S04_PID60_SupportedIDs_61_80 m96 : 24|32@1+ (1,0) [0|0] "" TOOL
 SG_ S05_PID60_SupportedIDs_61_80 m96 : 24|32@1+ (1,0) [0|0] "" TOOL
 SG_ S06_PID60_SupportedIDs_61_80 m96 : 24|32@1+ (1,0) [0|0] "" TOOL
 SG_ S07_PID60_SupportedIDs_61_80 m96 : 24|32@1+ (1,0) [0|0] "" TOOL
 SG_ S08_PID60_SupportedIDs_61_80 m96 : 24|32@1+ (1,0) [0|0] "" TOOL
 SG_ S09_PID60_SupportedIDs_61_80 m96 : 24|32@1+ (1,0) [0|0] "" TOOL
 SG_ S0A_PID60_SupportedIDs_61_80 m96 : 24|32@1+ (1,0) [0|0] "" TOOL
 SG_ S01_PID80_SupportedIDs_81_A0 m128 : 24|32@1+ (1,0) [0|0] "" TOOL
 SG_ S02_PID80_SupportedIDs_81_A0 m128 : 24|32@1+ (1,0) [0|0] "" TOOL
 SG_ S03_PID80_SupportedIDs_81_A0 m128 : 24|32@1+ (1,0) [0|0] "" TOOL
 SG_ S04_PID80_SupportedIDs_81_A0 m128 : 24|32@1+ (1,0) [0|0] "" TOOL
 SG_ S05_PID80_SupportedIDs_81_A0 m128 : 24|32@1+ (1,0) [0|0] "" TOOL
 SG_ S06_PID80_SupportedIDs_81_A0 m128 : 24|32@1+ (1,0) [0|0] "" TOOL
 SG_ S07_PID80_SupportedIDs_81_A0 m128 : 24|32@1+ (1,0) [0|0] "" TOOL
 SG_ S08_PID80_SupportedIDs_81_A0 m128 : 24|32@1+ (1,0) [0|0] "" TOOL
 SG_ S09_PID80_SupportedIDs_81_A0 m128 : 24|32@1+ (1,0) [0|0] "" TOOL
 SG_ S0A_PID80_SupportedIDs_81_A0 m128 : 24|32@1+ (1,0) [0|0] "" TOOL
 SG_ S01_PIDA0_SupportedIDs_A1_C0 m160 : 24|32@1+ (1,0) [0|0] "" TOOL
 SG_ S02_PIDA0_SupportedIDs_A1_C0 m160 : 24|32@1+ (1,0) [0|0] "" TOOL
 SG_ S03_PIDA0_SupportedIDs_A1_C0 m160 : 24|32@1+ (1,0) [0|0] "" TOOL
 SG_ S04_PIDA0_SupportedIDs_A1_C0 m160 : 24|32@1+ (1,0) [0|0] "" TOOL
 SG_ S05_PIDA0_SupportedIDs_A1_C0 m160 : 24|32@1+ (1,0) [0|0] "" TOOL
 SG_ S06_PIDA0_SupportedIDs_A1_C0 m160 : 24|32@1+ (1,0) [0|0] "" TOOL
 SG_ S07_PIDA0_SupportedIDs_A1_C0 m160 : 24|32@1+ (1,0) [0|0] "" TOOL
 SG_ S08_PIDA0_SupportedIDs_A1_C0 m160 : 24|32@1+ (1,0) [0|0] "" TOOL
 SG_ S09_PIDA0_SupportedIDs_A1_C0 m160 : 24|32@1+ (1,0) [0|0] "" TOOL
 SG_ S0A_PIDA0_SupportedIDs_A1_C0 m160 : 24|32@1+ (1,0) [0|0] "" TOOL
 SG_ S01_PIDC0_SupportedIDs_C1_E0 m192 : 24|32@1+ (1,0) [0|0] "" TOOL
 SG_ S02_PIDC0_SupportedIDs_C1_E0 m192 : 24|32@1+ (1,0) [0|0] "" TOOL
 SG_ S03_PIDC0_SupportedIDs_C1_E0 m192 : 24|32@1+ (1,0) [0|0] "" TOOL
 SG_ S04_PIDC0_SupportedIDs_C1_E0 m192 : 24|32@1+ (1,0) [0|0] "" TOOL
 SG_ S05_PIDC0_SupportedIDs_C1_E0 m192 : 24|32@1+ (1,0) [0|0] "" TOOL
 SG_ S06_PIDC0_SupportedIDs_C1_E0 m192 : 24|32@1+ (1,0) [0|0] "" TOOL
 SG_ S07_PIDC0_SupportedIDs_C1_E0 m192 : 24|32@1+ (1,0) [0|0] "" TOOL
 SG_ S08_PIDC0_SupportedIDs_C1_E0 m192 : 24|32@1+ (1,0) [0|0] "" TOOL
 SG_ S09_PIDC0_SupportedIDs_C1_E0 m192 : 24|32@1+ (1,0) [0|0] "" TOOL
 SG_ S0A_PIDC0_SupportedIDs_C1_E0 m192 : 24|32@1+ (1,0) [0|0] "" TOOL
 SG_ DTC_CNT m1 : 24|7@1+ (1,0) [0|0] "" TOOL
 SG_ MIL m1 : 31|1@1+ (1,0) [0|0] "" TOOL
 SG_ MIS_SUP m1 : 32|1@1+ (1,0) [0|0] "" TOOL
 SG_ FUEL_SUP m1 : 33|1@1+ (1,0) [0|0] "" TOOL
 SG_ CCM_SUP m1 : 34|1@1+ (1,0) [0|0] "" TOOL
 SG_ CIM_SUP m1M : 35|1@1+ (1,0) [0|0] "" TOOL
 SG_ MIS_RDY m1 : 36|1@1+ (1,0) [0|0] "" TOOL
 SG_ FUEL_RDY m1 : 37|1@1+ (1,0) [0|0] "" TOOL
 SG_ CCM_RDY m1 : 38|1@1+ (1,0) [0|0] "" TOOL
 SG_ CAT_SUP m0 : 40|1@1+ (1,0) [0|0] "" TOOL
 SG_ HCAT_SUP m0 : 41|1@1+ (1,0) [0|0] "" TOOL
 SG_ EVAP_SUP m0 : 42|1@1+ (1,0) [0|0] "" TOOL
 SG_ AIR_SUP m0 : 43|1@1+ (1,0) [0|0] "" TOOL
 SG_ GPF_SUP m0 : 44|1@1+ (1,0) [0|0] "" TOOL
 SG_ O2S_SUP m0 : 45|1@1+ (1,0) [0|0] "" TOOL
 SG_ HTR_SUP m0 : 46|1@1+ (1,0) [0|0] "" TOOL
 SG_ EGR_SUP m0 : 47|1@1+ (1,0) [0|0] "" TOOL
 SG_ CAT_RDY m0 : 48|1@1+ (1,0) [0|0] "" TOOL
 SG_ HCAT_RDY m0 : 49|1@1+ (1,0) [0|0] "" TOOL
 SG_ EVAP_RDY m0 : 50|1@1+ (1,0) [0|0] "" TOOL
 SG_ AIR_RDY m0 : 51|1@1+ (1,0) [0|0] "" TOOL
 SG_ GPF_RDY m0 : 52|1@1+ (1,0) [0|0] "" TOOL
 SG_ O2S_RDY m0 : 53|1@1+ (1,0) [0|0] "" TOOL
 SG_ HTR_RDY m0 : 54|1@1+ (1,0) [0|0] "" TOOL
 SG_ EGR_RDY m0 : 55|1@1+ (1,0) [0|0] "" TOOL
 SG_ HCCATSUP m1 : 56|1@1+ (1,0) [0|0] "" TOOL
 SG_ NCAT_SUP m1 : 57|1@1+ (1,0) [0|0] "" TOOL
 SG_ BP_SUP m1 : 59|1@1+ (1,0) [0|0] "" TOOL
 SG_ EGS_SUP m1 : 61|1@1+ (1,0) [0|0] "" TOOL
 SG_ PM_SUP m1 : 62|1@1+ (1,0) [0|0] "" TOOL
 SG_ HCCATRDY m1 : 64|1@1+ (1,0) [0|0] "" TOOL
 SG_ NCAT_RDY m1 : 65|1@1+ (1,0) [0|0] "" TOOL
 SG_ BP_RDY m1 : 67|1@1+ (1,0) [0|0] "" TOOL
 SG_ EGS_RDY m1 : 69|1@1+ (1,0) [0|0] "" TOOL
 SG_ PM_RDY m1 : 70|1@1+ (1,0) [0|0] "" TOOL
 SG_ DTCFRZF m2 : 31|16@0+ (1,0) [0|0] "" TOOL
 SG_ FUELSYSA_OL m3 : 24|1@1+ (1,0) [0|0] "" TOOL
 SG_ FUELSYSA_CL m3 : 25|1@1+ (1,0) [0|0] "" TOOL
 SG_ FUELSYSA_OL_Drive m3 : 26|1@1+ (1,0) [0|0] "" TOOL
 SG_ FUELSYSA_OL_Fault m3 : 27|1@1+ (1,0) [0|0] "" TOOL
 SG_ FUELSYSA_CL_Fault m3 : 28|1@1+ (1,0) [0|0] "" TOOL
 SG_ FUELSYSA_OL_B2 m3 : 29|1@1+ (1,0) [0|0] "" TOOL
 SG_ FUELSYSA_OL_Drive_B2 m3 : 30|1@1+ (1,0) [0|0] "" TOOL
 SG_ FUELSYSA_OL_Fault_B2 m3 : 31|1@1+ (1,0) [0|0] "" TOOL
 SG_ FUELSYSB_OL m3 : 32|1@1+ (1,0) [0|0] "" TOOL
 SG_ FUELSYSB_CL m3 : 33|1@1+ (1,0) [0|0] "" TOOL
 SG_ FUELSYSB_OL_Drive m3 : 34|1@1+ (1,0) [0|0] "" TOOL
 SG_ FUELSYSB_OL_Fault m3 : 35|1@1+ (1,0) [0|0] "" TOOL
 SG_ FUELSYSB_CL_Fault m3 : 36|1@1+ (1,0) [0|0] "" TOOL
 SG_ FUELSYSB_OL_B2 m3 : 37|1@1+ (1,0) [0|0] "" TOOL
 SG_ FUELSYSB_OL_Drive_B2 m3 : 38|1@1+ (1,0) [0|0] "" TOOL
 SG_ FUELSYSB_OL_Fault_B2 m3 : 39|1@1+ (1,0) [0|0] "" TOOL
 SG_ LOAD_PCT m4 : 24|8@1+ (0.3921569,0) [0|100] "%" TOOL
 SG_ ECT m5 : 24|8@1+ (1,-40) [-40|215] "°C " TOOL
 SG_ SHRTFT1 m6 : 24|8@1- (0.78125,0) [-100|99.21875] "%" TOOL
 SG_ SHRTFT3 m6 : 32|8@1- (0.78125,0) [-100|99.21875] "%" TOOL
 SG_ LONGFT1 m7 : 24|8@1- (0.78125,0) [-100|99.21875] "%" TOOL
 SG_ LONGFT3 m7 : 32|8@1- (0.78125,0) [-100|99.21875] "%" TOOL
 SG_ SHRTFT2 m8 : 24|8@1- (0.78125,0) [-100|99.21875] "%" TOOL
 SG_ SHRTFT4 m8 : 32|8@1- (0.78125,0) [-100|99.21875] "%" TOOL
 SG_ LONGFT2 m9 : 24|8@1- (0.78125,0) [-100|99.21875] "%" TOOL
 SG_ LONGFT4 m9 : 32|8@1- (0.78125,0) [-100|99.21875] "%" TOOL
 SG_ FPGAUGE m10 : 24|8@1+ (3,0) [0|0] "kPa" TOOL
 SG_ MAP m11 : 24|8@1+ (1,0) [0|0] "kPa" TOOL
 SG_ RPM m12 : 31|16@0+ (0.25,0) [0|0] "rpm" TOOL
 SG_ VSS m13 : 24|8@1+ (1,0) [0|0] "km/h" TOOL
 SG_ SPARKADV m14 : 24|8@1+ (0.5,64) [0|0] "°" TOOL
 SG_ IAT m15 : 24|8@1+ (1,-40) [0|0] "°C " TOOL
 SG_ MAF m16 : 31|16@0+ (0.01,0) [0|0] "g/s" TOOL
 SG_ TP m17 : 24|8@1+ (0.3921569,0) [0|0] "%" TOOL
 SG_ AIR_STAT_UPS m18 : 24|1@1+ (1,0) [0|0] "" TOOL
 SG_ AIR_STAT_DNS m18 : 25|1@1+ (1,0) [0|0] "" TOOL
 SG_ AIR_STAT_OFF m18 : 26|1@1+ (1,0) [0|0] "" TOOL
 SG_ AIR_STAT_DIAG m18 : 27|1@1+ (1,0) [0|0] "" TOOL
 SG_ O2SLOC_A1 m19 : 24|1@1+ (1,0) [0|0] "" TOOL
 SG_ O2SLOC_A2 m19 : 25|1@1+ (1,0) [0|0] "" TOOL
 SG_ O2SLOC_A3 m19 : 26|1@1+ (1,0) [0|0] "" TOOL
 SG_ O2SLOC_A4 m19 : 27|1@1+ (1,0) [0|0] "" TOOL
 SG_ O2SLOC_A5 m19 : 28|1@1+ (1,0) [0|0] "" TOOL
 SG_ O2SLOC_A6 m19 : 29|1@1+ (1,0) [0|0] "" TOOL
 SG_ O2SLOC_A7 m19 : 30|1@1+ (1,0) [0|0] "" TOOL
 SG_ O2SLOC_A8 m19 : 31|1@1+ (1,0) [0|0] "" TOOL
 SG_ O2S1 m20 : 24|8@1+ (0.005,0) [0|0] "V" TOOL
 SG_ SHRTFT11 m20 : 32|8@1- (0.78125,0) [0|0] "%" TOOL
 SG_ O2S2 m21 : 24|8@1+ (0.005,0) [0|0] "V" TOOL
 SG_ SHRTFT12 m21 : 32|8@1- (0.78125,0) [0|0] "%" TOOL
 SG_ O2S3 m22 : 24|8@1+ (0.005,0) [0|0] "V" TOOL
 SG_ SHRTFT13 m22 : 32|8@1- (0.78125,0) [0|0] "%" TOOL
 SG_ O2S4 m23 : 24|8@1+ (0.005,0) [0|0] "V" TOOL
 SG_ SHRTFT14 m23 : 32|8@1- (0.78125,0) [0|0] "%" TOOL
 SG_ O2S5 m24 : 24|8@1+ (0.005,0) [0|0] "V" TOOL
 SG_ SHRTFT15 m24 : 32|8@1- (0.78125,0) [0|0] "%" TOOL
 SG_ O2S6 m25 : 24|8@1+ (0.005,0) [0|0] "V" TOOL
 SG_ SHRTFT16 m25 : 32|8@1- (0.78125,0) [0|0] "%" TOOL
 SG_ O2S7 m26 : 24|8@1+ (0.005,0) [0|0] "V" TOOL
 SG_ SHRTFT17 m26 : 32|8@1- (0.78125,0) [0|0] "%" TOOL
 SG_ O2S8 m27 : 24|8@1+ (0.005,0) [0|0] "V" TOOL
 SG_ SHRTFT8 m27 : 32|8@1- (0.78125,0) [0|0] "%" TOOL
 SG_ OBDSUP m28 : 24|8@1+ (1,0) [0|0] "" TOOL
 SG_ O2SLOC_B1 m29 : 24|1@1+ (1,0) [0|0] "" TOOL
 SG_ O2SLOC_B2 m29 : 25|1@1+ (1,0) [0|0] "" TOOL
 SG_ O2SLOC_B3 m29 : 26|1@1+ (1,0) [0|0] "" TOOL
 SG_ O2SLOC_B4 m29 : 27|1@1+ (1,0) [0|0] "" TOOL
 SG_ O2SLOC_B5 m29 : 28|1@1+ (1,0) [0|0] "" TOOL
 SG_ O2SLOC_B6 m29 : 29|1@1+ (1,0) [0|0] "" TOOL
 SG_ O2SLOC_B7 m29 : 30|1@1+ (1,0) [0|0] "" TOOL
 SG_ O2SLOC_B8 m29 : 31|1@1+ (1,0) [0|0] "" TOOL
 SG_ PTO_STAT m30 : 24|1@1+ (1,0) [0|0] "" TOOL
 SG_ RUNTM m31 : 31|16@0+ (1,0) [0|0] "sec" TOOL
 SG_ MIL_DIST m33 : 31|16@0+ (1,0) [0|0] "km" TOOL
 SG_ FP m34 : 31|16@0+ (0.079,0) [0|0] "kPa" TOOL
 SG_ FRP m35 : 31|16@0+ (10,0) [0|0] "kPa" TOOL
 SG_ LAMBDA_WRV1 m36 : 31|16@0+ (0.0000305,0) [0|0] "" TOOL
 SG_ O2S_WRV1 m36 : 47|16@0+ (0.000122,0) [0|0] "V" TOOL
 SG_ LAMBDA_WRV2 m37 : 31|16@0+ (0.0000305,0) [0|0] "" TOOL
 SG_ O2S_WRV2 m37 : 47|16@0+ (0.000122,0) [0|0] "V" TOOL
 SG_ LAMBDA_WRV3 m38 : 31|16@0+ (0.0000305,0) [0|0] "" TOOL
 SG_ O2S_WRV3 m38 : 47|16@0+ (0.000122,0) [0|0] "V" TOOL
 SG_ LAMBDA_WRV4 m39 : 31|16@0+ (0.0000305,0) [0|0] "" TOOL
 SG_ O2S_WRV4 m39 : 47|16@0+ (0.000122,0) [0|0] "V" TOOL
 SG_ LAMBDA_WRV5 m40 : 31|16@0+ (0.0000305,0) [0|0] "" TOOL
 SG_ O2S_WRV5 m40 : 47|16@0+ (0.000122,0) [0|0] "V" TOOL
 SG_ LAMBDA_WRV6 m41 : 31|16@0+ (0.0000305,0) [0|0] "" TOOL
 SG_ O2S_WRV6 m41 : 47|16@0+ (0.000122,0) [0|0] "V" TOOL
 SG_ LAMBDA_WRV7 m42 : 31|16@0+ (0.0000305,0) [0|0] "" TOOL
 SG_ O2S_WRV7 m42 : 47|16@0+ (0.000122,0) [0|0] "V" TOOL
 SG_ LAMBDA_WRV8 m43 : 31|16@0+ (0.0000305,0) [0|0] "" TOOL
 SG_ O2S_WRV8 m43 : 47|16@0+ (0.000122,0) [0|0] "V" TOOL
 SG_ EGR_PCT m44 : 24|8@1+ (0.392156862745098,0) [0|0] "%" TOOL
 SG_ EGR_ERR m45 : 24|8@1- (0.78125,0) [0|0] "%" TOOL
 SG_ EVAP_PCT m46 : 24|8@1+ (0.392156862745098,0) [0|0] "%" TOOL
 SG_ FLI m47 : 24|8@1+ (0.392156862745098,0) [0|0] "%" TOOL
 SG_ WARM_UPS m48 : 24|8@1+ (1,0) [0|0] "" TOOL
 SG_ CLR_DIST m49 : 31|16@0+ (1,0) [0|0] "" TOOL
 SG_ EVAP_VP m50 : 31|16@0- (0.25,0) [0|0] "Pa" TOOL
 SG_ BARO m51 : 24|8@1+ (1,0) [0|0] "kPa" TOOL
 SG_ LAMBDA_WRC1 m52 : 31|16@0+ (0.0000305,0) [0|0] "" TOOL
 SG_ O2S_WRC1 m52 : 47|16@0+ (0.00390625,0) [0|0] "mA" TOOL
 SG_ LAMBDA_WRC2 m53 : 31|16@0+ (0.0000305,0) [0|0] "" TOOL
 SG_ O2S_WRC2 m53 : 47|16@0+ (0.00390625,0) [0|0] "mA" TOOL
 SG_ LAMBDA_WRC3 m54 : 31|16@0+ (0.0000305,0) [0|0] "" TOOL
 SG_ O2S_WRC3 m54 : 47|16@0+ (0.00390625,0) [0|0] "mA" TOOL
 SG_ LAMBDA_WRC4 m55 : 31|16@0+ (0.0000305,0) [0|0] "" TOOL
 SG_ O2S_WRC4 m55 : 47|16@0+ (0.00390625,0) [0|0] "mA" TOOL
 SG_ LAMBDA_WRC5 m56 : 31|16@0+ (0.0000305,0) [0|0] "" TOOL
 SG_ O2S_WRC5 m56 : 47|16@0+ (0.00390625,0) [0|0] "mA" TOOL
 SG_ LAMBDA_WRC6 m57 : 31|16@0+ (0.0000305,0) [0|0] "" TOOL
 SG_ O2S_WRC6 m57 : 47|16@0+ (0.00390625,0) [0|0] "mA" TOOL
 SG_ LAMBDA_WRC7 m58 : 31|16@0+ (0.0000305,0) [0|0] "" TOOL
 SG_ O2S_WRC7 m58 : 47|16@0+ (0.00390625,0) [0|0] "mA" TOOL
 SG_ LAMBDA_WRC8 m59 : 31|16@0+ (0.0000305,0) [0|0] "" TOOL
 SG_ O2S_WRC8 m59 : 47|16@0+ (0.00390625,0) [0|0] "mA" TOOL
 SG_ CATEMP11 m60 : 31|16@0+ (0.1,-40) [0|0] "" TOOL
 SG_ CATEMP21 m61 : 31|16@0+ (0.1,-40) [0|0] "" TOOL
 SG_ CATEMP12 m62 : 31|16@0+ (0.1,-40) [0|0] "" TOOL
 SG_ CATEMP22 m63 : 31|16@0+ (0.1,-40) [0|0] "" TOOL
 SG_ MIS_ENA m65 : 32|1@1+ (1,0) [0|0] "" TOOL
 SG_ FUEL_ENA m65 : 33|1@1+ (1,0) [0|0] "" TOOL
 SG_ CCM_ENA m65 : 34|1@1+ (1,0) [0|0] "" TOOL
 SG_ PID41_CIM_SUP m65M : 35|1@1+ (1,0) [0|0] "" TOOL
 SG_ MIS_CMPL m65 : 36|1@1+ (1,0) [0|0] "" TOOL
 SG_ FUELCMPL m65 : 37|1@1+ (1,0) [0|0] "" TOOL
 SG_ CCM_CMPL m65 : 38|1@1+ (1,0) [0|0] "" TOOL
 SG_ CAT_ENA m0 : 40|1@1+ (1,0) [0|0] "" TOOL
 SG_ HCAT_ENA m0 : 41|1@1+ (1,0) [0|0] "" TOOL
 SG_ EVAP_ENA m0 : 42|1@1+ (1,0) [0|0] "" TOOL
 SG_ AIR_ENA m0 : 43|1@1+ (1,0) [0|0] "" TOOL
 SG_ GPF_ENA m0 : 44|1@1+ (1,0) [0|0] "" TOOL
 SG_ O2S_ENA m0 : 45|1@1+ (1,0) [0|0] "" TOOL
 SG_ HTR_ENA m0 : 46|1@1+ (1,0) [0|0] "" TOOL
 SG_ EGR_ENA m0 : 47|1@1+ (1,0) [0|0] "" TOOL
 SG_ CAT_CMPL m0 : 48|1@1+ (1,0) [0|0] "" TOOL
 SG_ HCATCMPL m0 : 49|1@1+ (1,0) [0|0] "" TOOL
 SG_ EVAPCMPL m0 : 50|1@1+ (1,0) [0|0] "" TOOL
 SG_ AIR_CMPL m0 : 51|1@1+ (1,0) [0|0] "" TOOL
 SG_ GPF_CMPL m0 : 52|1@1+ (1,0) [0|0] "" TOOL
 SG_ O2S_CMPL m0 : 53|1@1+ (1,0) [0|0] "" TOOL
 SG_ HTR_CMPL m0 : 54|1@1+ (1,0) [0|0] "" TOOL
 SG_ EGR_CMPL m0 : 55|1@1+ (1,0) [0|0] "" TOOL
 SG_ HCCATENA m1 : 40|1@1+ (1,0) [0|0] "" TOOL
 SG_ NCAT_ENA m1 : 41|1@1+ (1,0) [0|0] "" TOOL
 SG_ BP_ENA m1 : 43|1@1+ (1,0) [0|0] "" TOOL
 SG_ EGS_ENA m1 : 45|1@1+ (1,0) [0|0] "" TOOL
 SG_ PM_ENA m1 : 46|1@1+ (1,0) [0|0] "" TOOL
 SG_ HCCATCMP m1 : 48|1@1+ (1,0) [0|0] "" TOOL
 SG_ NCATCMPL m1 : 49|1@1+ (1,0) [0|0] "" TOOL
 SG_ BP_CMPL m1 : 51|1@1+ (1,0) [0|0] "" TOOL
 SG_ EGS_CMPL m1 : 53|1@1+ (1,0) [0|0] "" TOOL
 SG_ PM_CMPL m1 : 54|1@1+ (1,0) [0|0] "" TOOL
 SG_ VPWR m66 : 31|16@0+ (0.001,0) [0|0] "V" TOOL
 SG_ LOAD_ABS m67 : 31|16@0+ (0.392156862745098,0) [0|0] "%" TOOL
 SG_ EQ_RAT m68 : 31|16@0+ (0.0000305,0) [0|0] "" TOOL
 SG_ TP_R m69 : 24|8@1+ (0.392156862745098,0) [0|0] "%" TOOL
 SG_ AAT m70 : 24|8@1+ (1,-40) [0|0] "°C " TOOL
 SG_ TP_B m71 : 24|8@1+ (0.392156862745098,0) [0|0] "%" TOOL
 SG_ TP_C m72 : 24|8@1+ (0.392156862745098,0) [0|0] "%" TOOL
 SG_ APP_D m73 : 24|8@1+ (0.392156862745098,0) [0|0] "%" TOOL
 SG_ APP_E m74 : 24|8@1+ (0.392156862745098,0) [0|0] "%" TOOL
 SG_ APP_F m75 : 24|8@1+ (0.392156862745098,0) [0|0] "%" TOOL
 SG_ TAC_PCT m76 : 24|8@1+ (0.392156862745098,0) [0|0] "%" TOOL
 SG_ MIL_TIME m77 : 31|16@0+ (1,0) [0|0] "min" TOOL
 SG_ CLR_TIME m78 : 31|16@0+ (1,0) [0|0] "min" TOOL
 SG_ ER_MAX m79 : 24|8@1+ (1,0) [0|0] "" TOOL
 SG_ O2SV_MAX m79 : 32|8@1+ (1,0) [0|0] "V" TOOL
 SG_ O2SC_MAX m79 : 40|8@1+ (1,0) [0|0] "mA" TOOL
 SG_ IMAP_MAX m79 : 48|8@1+ (10,0) [0|0] "kPa" TOOL
 SG_ AFR_MAX m80 : 24|8@1+ (10,0) [0|0] "g/s" TOOL
 SG_ FUEL_TYP m81 : 24|8@1+ (1,0) [0|0] "" TOOL
 SG_ ALCH_PCT m82 : 24|8@1+ (0.392156862745098,0) [0|0] "%" TOOL
 SG_ EVAP_VPA m83 : 31|16@0+ (0.005,0) [0|0] "kPa" TOOL
 SG_ EVAP_VP2 m84 : 31|16@0- (1,0) [0|0] "Pa" TOOL
 SG_ STSO2FT1 m85 : 24|8@1- (0.78125,0) [0|0] "%" TOOL
 SG_ STSO2FT3 m85 : 32|8@1- (0.78125,0) [0|0] "%" TOOL
 SG_ LGSO2FT1 m86 : 24|8@1- (0.78125,0) [0|0] "%" TOOL
 SG_ LGSO2FT3 m86 : 32|8@1- (0.78125,0) [0|0] "%" TOOL
 SG_ STSO2FT2 m87 : 24|8@1- (0.78125,0) [0|0] "%" TOOL
 SG_ STSO2FT4 m87 : 32|8@1- (0.78125,0) [0|0] "%" TOOL
 SG_ LGSO2FT2 m88 : 24|8@1- (0.78125,0) [0|0] "%" TOOL
 SG_ LGSO2FT4 m88 : 32|8@1- (0.78125,0) [0|0] "%" TOOL
 SG_ FRP2 m89 : 31|16@0+ (10,0) [0|0] "kPa" TOOL
 SG_ APP_R m90 : 24|8@1+ (0.392156862745098,0) [0|0] "%" TOOL
 SG_ BAT_PWR m91 : 24|8@1+ (0.392156862745098,0) [0|0] "%" TOOL
 SG_ EOT m92 : 24|8@1+ (1,-40) [0|0] "°C " TOOL
 SG_ FUEL_TIMING m93 : 31|16@0+ (0.0078125,-210) [0|0] "°" TOOL
 SG_ FUEL_RATE m94 : 31|16@0+ (0.05,0) [0|0] "L/h" TOOL
 SG_ EMIS_SUP m95 : 24|8@1+ (1,-125) [0|0] "%" TOOL
 SG_ TQ_DD m97 : 24|8@1+ (1,-125) [0|0] "%" TOOL
 SG_ TQ_ACT m98 : 24|8@1+ (1,-125) [0|0] "%" TOOL
 SG_ TQ_REF m99 : 31|16@0+ (1,0) [0|0] "Nm" TOOL
 SG_ TQ_MAX1 m100 : 24|8@1+ (1,-125) [0|0] "%" TOOL
 SG_ TQ_MAX2 m100 : 32|8@1+ (1,-125) [0|0] "%" TOOL
 SG_ TQ_MAX3 m100 : 40|8@1+ (1,-125) [0|0] "%" TOOL
 SG_ TQ_MAX4 m100 : 48|8@1+ (1,-125) [0|0] "%" TOOL
 SG_ TQ_MAX5 m100 : 56|8@1+ (1,-125) [0|0] "%" TOOL
 SG_ PTO_STAT_SUP m101 : 24|1@1+ (1,0) [0|0] "" TOOL
 SG_ ND_STAT_SUP m101 : 25|1@1+ (1,0) [0|0] "" TOOL
 SG_ NG_STAT_SUP m101 : 26|1@1+ (1,0) [0|0] "" TOOL
 SG_ GPL_STAT_SUP m101 : 27|1@1+ (1,0) [0|0] "" TOOL
 SG_ GEAR_RCMD_SUP m101 : 28|1@1+ (1,0) [0|0] "" TOOL
 SG_ PTO_STAT2 m101 : 32|1@1+ (1,0) [0|0] "" TOOL
 SG_ ND_STAT m101 : 33|1@1+ (1,0) [0|0] "" TOOL
 SG_ NG_STAT m101 : 34|1@1+ (1,0) [0|0] "" TOOL
 SG_ GPL_STAT m101 : 35|1@1+ (1,0) [0|0] "" TOOL
 SG_ GEAR_RCMD m101 : 36|4@1+ (1,0) [0|0] "" TOOL
 SG_ MAFA_SUP m102 : 24|1@1+ (1,0) [0|0] "" TOOL
 SG_ MAFB_SUP m102 : 25|1@1+ (1,0) [0|0] "" TOOL
 SG_ MAFA m102 : 39|16@0+ (0.03125,0) [0|0] "g/s" TOOL
 SG_ MAFB m102 : 55|16@0+ (0.03125,0) [0|0] "g/s" TOOL
 SG_ ECT1_SUP m103 : 24|1@1+ (1,0) [0|0] "" TOOL
 SG_ ECT2_SUP m103 : 25|1@1+ (1,0) [0|0] "" TOOL
 SG_ ECT1 m103 : 32|8@1+ (1,-40) [0|0] "°C " TOOL
 SG_ ECT2 m103 : 40|8@1+ (1,-40) [0|0] "°C " TOOL
 SG_ IAT11_SUP m104 : 24|1@1+ (1,0) [0|0] "" TOOL
 SG_ IAT12_SUP m104 : 25|1@1+ (1,0) [0|0] "" TOOL
 SG_ IAT13_SUP m104 : 26|1@1+ (1,0) [0|0] "" TOOL
 SG_ IAT21_SUP m104 : 27|1@1+ (1,0) [0|0] "" TOOL
 SG_ IAT22_SUP m104 : 28|1@1+ (1,0) [0|0] "" TOOL
 SG_ IAT23_SUP m104 : 29|1@1+ (1,0) [0|0] "" TOOL
 SG_ IAT11 m104 : 32|8@1+ (1,-40) [0|0] "°C " TOOL
 SG_ IAT12 m104 : 40|8@1+ (1,-40) [0|0] "°C " TOOL
 SG_ IAT13 m104 : 48|8@1+ (1,-40) [0|0] "°C " TOOL
 SG_ IAT21 m104 : 56|8@1+ (1,-40) [0|0] "°C " TOOL
 SG_ IAT22 m104 : 64|8@1+ (1,-40) [0|0] "°C " TOOL
 SG_ IAT23 m104 : 72|8@1+ (1,-40) [0|0] "°C " TOOL
 SG_ EGR_A_CMD_SUP m105 : 24|1@1+ (1,0) [0|0] "" TOOL
 SG_ EGR_A_ACT_SUP m105 : 25|1@1+ (1,0) [0|0] "" TOOL
 SG_ EGR_A_ERR_SUP m105 : 26|1@1+ (1,0) [0|0] "" TOOL
 SG_ EGR_B_CMD_SUP m105 : 27|1@1+ (1,0) [0|0] "" TOOL
 SG_ EGR_B_ACT_SUP m105 : 28|1@1+ (1,0) [0|0] "" TOOL
 SG_ EGR_B_ERR_SUP m105 : 29|1@1+ (1,0) [0|0] "" TOOL
 SG_ EGR_A_CMD m105 : 32|8@1- (0.78125,0) [0|0] "%" TOOL
 SG_ EGR_A_ACT m105 : 40|8@1- (0.78125,0) [0|0] "%" TOOL
 SG_ EGR_A_ERR m105 : 48|8@1- (0.78125,0) [0|0] "%" TOOL
 SG_ EGR_B_CMD m105 : 56|8@1- (0.78125,0) [0|0] "%" TOOL
 SG_ EGR_B_ACT m105 : 64|8@1- (0.78125,0) [0|0] "%" TOOL
 SG_ EGR_B_ERR m105 : 72|8@1- (0.78125,0) [0|0] "%" TOOL
 SG_ IAF_A_CMD_SUP m106 : 24|1@1+ (1,0) [0|0] "" TOOL
 SG_ IAF_A_REL_SUP m106 : 25|1@1+ (1,0) [0|0] "" TOOL
 SG_ IAF_B_CMD_SUP m106 : 26|1@1+ (1,0) [0|0] "" TOOL
 SG_ IAF_B_REL_SUP m106 : 27|1@1+ (1,0) [0|0] "" TOOL
 SG_ IAF_A_CMD m106 : 32|8@1+ (0.392156862745098,0) [0|0] "%" TOOL
 SG_ IAF_A_REL m106 : 40|8@1+ (0.392156862745098,0) [0|0] "%" TOOL
 SG_ IAF_B_CMD m106 : 48|8@1+ (0.392156862745098,0) [0|0] "%" TOOL
 SG_ IAF_B_REL m106 : 56|8@1+ (0.392156862745098,0) [0|0] "%" TOOL
 SG_ EGRTA_SUP m107M : 24|1@1+ (1,0) [0|0] "" TOOL
 SG_ EGRTC_SUP m107M : 25|1@1+ (1,0) [0|0] "" TOOL
 SG_ EGRTB_SUP m107M : 26|1@1+ (1,0) [0|0] "" TOOL
 SG_ EGRTD_SUP m107M : 27|1@1+ (1,0) [0|0] "" TOOL
 SG_ EGRTA_WR_SUP m107M : 28|1@1+ (1,0) [0|0] "" TOOL
 SG_ EGRTC_WR_SUP m107M : 29|1@1+ (1,0) [0|0] "" TOOL
 SG_ EGRTB_WR_SUP m107M : 30|1@1+ (1,0) [0|0] "" TOOL
 SG_ EGRTD_WR_SUP m107M : 31|1@1+ (1,0) [0|0] "" TOOL
 SG_ EGRTA m1 : 32|8@1+ (1,-40) [0|0] "°C " TOOL
 SG_ EGRTC m1 : 40|8@1+ (1,-40) [0|0] "°C " TOOL
 SG_ EGRTB m1 : 48|8@1+ (1,-40) [0|0] "°C " TOOL
 SG_ EGRTD m1 : 56|8@1+ (1,-40) [0|0] "°C " TOOL
 SG_ EGRTA_WR m0 : 32|8@1+ (4,-40) [0|0] "°C " TOOL
 SG_ EGRTC_WR m0 : 40|8@1+ (4,-40) [0|0] "°C " TOOL
 SG_ EGRTB_WR m0 : 48|8@1+ (4,-40) [0|0] "°C " TOOL
 SG_ EGRTD_WR m0 : 56|8@1+ (4,-40) [0|0] "°C " TOOL
 SG_ TAC_A_CMD_SUP m108 : 24|1@1+ (1,0) [0|0] "" TOOL
 SG_ TP_A_REL_SUP m108 : 25|1@1+ (1,0) [0|0] "" TOOL
 SG_ TAC_B_CMD_SUP m108 : 26|1@1+ (1,0) [0|0] "" TOOL
 SG_ TP_B_REL_SUP m108 : 27|1@1+ (1,0) [0|0] "" TOOL
 SG_ TAC_A_CMD m108 : 32|8@1+ (0.392156862745098,0) [0|0] "%" TOOL
 SG_ TP_A_REL m108 : 40|8@1+ (0.392156862745098,0) [0|0] "%" TOOL
 SG_ TAC_B_CMD m108 : 48|8@1+ (0.392156862745098,0) [0|0] "%" TOOL
 SG_ TP_B_REL m108 : 56|8@1+ (0.392156862745098,0) [0|0] "%" TOOL
 SG_ FRP_A_CMD_SUP m109 : 24|1@1+ (1,0) [0|0] "" TOOL
 SG_ FRP_A_SUP m109 : 25|1@1+ (1,0) [0|0] "" TOOL
 SG_ FRT_A_SUP m109 : 26|1@1+ (1,0) [0|0] "" TOOL
 SG_ FRP_B_CMD_SUP m109 : 27|1@1+ (1,0) [0|0] "" TOOL
 SG_ FRP_B_SUP m109 : 28|1@1+ (1,0) [0|0] "" TOOL
 SG_ FRT_B_SUP m109 : 29|1@1+ (1,0) [0|0] "" TOOL
 SG_ FRP_A_CMD m109 : 39|16@0+ (10,0) [0|0] "kPa" TOOL
 SG_ FRP_A m109 : 55|16@0+ (10,0) [0|0] "kPa" TOOL
 SG_ FRT_A  m109 : 64|8@1+ (1,-40) [0|0] "°C " TOOL
 SG_ FRP_B_CMD m109 : 79|16@0+ (10,0) [0|0] "kPa" TOOL
 SG_ FRP_B m109 : 95|16@0+ (10,0) [0|0] "kPa" TOOL
 SG_ FRT_B m109 : 104|8@1+ (1,-40) [0|0] "°C " TOOL
 SG_ ICP_A_CMD_SUP m110 : 24|1@1+ (1,0) [0|0] "" TOOL
 SG_ ICP_A_SUP m110 : 25|1@1+ (1,0) [0|0] "" TOOL
 SG_ ICP_B_CMD_SUP m110 : 26|1@1+ (1,0) [0|0] "" TOOL
 SG_ ICP_B_SUP m110 : 27|1@1+ (1,0) [0|0] "" TOOL
 SG_ ICP_A_CMD m110 : 39|16@0+ (10,0) [0|0] "kPa" TOOL
 SG_ ICP_A m110 : 55|16@0+ (10,0) [0|0] "kPa" TOOL
 SG_ ICP_B_CMD m110 : 71|16@0+ (10,0) [0|0] "kPa" TOOL
 SG_ ICP_B m110 : 87|16@0+ (10,0) [0|0] "kPa" TOOL
 SG_ TCA_CINP_SUP m111M : 24|1@1+ (1,0) [0|0] "" TOOL
 SG_ TCB_CINP_SUP m111M : 25|1@1+ (1,0) [0|0] "" TOOL
 SG_ TCA_CINP_WR_SUP m111M : 26|1@1+ (1,0) [0|0] "" TOOL
 SG_ TCB_CINP_WR_SUP m111M : 27|1@1+ (1,0) [0|0] "" TOOL
 SG_ TCA_CINP m1 : 32|8@1+ (1,0) [0|0] "kPa" TOOL
 SG_ TCB_CINP m1 : 40|8@1+ (1,0) [0|0] "kPa" TOOL
 SG_ TCA_CINP_WR m0 : 32|8@1+ (8,0) [0|0] "kPa" TOOL
 SG_ TCB_CINP_WR m0 : 40|8@1+ (8,0) [0|0] "kPa" TOOL
 SG_ BP_A_CMD_SUP m112 : 24|1@1+ (1,0) [0|0] "" TOOL
 SG_ BP_A_ACT_SUP m112 : 25|1@1+ (1,0) [0|0] "" TOOL
 SG_ BP_A_SUP m112 : 26|1@1+ (1,0) [0|0] "" TOOL
 SG_ BP_B_CMD_SUP m112 : 27|1@1+ (1,0) [0|0] "" TOOL
 SG_ BP_B_ACT_SUP m112 : 28|1@1+ (1,0) [0|0] "" TOOL
 SG_ BP_B_SUP m112 : 29|1@1+ (1,0) [0|0] "" TOOL
 SG_ BP_A_CMD m112 : 39|16@0+ (0.03125,0) [0|0] "kPa" TOOL
 SG_ BP_A_ACT m112 : 55|16@0+ (0.03125,0) [0|0] "kPa" TOOL
 SG_ BP_B_CMD m112 : 71|16@0+ (0.03125,0) [0|0] "kPa" TOOL
 SG_ BP_B_ACT m112 : 87|16@0+ (0.03125,0) [0|0] "kPa" TOOL
 SG_ BP_A m112 : 96|2@1+ (1,0) [0|0] "" TOOL
 SG_ BP_B m112 : 98|2@1+ (1,0) [0|0] "" TOOL
 SG_ VGT_A_CMD_SUP m113 : 24|1@1+ (1,0) [0|0] "" TOOL
 SG_ VGT_A_ACT_SUP m113 : 25|1@1+ (1,0) [0|0] "" TOOL
 SG_ VGT_A_SUP m113 : 26|1@1+ (1,0) [0|0] "" TOOL
 SG_ VGT_B_CMD_SUP m113 : 27|1@1+ (1,0) [0|0] "" TOOL
 SG_ VGT_B_ACT_SUP m113 : 28|1@1+ (1,0) [0|0] "" TOOL
 SG_ VGT_B_SUP m113 : 29|1@1+ (1,0) [0|0] "" TOOL
 SG_ VGT_A_CMD m113 : 32|8@1+ (0.392156862745098,0) [0|0] "%" TOOL
 SG_ VGT_A_ACT m113 : 40|8@1+ (0.392156862745098,0) [0|0] "%" TOOL
 SG_ VGT_B_CMD m113 : 48|8@1+ (0.392156862745098,0) [0|0] "%" TOOL
 SG_ VGT_B_ACT m113 : 56|8@1+ (0.392156862745098,0) [0|0] "%" TOOL
 SG_ VGT_A m113 : 64|2@1+ (1,0) [0|0] "" TOOL
 SG_ VGT_B m113 : 66|2@1+ (1,0) [0|0] "" TOOL
 SG_ WG_A_CMD_SUP m114 : 24|1@1+ (1,0) [0|0] "" TOOL
 SG_ WG_A_ACT_SUP m114 : 25|1@1+ (1,0) [0|0] "" TOOL
 SG_ WG_B_CMD_SUP m114 : 26|1@1+ (1,0) [0|0] "" TOOL
 SG_ WG_B_ACT_SUP m114 : 27|1@1+ (1,0) [0|0] "" TOOL
 SG_ WG_A_CMD m114 : 32|8@1+ (0.392156862745098,0) [0|0] "%" TOOL
 SG_ WG_A_ACT m114 : 40|8@1+ (0.392156862745098,0) [0|0] "%" TOOL
 SG_ WG_B_CMD m114 : 48|8@1+ (0.392156862745098,0) [0|0] "%" TOOL
 SG_ WG_B_ACT m114 : 56|8@1+ (0.392156862745098,0) [0|0] "%" TOOL
 SG_ EP_11_SUP m115 : 24|1@1+ (1,0) [0|0] "" TOOL
 SG_ EP_21_SUP m115 : 25|1@1+ (1,0) [0|0] "" TOOL
 SG_ EP_11 m115 : 39|16@0+ (0.01,0) [0|0] "kPa" TOOL
 SG_ EP_21 m115 : 55|16@0+ (0.01,0) [0|0] "kPa" TOOL
 SG_ TCA_RPM_SUP m116 : 24|1@1+ (1,0) [0|0] "" TOOL
 SG_ TCB_RPM_SUP m116 : 25|1@1+ (1,0) [0|0] "" TOOL
 SG_ TCA_RPM m116 : 39|16@0+ (10,0) [0|0] "rpm" TOOL
 SG_ TCB_RPM m116 : 55|16@0+ (10,0) [0|0] "rpm" TOOL
 SG_ TCA_CINT_SUP m117 : 24|1@1+ (1,0) [0|0] "" TOOL
 SG_ TCA_COUTT_SUP m117 : 25|1@1+ (1,0) [0|0] "" TOOL
 SG_ TCA_TINT_SUP m117 : 26|1@1+ (1,0) [0|0] "" TOOL
 SG_ TCA_TOUTT_SUP m117 : 27|1@1+ (1,0) [0|0] "" TOOL
 SG_ TCA_CINT m117 : 32|8@1+ (1,-40) [0|0] "°C " TOOL
 SG_ TCA_COUTT m117 : 40|8@1+ (1,-40) [0|0] "°C " TOOL
 SG_ TCA_TINT m117 : 55|16@0+ (0.1,-40) [0|0] "°C " TOOL
 SG_ TCA_TOUTT m117 : 71|16@0+ (0.1,-40) [0|0] "°C " TOOL
 SG_ CACT_11_SUP m119 : 24|1@1+ (1,0) [0|0] "" TOOL
 SG_ CACT_12_SUP m119 : 25|1@1+ (1,0) [0|0] "" TOOL
 SG_ CACT_21_SUP m119 : 26|1@1+ (1,0) [0|0] "" TOOL
 SG_ CACT_22_SUP m119 : 27|1@1+ (1,0) [0|0] "" TOOL
 SG_ CACT_11 m119 : 32|8@1+ (1,0) [0|0] "" TOOL
 SG_ CACT_12 m119 : 40|8@1+ (1,0) [0|0] "" TOOL
 SG_ CACT_21 m119 : 48|8@1+ (1,0) [0|0] "" TOOL
 SG_ CACT_22 m119 : 56|8@1+ (1,0) [0|0] "" TOOL
 SG_ EGT11_SUP m120 : 24|1@1+ (1,0) [0|0] "" TOOL
 SG_ EGT12_SUP m120 : 25|1@1+ (1,0) [0|0] "" TOOL
 SG_ EGT13_SUP m120 : 26|1@1+ (1,0) [0|0] "" TOOL
 SG_ EGT14_SUP m120 : 27|1@1+ (1,0) [0|0] "" TOOL
 SG_ EGT11 m120 : 39|16@0+ (0.1,-40) [0|0] "°C " TOOL
 SG_ EGT12 m120 : 55|16@0+ (0.1,-40) [0|0] "°C " TOOL
 SG_ EGT13 m120 : 71|16@0+ (0.1,-40) [0|0] "°C " TOOL
 SG_ EGT14 m120 : 87|16@0+ (0.1,-40) [0|0] "°C " TOOL
 SG_ EGT21_SUP m121 : 24|1@1+ (1,0) [0|0] "" TOOL
 SG_ EGT22_SUP m121 : 25|1@1+ (1,0) [0|0] "" TOOL
 SG_ EGT23_SUP m121 : 26|1@1+ (1,0) [0|0] "" TOOL
 SG_ EGT24_SUP m121 : 27|1@1+ (1,0) [0|0] "" TOOL
 SG_ EGT21 m121 : 39|16@0+ (0.1,-40) [0|0] "°C " TOOL
 SG_ EGT22 m121 : 55|16@0+ (0.1,-40) [0|0] "°C " TOOL
 SG_ EGT23 m121 : 71|16@0+ (0.1,-40) [0|0] "°C " TOOL
 SG_ EGT24 m121 : 87|16@0+ (0.1,-40) [0|0] "°C " TOOL
 SG_ PF1_DP_SUP m122 : 24|1@1+ (1,0) [0|0] "" TOOL
 SG_ PF1_INP_SUP m122 : 25|1@1+ (1,0) [0|0] "" TOOL
 SG_ PF1_OUTP_SUP m122 : 26|1@1+ (1,0) [0|0] "" TOOL
 SG_ PF1_DP m122 : 39|16@0- (0.01,0) [0|0] "kPa" TOOL
 SG_ PF1_INP m122 : 55|16@0+ (0.01,0) [0|0] "kPa" TOOL
 SG_ PF1_OUTP m122 : 71|16@0+ (0.01,0) [0|0] "kPa" TOOL
 SG_ PF2_DP_SUP m123 : 24|1@1+ (1,0) [0|0] "" TOOL
 SG_ PF2_INP_SUP m123 : 25|1@1+ (1,0) [0|0] "" TOOL
 SG_ PF2_OUTP_SUP m123 : 26|1@1+ (1,0) [0|0] "" TOOL
 SG_ PF2_DP m123 : 39|16@0- (0.01,0) [0|0] "kPa" TOOL
 SG_ PF2_INP m123 : 55|16@0+ (0.01,0) [0|0] "kPa" TOOL
 SG_ PF2_OUTP m123 : 71|16@0+ (0.01,0) [0|0] "kPa" TOOL
 SG_ PF1_INT_SUP m124 : 24|1@1+ (1,0) [0|0] "" TOOL
 SG_ PF1_OUTT_SUP m124 : 25|1@1+ (1,0) [0|0] "" TOOL
 SG_ PF2_INT_SUP m124 : 26|1@1+ (1,0) [0|0] "" TOOL
 SG_ PF2_OUTT_SUP m124 : 27|1@1+ (1,0) [0|0] "" TOOL
 SG_ PF1_INT m124 : 39|16@0+ (0.1,-40) [0|0] "°C " TOOL
 SG_ PF1_OUTT m124 : 55|16@0+ (0.1,-40) [0|0] "°C " TOOL
 SG_ PF2_INT m124 : 71|16@0+ (0.1,-40) [0|0] "°C " TOOL
 SG_ PF2_OUTT m124 : 87|16@0+ (0.1,-40) [0|0] "°C " TOOL
 SG_ NNTE_IN m125 : 24|1@1+ (1,0) [0|0] "" TOOL
 SG_ NNTE_OUT m125 : 25|1@1+ (1,0) [0|0] "" TOOL
 SG_ NNTE_CAA m125 : 26|1@1+ (1,0) [0|0] "" TOOL
 SG_ NNTE_DEF m125 : 27|1@1+ (1,0) [0|0] "" TOOL
 SG_ PNTE_IN m126 : 24|1@1+ (1,0) [0|0] "" TOOL
 SG_ PNTE_OUT m126 : 25|1@1+ (1,0) [0|0] "" TOOL
 SG_ PNTE_CAA m126 : 26|1@1+ (1,0) [0|0] "" TOOL
 SG_ PNTE_DEF m126 : 27|1@1+ (1,0) [0|0] "" TOOL
 SG_ RUN_TIME_SUP m127 : 24|1@1+ (1,0) [0|0] "" TOOL
 SG_ IDLE_TIME_SUP m127 : 25|1@1+ (1,0) [0|0] "" TOOL
 SG_ PTO_TIME_SUP m127 : 26|1@1+ (1,0) [0|0] "" TOOL
 SG_ RUN_TIME m127 : 39|32@0+ (1,0) [0|0] "sec" TOOL
 SG_ IDLE_TIME m127 : 71|32@0+ (1,0) [0|0] "sec" TOOL
 SG_ PTO_TIME m127 : 103|32@0+ (1,0) [0|0] "sec" TOOL
 SG_ AECD1_TIME_SUP m129 : 24|1@1+ (1,0) [0|0] "" TOOL
 SG_ AECD2_TIME_SUP m129 : 25|1@1+ (1,0) [0|0] "" TOOL
 SG_ AECD3_TIME_SUP m129 : 26|1@1+ (1,0) [0|0] "" TOOL
 SG_ AECD4_TIME_SUP m129 : 27|1@1+ (1,0) [0|0] "" TOOL
 SG_ AECD5_TIME_SUP m129 : 28|1@1+ (1,0) [0|0] "" TOOL
 SG_ AECD1_TIME1 m129 : 39|32@0+ (1,0) [0|0] "sec" TOOL
 SG_ AECD1_TIME2 m129 : 71|32@0+ (1,0) [0|0] "sec" TOOL
 SG_ AECD2_TIME1 m129 : 103|32@0+ (1,0) [0|0] "sec" TOOL
 SG_ AECD2_TIME2 m129 : 135|32@0+ (1,0) [0|0] "sec" TOOL
 SG_ AECD3_TIME1 m129 : 167|32@0+ (1,0) [0|0] "sec" TOOL
 SG_ AECD3_TIME2 m129 : 199|32@0+ (1,0) [0|0] "sec" TOOL
 SG_ AECD4_TIME1 m129 : 231|32@0+ (1,0) [0|0] "sec" TOOL
 SG_ AECD4_TIME2 m129 : 263|32@0+ (1,0) [0|0] "sec" TOOL
 SG_ AECD5_TIME1 m129 : 295|32@0+ (1,0) [0|0] "sec" TOOL
 SG_ AECD5_TIME2 m129 : 327|32@0+ (1,0) [0|0] "sec" TOOL
 SG_ AECD6_TIME_SUP m130 : 24|1@1+ (1,0) [0|0] "" TOOL
 SG_ AECD7_TIME_SUP m130 : 25|1@1+ (1,0) [0|0] "" TOOL
 SG_ AECD8_TIME_SUP m130 : 26|1@1+ (1,0) [0|0] "" TOOL
 SG_ AECD9_TIME_SUP m130 : 27|1@1+ (1,0) [0|0] "" TOOL
 SG_ AECD10_TIME_SUP m130 : 28|1@1+ (1,0) [0|0] "" TOOL
 SG_ AECD6_TIME1 m130 : 39|32@0+ (1,0) [0|0] "sec" TOOL
 SG_ AECD6_TIME2 m130 : 71|32@0+ (1,0) [0|0] "sec" TOOL
 SG_ AECD7_TIME1 m130 : 103|32@0+ (1,0) [0|0] "sec" TOOL
 SG_ AECD7_TIME2 m130 : 135|32@0+ (1,0) [0|0] "sec" TOOL
 SG_ AECD8_TIME1 m130 : 167|32@0+ (1,0) [0|0] "sec" TOOL
 SG_ AECD8_TIME2 m130 : 199|32@0+ (1,0) [0|0] "sec" TOOL
 SG_ AECD9_TIME1 m130 : 231|32@0+ (1,0) [0|0] "sec" TOOL
 SG_ AECD9_TIME2 m130 : 263|32@0+ (1,0) [0|0] "sec" TOOL
 SG_ AECD10_TIME1 m130 : 295|32@0+ (1,0) [0|0] "sec" TOOL
 SG_ AECD10_TIME2 m130 : 327|32@0+ (1,0) [0|0] "sec" TOOL
 SG_ NOX11_SUP m131 : 24|1@1+ (1,0) [0|0] "" TOOL
 SG_ NOX12_SUP m131 : 25|1@1+ (1,0) [0|0] "" TOOL
 SG_ NOX21_SUP m131 : 26|1@1+ (1,0) [0|0] "" TOOL
 SG_ NOX22_SUP m131 : 27|1@1+ (1,0) [0|0] "" TOOL
 SG_ NOX11_RDY m131 : 28|1@1+ (1,0) [0|0] "" TOOL
 SG_ NOX12_RDY m131 : 29|1@1+ (1,0) [0|0] "" TOOL
 SG_ NOX21_RDY m131 : 30|1@1+ (1,0) [0|0] "" TOOL
 SG_ NOX22_RDY m131 : 31|1@1+ (1,0) [0|0] "" TOOL
 SG_ NOX11 m131 : 39|16@0+ (1,0) [0|0] "ppm" TOOL
 SG_ NOX12 m131 : 55|16@0+ (1,0) [0|0] "ppm" TOOL
 SG_ NOX21 m131 : 71|16@0+ (1,0) [0|0] "ppm" TOOL
 SG_ NOX22 m131 : 87|16@0+ (1,0) [0|0] "ppm" TOOL
 SG_ MST m132 : 24|8@1+ (1,-40) [0|0] "°C " TOOL
 SG_ REAG_RATE_SUP m133 : 24|1@1+ (1,0) [0|0] "" TOOL
 SG_ REAG_DEMD_SUP m133 : 25|1@1+ (1,0) [0|0] "" TOOL
 SG_ REAG_LVL_SUP m133 : 26|1@1+ (1,0) [0|0] "" TOOL
 SG_ NWI_TIME_SUP m133 : 27|1@1+ (1,0) [0|0] "" TOOL
 SG_ REAG_RATE m133 : 39|16@0+ (0.005,0) [0|0] "L/h" TOOL
 SG_ REAG_DEMD m133 : 55|16@0+ (0.005,0) [0|0] "L/h" TOOL
 SG_ REAG_LVL m133 : 64|8@1+ (0.392156862745098,0) [0|0] "%" TOOL
 SG_ NWI_TIME m133 : 79|32@0+ (1,0) [0|0] "sec" TOOL
 SG_ PM11_SUP m134 : 24|1@1+ (1,0) [0|0] "" TOOL
 SG_ PM21_SUP m134 : 25|1@1+ (1,0) [0|0] "" TOOL
 SG_ PM11 m134 : 39|16@0+ (0.0125,0) [0|0] "mg/m3" TOOL
 SG_ PM21 m134 : 55|16@0+ (0.0125,0) [0|0] "mg/m3" TOOL
 SG_ MAP_A_SUP m135 : 24|1@1+ (1,0) [0|0] "" TOOL
 SG_ MAP_B_SUP m135 : 25|1@1+ (1,0) [0|0] "" TOOL
 SG_ MAP_A m135 : 39|16@0+ (0.03125,0) [0|0] "kPa" TOOL
 SG_ MAP_B m135 : 55|16@0+ (0.03125,0) [0|0] "kPa" TOOL
 SG_ SCR_IND_SYS_LEVEL_LOW m136 : 24|1@1+ (1,0) [0|0] "" TOOL
 SG_ SCR_IND_SYS_INCORR_REAG m136 : 25|1@1+ (1,0) [0|0] "" TOOL
 SG_ SCR_IND_SYS_CONSUMP_DEVIATION m136 : 26|1@1+ (1,0) [0|0] "" TOOL
 SG_ SCR_IND_SYS_NOx_LEVEL m136 : 27|1@1+ (1,0) [0|0] "" TOOL
 SG_ SCR_IND_SYS_ACTIVE m136 : 31|1@1+ (1,0) [0|0] "" TOOL
 SG_ SCR_IND_SYS_HIST1_LEVEL_LOW m136 : 32|1@1+ (1,0) [0|0] "" TOOL
 SG_ SCR_IND_SYS_HIST1_INCORR_REAG m136 : 33|1@1+ (1,0) [0|0] "" TOOL
 SG_ SCR_IND_SYS_HIST1_CONSUMP_DEVIATION m136 : 34|1@1+ (1,0) [0|0] "" TOOL
 SG_ SCR_IND_SYS_HIST1_NOx_LEVEL m136 : 35|1@1+ (1,0) [0|0] "" TOOL
 SG_ SCR_IND_SYS_HIST2_LEVEL_LOW m136 : 36|1@1+ (1,0) [0|0] "" TOOL
 SG_ SCR_IND_SYS_HIST2_INCORR_REAG m136 : 37|1@1+ (1,0) [0|0] "" TOOL
 SG_ SCR_IND_SYS_HIST2_CONSUMP_DEVIATION m136 : 38|1@1+ (1,0) [0|0] "" TOOL
 SG_ SCR_IND_SYS_HIST2_NOx_LEVEL m136 : 39|1@1+ (1,0) [0|0] "" TOOL
 SG_ SCR_IND_SYS_HIST3_LEVEL_LOW m136 : 40|1@1+ (1,0) [0|0] "" TOOL
 SG_ SCR_IND_SYS_HIST3_INCORR_REAG m136 : 41|1@1+ (1,0) [0|0] "" TOOL
 SG_ SCR_IND_SYS_HIST3_CONSUMP_DEVIATION m136 : 42|1@1+ (1,0) [0|0] "" TOOL
 SG_ SCR_IND_SYS_HIST3_NOx_LEVEL m136 : 43|1@1+ (1,0) [0|0] "" TOOL
 SG_ SCR_IND_SYS_HIST4_LEVEL_LOW m136 : 44|1@1+ (1,0) [0|0] "" TOOL
 SG_ SCR_IND_SYS_HIST4_INCORR_REAG m136 : 45|1@1+ (1,0) [0|0] "" TOOL
 SG_ SCR_IND_SYS_HIST4_CONSUMP_DEVIATION m136 : 46|1@1+ (1,0) [0|0] "" TOOL
 SG_ SCR_IND_SYS_HIST4_NOx_LEVEL m136 : 47|1@1+ (1,0) [0|0] "" TOOL
 SG_ SCR_IND_DIST_1N m136 : 55|16@0+ (1,0) [0|0] "km" TOOL
 SG_ SCR_IND_DIST_1D m136 : 71|16@0+ (1,0) [0|0] "km" TOOL
 SG_ SCR_IND_DIST_2N m136 : 87|16@0+ (1,0) [0|0] "km" TOOL
 SG_ SCR_IND_DIST_3N m136 : 103|16@0+ (1,0) [0|0] "km" TOOL
 SG_ SCR_IND_DIST_4N m136 : 119|16@0+ (1,0) [0|0] "km" TOOL
 SG_ AECD11_TIME_SUP m137 : 24|1@1+ (1,0) [0|0] "" TOOL
 SG_ AECD12_TIME_SUP m137 : 25|1@1+ (1,0) [0|0] "" TOOL
 SG_ AECD13_TIME_SUP m137 : 26|1@1+ (1,0) [0|0] "" TOOL
 SG_ AECD14_TIME_SUP m137 : 27|1@1+ (1,0) [0|0] "" TOOL
 SG_ AECD15_TIME_SUP m137 : 28|1@1+ (1,0) [0|0] "" TOOL
 SG_ AECD11_TIME1 m137 : 39|32@0+ (1,0) [0|0] "sec" TOOL
 SG_ AECD11_TIME2 m137 : 71|32@0+ (1,0) [0|0] "sec" TOOL
 SG_ AECD12_TIME1 m137 : 103|32@0+ (1,0) [0|0] "sec" TOOL
 SG_ AECD12_TIME2 m137 : 135|32@0+ (1,0) [0|0] "sec" TOOL
 SG_ AECD13_TIME1 m137 : 167|32@0+ (1,0) [0|0] "sec" TOOL
 SG_ AECD13_TIME2 m137 : 199|32@0+ (1,0) [0|0] "sec" TOOL
 SG_ AECD14_TIME1 m137 : 231|32@0+ (1,0) [0|0] "sec" TOOL
 SG_ AECD14_TIME2 m137 : 263|32@0+ (1,0) [0|0] "sec" TOOL
 SG_ AECD15_TIME1 m137 : 295|32@0+ (1,0) [0|0] "sec" TOOL
 SG_ AECD15_TIME2 m137 : 327|32@0+ (1,0) [0|0] "sec" TOOL
 SG_ AECD16_TIME_SUP m138 : 24|1@1+ (1,0) [0|0] "" TOOL
 SG_ AECD17_TIME_SUP m138 : 25|1@1+ (1,0) [0|0] "" TOOL
 SG_ AECD18_TIME_SUP m138 : 26|1@1+ (1,0) [0|0] "" TOOL
 SG_ AECD19_TIME_SUP m138 : 27|1@1+ (1,0) [0|0] "" TOOL
 SG_ AECD20_TIME_SUP m138 : 28|1@1+ (1,0) [0|0] "" TOOL
 SG_ AECD16_TIME1 m138 : 39|32@0+ (1,0) [0|0] "sec" TOOL
 SG_ AECD16_TIME2 m138 : 71|32@0+ (1,0) [0|0] "sec" TOOL
 SG_ AECD17_TIME1 m138 : 103|32@0+ (1,0) [0|0] "sec" TOOL
 SG_ AECD17_TIME2 m138 : 135|32@0+ (1,0) [0|0] "sec" TOOL
 SG_ AECD18_TIME1 m138 : 167|32@0+ (1,0) [0|0] "sec" TOOL
 SG_ AECD18_TIME2 m138 : 199|32@0+ (1,0) [0|0] "sec" TOOL
 SG_ AECD19_TIME1 m138 : 231|32@0+ (1,0) [0|0] "sec" TOOL
 SG_ AECD19_TIME2 m138 : 263|32@0+ (1,0) [0|0] "sec" TOOL
 SG_ AECD20_TIME1 m138 : 295|32@0+ (1,0) [0|0] "sec" TOOL
 SG_ AECD20_TIME2 m138 : 327|32@0+ (1,0) [0|0] "sec" TOOL
 SG_ PF_REGEN_STAT_SUP m139 : 24|1@1+ (1,0) [0|0] "" TOOL
 SG_ PF_REGEN_TYPE_SUP m139 : 25|1@1+ (1,0) [0|0] "" TOOL
 SG_ NOX_ADS_REGEN_SUP m139 : 26|1@1+ (1,0) [0|0] "" TOOL
 SG_ NOX_ADS_DESULF_SUP m139 : 27|1@1+ (1,0) [0|0] "" TOOL
 SG_ PF_REGEN_PCT_SUP m139 : 28|1@1+ (1,0) [0|0] "" TOOL
 SG_ PF_REGEN_AVGT_SUP m139 : 29|1@1+ (1,0) [0|0] "" TOOL
 SG_ PF_REGEN_AVGD_SUP m139 : 30|1@1+ (1,0) [0|0] "" TOOL
 SG_ PF_REGEN_STAT m139 : 32|1@1+ (1,0) [0|0] "" TOOL
 SG_ PF_REGEN_TYPE m139 : 33|1@1+ (1,0) [0|0] "" TOOL
 SG_ NOX_ADS_REGEN m139 : 34|1@1+ (1,0) [0|0] "" TOOL
 SG_ NOX_ADS_DESULF m139 : 35|1@1+ (1,0) [0|0] "" TOOL
 SG_ PF_REGEN_PCT m139 : 40|8@1+ (0.392156862745098,0) [0|0] "%" TOOL
 SG_ PF_REGEN_AVGT m139 : 55|16@0+ (1,0) [0|0] "min" TOOL
 SG_ PF_REGEN_AVGD m139 : 71|16@0+ (1,0) [0|0] "km" TOOL
 SG_ O2S11_PCT_SUP m140 : 24|1@1+ (1,0) [0|0] "" TOOL
 SG_ O2S12_PCT_SUP m140 : 25|1@1+ (1,0) [0|0] "" TOOL
 SG_ O2S21_PCT_SUP m140 : 26|1@1+ (1,0) [0|0] "" TOOL
 SG_ O2S22_PCT_SUP m140 : 27|1@1+ (1,0) [0|0] "" TOOL
 SG_ O2S11_PCT_LAMBDA_SUP m140 : 28|1@1+ (1,0) [0|0] "" TOOL
 SG_ O2S12_PCT_LAMBDA_SUP m140 : 29|1@1+ (1,0) [0|0] "" TOOL
 SG_ O2S21_PCT_LAMBDA_SUP m140 : 30|1@1+ (1,0) [0|0] "" TOOL
 SG_ O2S22_PCT_LAMBDA_SUP m140 : 31|1@1+ (1,0) [0|0] "" TOOL
 SG_ O2S11_PCT m140 : 39|16@0+ (0.001526,0) [0|0] "%" TOOL
 SG_ O2S12_PCT m140 : 55|16@0+ (0.001526,0) [0|0] "%" TOOL
 SG_ O2S21_PCT m140 : 71|16@0+ (0.001526,0) [0|0] "%" TOOL
 SG_ O2S22_PCT m140 : 87|16@0+ (0.001526,0) [0|0] "%" TOOL
 SG_ O2S11_PCT_LAMBDA m140 : 103|16@0+ (0.000122,0) [0|0] "lambda" TOOL
 SG_ O2S12_PCT_LAMBDA m140 : 119|16@0+ (0.000122,0) [0|0] "lambda" TOOL
 SG_ O2S21_PCT_LAMBDA m140 : 135|16@0+ (0.000122,0) [0|0] "lambda" TOOL
 SG_ O2S22_PCT_LAMBDA m140 : 151|16@0+ (0.000122,0) [0|0] "lambda" TOOL
 SG_ TP_G m141 : 24|8@1+ (0.392156862745098,0) [0|0] "%" TOOL
 SG_ TQ_FR m142 : 24|8@1+ (0.1,-125) [0|0] "%" TOOL
 SG_ PM11_STA_SUP m143 : 24|1@1+ (1,0) [0|0] "" TOOL
 SG_ PM11_SIGNAL_SUP m143 : 25|1@1+ (1,0) [0|0] "" TOOL
 SG_ PM21_STA_SUP m143 : 26|1@1+ (1,0) [0|0] "" TOOL
 SG_ PM21_SIGNAL_SUP m143 : 27|1@1+ (1,0) [0|0] "" TOOL
 SG_ PM11_ACTIVE m143 : 32|1@1+ (1,0) [0|0] "" TOOL
 SG_ PM11_REGEN m143 : 33|1@1+ (1,0) [0|0] "" TOOL
 SG_ PM11_NOV m143 : 47|16@0- (0.01,0) [0|0] "%" TOOL
 SG_ PM21_ACTIVE m143 : 56|1@1+ (1,0) [0|0] "" TOOL
 SG_ PM21_REGEN m143 : 57|1@1+ (1,0) [0|0] "" TOOL
 SG_ PM21_NOV m143 : 71|16@0- (0.01,0) [0|0] "%" TOOL
 SG_ MI_DISP_VOBD m144 : 24|2@1+ (1,0) [0|0] "" TOOL
 SG_ MI_MODE_VOBD m144 : 26|4@1+ (1,0) [0|0] "" TOOL
 SG_ VOBD_RDY m144 : 30|1@1+ (1,0) [0|0] "" TOOL
 SG_ VOBD_MI_TIME m144 : 39|16@0+ (1,0) [0|0] "h" TOOL
 SG_ MI_MODE_ECU m145 : 24|4@1+ (1,0) [0|0] "" TOOL
 SG_ OBD_MI_TIME m145 : 39|16@0+ (1,0) [0|0] "h" TOOL
 SG_ OBD_B1_TIME m145 : 55|16@0+ (1,0) [0|0] "h" TOOL
 SG_ FP1_CL_SUP m146 : 24|1@1+ (1,0) [0|0] "" TOOL
 SG_ FIQ1_CL_SUP m146 : 25|1@1+ (1,0) [0|0] "" TOOL
 SG_ FIT1_CL_SUP m146 : 26|1@1+ (1,0) [0|0] "" TOOL
 SG_ IFB1_CL_SUP m146 : 27|1@1+ (1,0) [0|0] "" TOOL
 SG_ FP2_CL_SUP m146 : 28|1@1+ (1,0) [0|0] "" TOOL
 SG_ FIQ2_CL_SUP m146 : 29|1@1+ (1,0) [0|0] "" TOOL
 SG_ FIT2_CL_SUP m146 : 30|1@1+ (1,0) [0|0] "" TOOL
 SG_ IFB2_CL_SUP m146 : 31|1@1+ (1,0) [0|0] "" TOOL
 SG_ FP1_CL m146 : 32|1@1+ (1,0) [0|0] "" TOOL
 SG_ FIQ1_CL m146 : 33|1@1+ (1,0) [0|0] "" TOOL
 SG_ FIT1_CL m146 : 34|1@1+ (1,0) [0|0] "" TOOL
 SG_ IFB1_CL m146 : 35|1@1+ (1,0) [0|0] "" TOOL
 SG_ FP2_CL m146 : 36|1@1+ (1,0) [0|0] "" TOOL
 SG_ FIQ2_CL m146 : 37|1@1+ (1,0) [0|0] "" TOOL
 SG_ FIT2_CL m146 : 38|1@1+ (1,0) [0|0] "" TOOL
 SG_ IFB2_CL m146 : 39|1@1+ (1,0) [0|0] "" TOOL
 SG_ MI_TIME_CUM_SUP m147 : 24|1@1+ (1,0) [0|0] "" TOOL
 SG_ MI_TIME_CUM m147 : 39|16@0+ (1,0) [0|0] "h" TOOL
 SG_ NOX_WARN_ACT_SUP m148 : 24|1@1+ (1,0) [0|0] "" TOOL
 SG_ REAG_QUAL_TIME_SUP m148 : 25|1@1+ (1,0) [0|0] "" TOOL
 SG_ REAG_CON_TIME_SUP m148 : 26|1@1+ (1,0) [0|0] "" TOOL
 SG_ REAG_DOSE_TIME_SUP m148 : 27|1@1+ (1,0) [0|0] "" TOOL
 SG_ EGR_TIME_SUP m148 : 28|1@1+ (1,0) [0|0] "" TOOL
 SG_ NOX_DTC_TIME_SUP m148 : 29|1@1+ (1,0) [0|0] "" TOOL
 SG_ NOX_WARN_ACT m148 : 32|1@1+ (1,0) [0|0] "" TOOL
 SG_ INDUC_L1 m148 : 33|2@1+ (1,0) [0|0] "" TOOL
 SG_ INDUC_L2 m148 : 35|2@1+ (1,0) [0|0] "" TOOL
 SG_ INDUC_L3 m148 : 37|2@1+ (1,0) [0|0] "" TOOL
 SG_ REAG_QUAL_TIME m148 : 47|16@0+ (1,0) [0|0] "h" TOOL
 SG_ REAG_CON_TIME m148 : 63|16@0+ (1,0) [0|0] "h" TOOL
 SG_ REAG_DOSE_TIME m148 : 79|16@0+ (1,0) [0|0] "h" TOOL
 SG_ EGR_TIME m148 : 95|16@0+ (1,0) [0|0] "h" TOOL
 SG_ NOX_DTC_TIME m148 : 111|16@0+ (1,0) [0|0] "h" TOOL
 SG_ SCR_NH3_TGT_A_SUP m149 : 24|1@1+ (1,0) [0|0] "" TOOL
 SG_ SCR_NH3_ACT_A_SUP m149 : 25|1@1+ (1,0) [0|0] "" TOOL
 SG_ SCR_NH3_TGT_B_SUP m149 : 26|1@1+ (1,0) [0|0] "" TOOL
 SG_ SCR_NH3_ACT_B_SUP m149 : 27|1@1+ (1,0) [0|0] "" TOOL
 SG_ SCR_NH3_TGT_A m149 : 39|16@0+ (1,0) [0|0] "g/l" TOOL
 SG_ SCR_NH3_ACT_A m149 : 55|16@0+ (1,0) [0|0] "g/l" TOOL
 SG_ SCR_NH3_TGT_B m149 : 71|16@0+ (1,0) [0|0] "g/l" TOOL
 SG_ SCR_NH3_ACT_B m149 : 87|16@0+ (1,0) [0|0] "g/l" TOOL
 SG_ HC_INJ_FL_SUP m150 : 24|1@1+ (1,0) [0|0] "" TOOL
 SG_ HC_INJ_DC_SUP m150 : 25|1@1+ (1,0) [0|0] "" TOOL
 SG_ AFT_FP_SUP m150 : 26|1@1+ (1,0) [0|0] "" TOOL
 SG_ HC_INJ_FL m150 : 39|16@0+ (0.05,0) [0|0] "g/min" TOOL
 SG_ HC_INJ_DC m150 : 48|8@1+ (0.392156862745098,0) [0|0] "%" TOOL
 SG_ AFT_FP m150 : 63|16@0+ (0.1,0) [0|0] "kPa" TOOL
 SG_ NOx_EO_SUP m151 : 24|1@1+ (1,0) [0|0] "" TOOL
 SG_ NOx_TP_SUP m151 : 25|1@1+ (1,0) [0|0] "" TOOL
 SG_ NOx_EO m151 : 39|16@0+ (1,0) [0|0] "" TOOL
 SG_ NOx_TP m151 : 55|16@0+ (1,0) [0|0] "" TOOL
 SG_ EGT15_SUP m152 : 24|1@1+ (1,0) [0|0] "" TOOL
 SG_ EGT16_SUP m152 : 25|1@1+ (1,0) [0|0] "" TOOL
 SG_ EGT17_SUP m152 : 26|1@1+ (1,0) [0|0] "" TOOL
 SG_ EGT18_SUP m152 : 27|1@1+ (1,0) [0|0] "" TOOL
 SG_ EGT15 m152 : 39|16@0+ (0.1,-40) [0|0] "°C " TOOL
 SG_ EGT16 m152 : 55|16@0+ (0.1,-40) [0|0] "°C " TOOL
 SG_ EGT17 m152 : 71|16@0+ (0.1,-40) [0|0] "°C " TOOL
 SG_ EGT18 m152 : 87|16@0+ (0.1,-40) [0|0] "°C " TOOL
 SG_ EGT25_SUP m153 : 24|1@1+ (1,0) [0|0] "" TOOL
 SG_ EGT26_SUP m153 : 25|1@1+ (1,0) [0|0] "" TOOL
 SG_ EGT27_SUP m153 : 26|1@1+ (1,0) [0|0] "" TOOL
 SG_ EGT28_SUP m153 : 27|1@1+ (1,0) [0|0] "" TOOL
 SG_ EGT25 m153 : 39|16@0+ (0.1,-40) [0|0] "°C " TOOL
 SG_ EGT26 m153 : 55|16@0+ (0.1,-40) [0|0] "°C " TOOL
 SG_ EGT27 m153 : 71|16@0+ (0.1,-40) [0|0] "°C " TOOL
 SG_ EGT28 m153 : 87|16@0+ (0.1,-40) [0|0] "°C " TOOL
 SG_ HEV_CHRG_STA_SUP m154 : 24|1@1+ (1,0) [0|0] "" TOOL
 SG_ HEV_BATT_V_SUP m154 : 25|1@1+ (1,0) [0|0] "" TOOL
 SG_ HEV_BATT_A_SUP m154 : 26|1@1+ (1,0) [0|0] "" TOOL
 SG_ EHEV_CHRG_STA_SUP m154 : 27|1@1+ (1,0) [0|0] "" TOOL
 SG_ HEV_CHRG_STA m154 : 32|1@1+ (1,0) [0|0] "" TOOL
 SG_ EHEV_CHRG_STA m154 : 33|2@1+ (1,0) [0|0] "" TOOL
 SG_ HEV_BATT_V m154 : 47|16@0+ (0.015625,0) [0|0] "V" TOOL
 SG_ HEV_BATT_A m154 : 63|16@0+ (0.1,0) [0|0] "A" TOOL
 SG_ DEF_TYPE_SUP m155 : 24|1@1+ (1,0) [0|0] "" TOOL
 SG_ DEF_CON_SUP m155 : 25|1@1+ (1,0) [0|0] "" TOOL
 SG_ DEF_T_SUP m155 : 26|1@1+ (1,0) [0|0] "" TOOL
 SG_ DEF_LVL_SUP m155 : 27|1@1+ (1,0) [0|0] "" TOOL
 SG_ DEF_TYPE m155 : 28|4@1+ (1,0) [0|0] "" TOOL
 SG_ DEF_CON m155 : 32|8@1+ (0.25,0) [0|0] "%" TOOL
 SG_ DEF_T m155 : 40|8@1+ (1,-40) [0|0] "°C " TOOL
 SG_ DEF_LVL m155 : 48|8@1+ (0.392156862745098,0) [0|0] "%" TOOL
 SG_ O2S13_PCT_SUP m156 : 24|1@1+ (1,0) [0|0] "" TOOL
 SG_ O2S14_PCT_SUP m156 : 25|1@1+ (1,0) [0|0] "" TOOL
 SG_ O2S23_PCT_SUP m156 : 26|1@1+ (1,0) [0|0] "" TOOL
 SG_ O2S24_PCT_SUP m156 : 27|1@1+ (1,0) [0|0] "" TOOL
 SG_ O2S13_PCT_LAMBDA_SUP m156 : 28|1@1+ (1,0) [0|0] "" TOOL
 SG_ O2S14_PCT_LAMBDA_SUP m156 : 29|1@1+ (1,0) [0|0] "" TOOL
 SG_ O2S23_PCT_LAMBDA_SUP m156 : 30|1@1+ (1,0) [0|0] "" TOOL
 SG_ O2S24_PCT_LAMBDA_SUP m156 : 31|1@1+ (1,0) [0|0] "" TOOL
 SG_ O2S13_PCT m156 : 39|16@0+ (0.001526,0) [0|0] "%" TOOL
 SG_ O2S14_PCT m156 : 55|16@0+ (0.001526,0) [0|0] "%" TOOL
 SG_ O2S23_PCT m156 : 71|16@0+ (0.001526,0) [0|0] "%" TOOL
 SG_ O2S24_PCT m156 : 87|16@0+ (0.001526,0) [0|0] "%" TOOL
 SG_ O2S13_PCT_LAMBDA m156 : 103|16@0+ (0.000122,0) [0|0] "lambda" TOOL
 SG_ O2S14_PCT_LAMBDA m156 : 119|16@0+ (0.000122,0) [0|0] "lambda" TOOL
 SG_ O2S23_PCT_LAMBDA m156 : 135|16@0+ (0.000122,0) [0|0] "lambda" TOOL
 SG_ O2S24_PCT_LAMBDA m156 : 151|16@0+ (0.000122,0) [0|0] "lambda" TOOL
 SG_ FUEL_RATE_GS m157 : 31|16@0+ (0.02,0) [0|0] "g/s" TOOL
 SG_ VFUEL_RATE m157 : 47|16@0+ (0.02,0) [0|0] "g/s" TOOL
 SG_ EXH_RATE m158 : 31|16@0+ (0.2,0) [0|0] "kg/h " TOOL
 SG_ FUELSYSA_B1_SUP m159 : 24|1@1+ (1,0) [0|0] "" TOOL
 SG_ FUELSYSB_B1_SUP m159 : 25|1@1+ (1,0) [0|0] "" TOOL
 SG_ FUELSYSA_B2_SUP m159 : 26|1@1+ (1,0) [0|0] "" TOOL
 SG_ FUELSYSB_B2_SUP m159 : 27|1@1+ (1,0) [0|0] "" TOOL
 SG_ FUELSYSA_B3_SUP m159 : 28|1@1+ (1,0) [0|0] "" TOOL
 SG_ FUELSYSB_B3_SUP m159 : 29|1@1+ (1,0) [0|0] "" TOOL
 SG_ FUELSYSA_B4_SUP m159 : 30|1@1+ (1,0) [0|0] "" TOOL
 SG_ FUELSYSB_B4_SUP m159 : 31|1@1+ (1,0) [0|0] "" TOOL
 SG_ FUELSYSA_B1 m159 : 32|8@1+ (0.392156862745098,0) [0|0] "%" TOOL
 SG_ FUELSYSB_B1 m159 : 40|8@1+ (0.392156862745098,0) [0|0] "%" TOOL
 SG_ FUELSYSA_B2 m159 : 48|8@1+ (0.392156862745098,0) [0|0] "%" TOOL
 SG_ FUELSYSB_B2 m159 : 56|8@1+ (0.392156862745098,0) [0|0] "%" TOOL
 SG_ FUELSYSA_B3 m159 : 64|8@1+ (0.392156862745098,0) [0|0] "%" TOOL
 SG_ FUELSYSB_B3 m159 : 72|8@1+ (0.392156862745098,0) [0|0] "%" TOOL
 SG_ FUELSYSA_B4 m159 : 80|8@1+ (0.392156862745098,0) [0|0] "%" TOOL
 SG_ FUELSYSB_B4 m159 : 88|8@1+ (0.392156862745098,0) [0|0] "%" TOOL
 SG_ NOXC11_SUP m161 : 24|1@1+ (1,0) [0|0] "" TOOL
 SG_ NOXC12_SUP m161 : 25|1@1+ (1,0) [0|0] "" TOOL
 SG_ NOXC21_SUP m161 : 26|1@1+ (1,0) [0|0] "" TOOL
 SG_ NOXC22_SUP m161 : 27|1@1+ (1,0) [0|0] "" TOOL
 SG_ NOXC11_RDY m161 : 28|1@1+ (1,0) [0|0] "" TOOL
 SG_ NOXC12_RDY m161 : 29|1@1+ (1,0) [0|0] "" TOOL
 SG_ NOXC21_RDY m161 : 30|1@1+ (1,0) [0|0] "" TOOL
 SG_ NOXC22_RDY m161 : 31|1@1+ (1,0) [0|0] "" TOOL
 SG_ NOXC11 m161 : 39|16@0+ (1,0) [0|0] "ppm" TOOL
 SG_ NOXC12 m161 : 55|16@0+ (1,0) [0|0] "ppm" TOOL
 SG_ NOXC21 m161 : 71|16@0+ (1,0) [0|0] "ppm" TOOL
 SG_ NOXC22 m161 : 87|16@0+ (1,0) [0|0] "ppm" TOOL
 SG_ CYL_RATE m162 : 31|16@0+ (0.03125,0) [0|0] "mg/stoke" TOOL
 SG_ EVAP_A_VP_SUP m163 : 24|1@1+ (1,0) [0|0] "" TOOL
 SG_ EVAP_A_VP_WR_SUP m163 : 25|1@1+ (1,0) [0|0] "" TOOL
 SG_ EVAP_B_VP_SUP m163 : 26|1@1+ (1,0) [0|0] "" TOOL
 SG_ EVAP_B_VP_WR_SUP m163 : 27|1@1+ (1,0) [0|0] "" TOOL
 SG_ EVAP_SEAL_SUP m163 : 28|1@1+ (1,0) [0|0] "" TOOL
 SG_ EVAP_SEAL m163 : 29|1@1+ (1,0) [0|0] "" TOOL
 SG_ EVAP_A_VP m163 : 39|16@0- (0.25,0) [0|0] "Pa" TOOL
 SG_ EVAP_A_VP_WR m163 : 55|16@0- (2,0) [0|0] "Pa" TOOL
 SG_ EVAP_B_VP m163 : 71|16@0- (0.25,0) [0|0] "Pa" TOOL
 SG_ EVAP_B_VP_WR m163 : 87|16@0- (2,0) [0|0] "Pa" TOOL
 SG_ GEAR_ACT_SUP m164 : 24|1@1+ (1,0) [0|0] "" TOOL
 SG_ GEAR_RAT_SUP m164 : 25|1@1+ (1,0) [0|0] "" TOOL
 SG_ GEAR_ACT m164 : 36|4@1+ (1,0) [0|0] "" TOOL
 SG_ GEAR_RAT m164 : 47|16@0+ (0.001,0) [0|0] "" TOOL
 SG_ DEF_CMD_SUP m165 : 24|1@1+ (1,0) [0|0] "" TOOL
 SG_ DEF_UCDC_SUP m165 : 25|1@1+ (1,0) [0|0] "" TOOL
 SG_ DEF_CMD m165 : 32|8@1+ (0.5,0) [0|0] "%" TOOL
 SG_ DEF_UCDC m165 : 47|16@0+ (0.0005,0) [0|0] "L" TOOL
 SG_ ODO m166 : 31|32@0+ (0.1,0) [0|0] "km" TOOL
 SG_ NOX13_SUP m167 : 24|1@1+ (1,0) [0|0] "" TOOL
 SG_ NOX14_SUP m167 : 25|1@1+ (1,0) [0|0] "" TOOL
 SG_ NOX23_SUP m167 : 26|1@1+ (1,0) [0|0] "" TOOL
 SG_ NOX24_SUP m167 : 27|1@1+ (1,0) [0|0] "" TOOL
 SG_ NOX13_RDY m167 : 28|1@1+ (1,0) [0|0] "" TOOL
 SG_ NOX14_RDY m167 : 29|1@1+ (1,0) [0|0] "" TOOL
 SG_ NOX23_RDY m167 : 30|1@1+ (1,0) [0|0] "" TOOL
 SG_ NOX24_RDY m167 : 31|1@1+ (1,0) [0|0] "" TOOL
 SG_ NOX13 m167 : 39|16@0+ (1,0) [0|0] "ppm" TOOL
 SG_ NOX14 m167 : 55|16@0+ (1,0) [0|0] "ppm" TOOL
 SG_ NOX23 m167 : 71|16@0+ (1,0) [0|0] "ppm" TOOL
 SG_ NOX24 m167 : 87|16@0+ (1,0) [0|0] "ppm" TOOL
 SG_ NOXC13_SUP m168 : 24|1@1+ (1,0) [0|0] "" TOOL
 SG_ NOXC14_SUP m168 : 25|1@1+ (1,0) [0|0] "" TOOL
 SG_ NOXC23_SUP m168 : 26|1@1+ (1,0) [0|0] "" TOOL
 SG_ NOXC24_SUP m168 : 27|1@1+ (1,0) [0|0] "" TOOL
 SG_ NOXC13_RDY m168 : 28|1@1+ (1,0) [0|0] "" TOOL
 SG_ NOXC14_RDY m168 : 29|1@1+ (1,0) [0|0] "" TOOL
 SG_ NOXC23_RDY m168 : 30|1@1+ (1,0) [0|0] "" TOOL
 SG_ NOXC24_RDY m168 : 31|1@1+ (1,0) [0|0] "" TOOL
 SG_ NOXC13 m168 : 39|16@0+ (1,0) [0|0] "ppm" TOOL
 SG_ NOXC14 m168 : 55|16@0+ (1,0) [0|0] "ppm" TOOL
 SG_ NOXC23 m168 : 71|16@0+ (1,0) [0|0] "ppm" TOOL
 SG_ NOXC24 m168 : 87|16@0+ (1,0) [0|0] "ppm" TOOL
 SG_ ABS_DISABLED_SUP m169 : 24|1@1+ (1,0) [0|0] "" TOOL
 SG_ ABS_DISABLED m169 : 32|1@1+ (1,0) [0|0] "" TOOL
 SG_ V_SET m170 : 24|8@1+ (1,0) [0|0] "km/h" TOOL
 SG_ FRP_AF_SUP m171 : 24|1@1+ (1,0) [0|0] "" TOOL
 SG_ FRT_AF_SUP m171 : 25|1@1+ (1,0) [0|0] "" TOOL
 SG_ FTP_AF_SUP m171 : 26|1@1+ (1,0) [0|0] "" TOOL
 SG_ FTPW_AF_SUP m171 : 27|1@1+ (1,0) [0|0] "" TOOL
 SG_ FTT_AF_SUP m171 : 28|1@1+ (1,0) [0|0] "" TOOL
 SG_ FRP_AF m171 : 39|16@0+ (0.03125,0) [0|0] "kPa" TOOL
 SG_ FRT_AF m171 : 48|8@1+ (1,-40) [0|0] "°C " TOOL
 SG_ FTP_AF m171 : 63|16@0+ (0.125,0) [0|0] "kPa" TOOL
 SG_ FTPW_AF m171 : 79|16@0+ (1,0) [0|0] "kPa" TOOL
 SG_ FTT_AF m171 : 88|8@1+ (2,-256) [0|0] "°C " TOOL
 SG_ CKC_P_SUP m173 : 24|1@1+ (1,0) [0|0] "" TOOL
 SG_ CKC_OSEP_RPM_SUP m173 : 25|1@1+ (1,0) [0|0] "" TOOL
 SG_ CKC_P m173 : 39|16@0- (0.25,0) [0|0] "Pa" TOOL
 SG_ CKC_OSEP_RPM m173 : 55|16@0+ (1,0) [0|0] "rpm" TOOL
 SG_ EVAP_PP_SUP m174 : 24|1@1+ (1,0) [0|0] "" TOOL
 SG_ EVAP_PP_WR_SUP m174 : 25|1@1+ (1,0) [0|0] "" TOOL
 SG_ EVAP_PP m174 : 39|16@0- (0.25,0) [0|0] "Pa" TOOL
 SG_ EVAP_PP_WR m174 : 55|16@0- (2,0) [0|0] "Pa" TOOL
 SG_ AIR_FL_TGT m175 : 31|16@0+ (0.05,0) [0|0] "kg/hr " TOOL
 SG_ EGR_M_FL_A_SUP m176 : 24|1@1+ (1,0) [0|0] "" TOOL
 SG_ EGR_M_FL_B_SUP m176 : 25|1@1+ (1,0) [0|0] "" TOOL
 SG_ EGR_M_FL_A m176 : 39|16@0+ (0.05,0) [0|0] "kg/hr " TOOL
 SG_ EGR_M_FL_B m176 : 55|16@0+ (0.05,0) [0|0] "kg/hr " TOOL
 SG_ CIFSI1_SUP m177 : 24|1@1+ (1,0) [0|0] "" TOOL
 SG_ CIFSI2_SUP m177 : 25|1@1+ (1,0) [0|0] "" TOOL
 SG_ CIFSI1_SHRTFT_SUP m177 : 26|1@1+ (1,0) [0|0] "" TOOL
 SG_ CIFSI1_LONGFT_SUP m177 : 27|1@1+ (1,0) [0|0] "" TOOL
 SG_ CIFSI2_SHRTFT_SUP m177 : 28|1@1+ (1,0) [0|0] "" TOOL
 SG_ CIFSI2_LONGFT_SUP m177 : 29|1@1+ (1,0) [0|0] "" TOOL
 SG_ CIFSI1_OL m177 : 32|1@1+ (1,0) [0|0] "" TOOL
 SG_ CIFSI1_CL m177 : 33|1@1+ (1,0) [0|0] "" TOOL
 SG_ CIFSI1_OL_Fault m177 : 34|1@1+ (1,0) [0|0] "" TOOL
 SG_ CIFSI2_OL m177 : 36|1@1+ (1,0) [0|0] "" TOOL
 SG_ CIFSI2_CL m177 : 37|1@1+ (1,0) [0|0] "" TOOL
 SG_ CIFSI2_OL_Fault m177 : 38|1@1+ (1,0) [0|0] "" TOOL
 SG_ CIFSI1_SHRTFT m177 : 40|8@1- (0.78125,0) [0|0] "%" TOOL
 SG_ CIFSI1_LONGFT m177 : 48|8@1- (0.78125,0) [0|0] "%" TOOL
 SG_ CIFSI2_SHRTFT m177 : 56|8@1- (0.78125,0) [0|0] "%" TOOL
 SG_ CIFSI2_LONGFT m177 : 64|8@1+ (1,0) [0|0] "" TOOL
 SG_ BAT_RET m178 : 24|8@1+ (0.392156862745098,0) [0|0] "%" TOOL
 SG_ HVESPA_ACR_SUP m179 : 24|1@1+ (1,0) [0|0] "" TOOL
 SG_ HVESPB_ACR_SUP m179 : 25|1@1+ (1,0) [0|0] "" TOOL
 SG_ HVESPC_ACR_SUP m179 : 26|1@1+ (1,0) [0|0] "" TOOL
 SG_ HVESPD_ACR_SUP m179 : 27|1@1+ (1,0) [0|0] "" TOOL
 SG_ HVESPE_ACR_SUP m179 : 28|1@1+ (1,0) [0|0] "" TOOL
 SG_ HVESPF_ACR_SUP m179 : 29|1@1+ (1,0) [0|0] "" TOOL
 SG_ HVESPG_ACR_SUP m179 : 30|1@1+ (1,0) [0|0] "" TOOL
 SG_ HVESPH_ACR_SUP m179 : 31|1@1+ (1,0) [0|0] "" TOOL
 SG_ HVESS_ACR m179 : 39|16@0+ (0.05,0) [0|0] "kW" TOOL
 SG_ HVESPA_ACR m179 : 55|16@0+ (0.05,0) [0|0] "kW" TOOL
 SG_ HVESPB_ACR m179 : 71|16@0+ (0.05,0) [0|0] "kW" TOOL
 SG_ HVESPC_ACR m179 : 87|16@0+ (0.05,0) [0|0] "kW" TOOL
 SG_ HVESPD_ACR m179 : 103|16@0+ (0.05,0) [0|0] "kW" TOOL
 SG_ HVESPE_ACR m179 : 119|16@0+ (0.05,0) [0|0] "kW" TOOL
 SG_ HVESPF_ACR m179 : 135|16@0+ (0.05,0) [0|0] "kW" TOOL
 SG_ HVESPG_ACR m179 : 151|16@0+ (0.05,0) [0|0] "kW" TOOL
 SG_ HVESPH_ACR m179 : 167|16@0+ (0.05,0) [0|0] "kW" TOOL
 SG_ HVESPA_Temp_SUP m180 : 24|1@1+ (1,0) [0|0] "" TOOL
 SG_ HVESPB_Temp_SUP m180 : 25|1@1+ (1,0) [0|0] "" TOOL
 SG_ HVESPC_Temp_SUP m180 : 26|1@1+ (1,0) [0|0] "" TOOL
 SG_ HVESPD_Temp_SUP m180 : 27|1@1+ (1,0) [0|0] "" TOOL
 SG_ HVESPE_Temp_SUP m180 : 28|1@1+ (1,0) [0|0] "" TOOL
 SG_ HVESPF_Temp_SUP m180 : 29|1@1+ (1,0) [0|0] "" TOOL
 SG_ HVESPG_Temp_SUP m180 : 30|1@1+ (1,0) [0|0] "" TOOL
 SG_ HVESPH_Temp_SUP m180 : 31|1@1+ (1,0) [0|0] "" TOOL
 SG_ HVESS_Temp m180 : 32|8@1+ (1,-40) [0|0] "°C " TOOL
 SG_ HVESPA_Temp m180 : 40|8@1+ (1,-40) [0|0] "°C " TOOL
 SG_ HVESPB_Temp m180 : 48|8@1+ (1,-40) [0|0] "°C " TOOL
 SG_ HVESPC_Temp m180 : 56|8@1+ (1,-40) [0|0] "°C " TOOL
 SG_ HVESPD_Temp m180 : 64|8@1+ (1,-40) [0|0] "°C " TOOL
 SG_ HVESPE_Temp m180 : 72|8@1+ (1,-40) [0|0] "°C " TOOL
 SG_ HVESPF_Temp m180 : 80|8@1+ (1,-40) [0|0] "°C " TOOL
 SG_ HVESPG_Temp m180 : 88|8@1+ (1,-40) [0|0] "°C " TOOL
 SG_ HVESPH_Temp m180 : 96|8@1+ (1,-40) [0|0] "°C " TOOL
 SG_ HVESPA_Cur_SUP m181 : 24|1@1+ (1,0) [0|0] "" TOOL
 SG_ HVESPB_Cur_SUP m181 : 25|1@1+ (1,0) [0|0] "" TOOL
 SG_ HVESPC_Cur_SUP m181 : 26|1@1+ (1,0) [0|0] "" TOOL
 SG_ HVESPD_Cur_SUP m181 : 27|1@1+ (1,0) [0|0] "" TOOL
 SG_ HVESPE_Cur_SUP m181 : 28|1@1+ (1,0) [0|0] "" TOOL
 SG_ HVESPF_Cur_SUP m181 : 29|1@1+ (1,0) [0|0] "" TOOL
 SG_ HVESPG_Cur_SUP m181 : 30|1@1+ (1,0) [0|0] "" TOOL
 SG_ HVESPH_Cur_SUP m181 : 31|1@1+ (1,0) [0|0] "" TOOL
 SG_ HVESS_Cur m181 : 39|16@0+ (0.05,0) [0|0] "A" TOOL
 SG_ HVESPA_Cur m181 : 55|16@0+ (0.05,0) [0|0] "A" TOOL
 SG_ HVESPB_Cur m181 : 71|16@0+ (0.05,0) [0|0] "A" TOOL
 SG_ HVESPC_Cur m181 : 87|16@0+ (0.05,0) [0|0] "A" TOOL
 SG_ HVESPD_Cur m181 : 103|16@0+ (0.05,0) [0|0] "A" TOOL
 SG_ HVESPE_Cur m181 : 119|16@0+ (0.05,0) [0|0] "A" TOOL
 SG_ HVESPF_Cur m181 : 135|16@0+ (0.05,0) [0|0] "A" TOOL
 SG_ HVESPG_Cur m181 : 151|16@0+ (0.05,0) [0|0] "A" TOOL
 SG_ HVESPH_Cur m181 : 167|16@0+ (0.05,0) [0|0] "A" TOOL
 SG_ HVESPA_Volt_SUP m182 : 24|1@1+ (1,0) [0|0] "" TOOL
 SG_ HVESPB_Volt_SUP m182 : 25|1@1+ (1,0) [0|0] "" TOOL
 SG_ HVESPC_Volt_SUP m182 : 26|1@1+ (1,0) [0|0] "" TOOL
 SG_ HVESPD_Volt_SUP m182 : 27|1@1+ (1,0) [0|0] "" TOOL
 SG_ HVESPE_Volt_SUP m182 : 28|1@1+ (1,0) [0|0] "" TOOL
 SG_ HVESPF_Volt_SUP m182 : 29|1@1+ (1,0) [0|0] "" TOOL
 SG_ HVESPG_Volt_SUP m182 : 30|1@1+ (1,0) [0|0] "" TOOL
 SG_ HVESPH_Volt_SUP m182 : 31|1@1+ (1,0) [0|0] "" TOOL
 SG_ HVESS_Volt m182 : 39|16@0+ (0.05,0) [0|0] "V" TOOL
 SG_ HVESPA_Volt m182 : 55|16@0+ (0.05,0) [0|0] "V" TOOL
 SG_ HVESPB_Volt m182 : 71|16@0+ (0.05,0) [0|0] "V" TOOL
 SG_ HVESPC_Volt m182 : 87|16@0+ (0.05,0) [0|0] "V" TOOL
 SG_ HVESPD_Volt m182 : 103|16@0+ (0.05,0) [0|0] "V" TOOL
 SG_ HVESPE_Volt m182 : 119|16@0+ (0.05,0) [0|0] "V" TOOL
 SG_ HVESPF_Volt m182 : 135|16@0+ (0.05,0) [0|0] "V" TOOL
 SG_ HVESPG_Volt m182 : 151|16@0+ (0.05,0) [0|0] "V" TOOL
 SG_ HVESPH_Volt m182 : 167|16@0+ (0.05,0) [0|0] "V" TOOL
 SG_ HEV_Batt_Min_Cell_Temp_SUP m183 : 24|1@1+ (1,0) [0|0] "" TOOL
 SG_ HEV_Batt_Max_Cell_Temp_SUP m183 : 25|1@1+ (1,0) [0|0] "" TOOL
 SG_ HEV_Batt_Ave_Cell_Temp_SUP m183 : 26|1@1+ (1,0) [0|0] "" TOOL
 SG_ HEV_Batt_Bus_Bar_Temp_SUP m183 : 27|1@1+ (1,0) [0|0] "" TOOL
 SG_ HEV_Batt_Coolant_Temp_SUP m183 : 28|1@1+ (1,0) [0|0] "" TOOL
 SG_ HEV_Batt_Therm_Mode_SUP m183 : 29|1@1+ (1,0) [0|0] "" TOOL
 SG_ HEV_Batt_Min_Cell_Temp m183 : 32|8@1+ (1,-40) [0|0] "°C " TOOL
 SG_ HEV_Batt_Max_Cell_Temp m183 : 40|8@1+ (1,-40) [0|0] "°C " TOOL
 SG_ HEV_Batt_Ave_Cell_Temp m183 : 48|8@1+ (1,-40) [0|0] "°C " TOOL
 SG_ HEV_Batt_Bus_Bar_Temp m183 : 56|8@1+ (1,-40) [0|0] "°C " TOOL
 SG_ HEV_Batt_Coolant_Temp m183 : 64|8@1+ (1,-40) [0|0] "°C " TOOL
 SG_ HEV_Batt_Therm_Mode m183 : 72|8@1+ (1,0) [0|0] "" TOOL
 SG_ HEV_Batt_Time_Since_Last_Balance m184 : 31|16@0+ (1,0) [0|0] "min" TOOL
 SG_ HEV_Batt_Min_Cell_Voltage m185 : 31|16@0+ (0.001,0) [0|0] "V" TOOL
 SG_ HEV_Batt_Max_Cell_Voltage m185 : 47|16@0+ (0.001,0) [0|0] "V" TOOL
 SG_ HEV_Batt_PWR_Available m186 : 24|8@1+ (0.392156862745098,0) [0|0] "%" TOOL
 SG_ HEV_Batt_Charge_Current_Limit m186 : 39|16@0- (0.1,0) [0|0] "A" TOOL
 SG_ HEV_Batt_Discharge_Current_Limit m186 : 55|16@0- (0.1,0) [0|0] "A" TOOL
 SG_ HVESPA_Enrg_In_SUP m187 : 24|1@1+ (1,0) [0|0] "" TOOL
 SG_ HVESPB_Enrg_In_SUP m187 : 25|1@1+ (1,0) [0|0] "" TOOL
 SG_ HVESPC_Enrg_In_SUP m187 : 26|1@1+ (1,0) [0|0] "" TOOL
 SG_ HVESPD_Enrg_In_SUP m187 : 27|1@1+ (1,0) [0|0] "" TOOL
 SG_ HVESPE_Enrg_In_SUP m187 : 28|1@1+ (1,0) [0|0] "" TOOL
 SG_ HVESPF_Enrg_In_SUP m187 : 29|1@1+ (1,0) [0|0] "" TOOL
 SG_ HVESPG_Enrg_In_SUP m187 : 30|1@1+ (1,0) [0|0] "" TOOL
 SG_ HVESPH_Enrg_In_SUP m187 : 31|1@1+ (1,0) [0|0] "" TOOL
 SG_ HVESS_Enrg_In m187 : 39|32@0+ (1,0) [0|0] "kWh" TOOL
 SG_ HVESPA_Enrg_In m187 : 71|32@0+ (1,0) [0|0] "kWh" TOOL
 SG_ HVESPB_Enrg_In m187 : 103|32@0+ (1,0) [0|0] "kWh" TOOL
 SG_ HVESPC_Enrg_In m187 : 135|32@0+ (1,0) [0|0] "kWh" TOOL
 SG_ HVESPD_Enrg_In m187 : 167|32@0+ (1,0) [0|0] "kWh" TOOL
 SG_ HVESPE_Enrg_In m187 : 199|32@0+ (1,0) [0|0] "kWh" TOOL
 SG_ HVESPF_Enrg_In m187 : 231|32@0+ (1,0) [0|0] "kWh" TOOL
 SG_ HVESPG_Enrg_In m187 : 263|32@0+ (1,0) [0|0] "kWh" TOOL
 SG_ HVESPH_Enrg_In m187 : 295|32@0+ (1,0) [0|0] "kWh" TOOL
 SG_ HVESPA_Enrg_Out_SUP m188 : 24|1@1+ (1,0) [0|0] "" TOOL
 SG_ HVESPB_Enrg_Out_SUP m188 : 25|1@1+ (1,0) [0|0] "" TOOL
 SG_ HVESPC_Enrg_Out_SUP m188 : 26|1@1+ (1,0) [0|0] "" TOOL
 SG_ HVESPD_Enrg_Out_SUP m188 : 27|1@1+ (1,0) [0|0] "" TOOL
 SG_ HVESPE_Enrg_Out_SUP m188 : 28|1@1+ (1,0) [0|0] "" TOOL
 SG_ HVESPF_Enrg_Out_SUP m188 : 29|1@1+ (1,0) [0|0] "" TOOL
 SG_ HVESPG_Enrg_Out_SUP m188 : 30|1@1+ (1,0) [0|0] "" TOOL
 SG_ HVESPH_Enrg_Out_SUP m188 : 31|1@1+ (1,0) [0|0] "" TOOL
 SG_ HVESS_Enrg_Out m188 : 39|32@0+ (1,0) [0|0] "kWh" TOOL
 SG_ HVESPA_Enrg_Out m188 : 71|32@0+ (1,0) [0|0] "kWh" TOOL
 SG_ HVESPB_Enrg_Out m188 : 103|32@0+ (1,0) [0|0] "kWh" TOOL
 SG_ HVESPC_Enrg_Out m188 : 135|32@0+ (1,0) [0|0] "kWh" TOOL
 SG_ HVESPD_Enrg_Out m188 : 167|32@0+ (1,0) [0|0] "kWh" TOOL
 SG_ HVESPE_Enrg_Out m188 : 199|32@0+ (1,0) [0|0] "kWh" TOOL
 SG_ HVESPF_Enrg_Out m188 : 231|32@0+ (1,0) [0|0] "kWh" TOOL
 SG_ HVESPG_Enrg_Out m188 : 263|32@0+ (1,0) [0|0] "kWh" TOOL
 SG_ HVESPH_Enrg_Out m188 : 295|32@0+ (1,0) [0|0] "kWh" TOOL
 SG_ HVESPA_Enrg_Tput_SUP m189 : 24|1@1+ (1,0) [0|0] "" TOOL
 SG_ HVESPB_Enrg_Tput_SUP m189 : 25|1@1+ (1,0) [0|0] "" TOOL
 SG_ HVESPC_Enrg_Tput_SUP m189 : 26|1@1+ (1,0) [0|0] "" TOOL
 SG_ HVESPD_Enrg_Tput_SUP m189 : 27|1@1+ (1,0) [0|0] "" TOOL
 SG_ HVESPE_Enrg_Tput_SUP m189 : 28|1@1+ (1,0) [0|0] "" TOOL
 SG_ HVESPF_Enrg_Tput_SUP m189 : 29|1@1+ (1,0) [0|0] "" TOOL
 SG_ HVESPG_Enrg_Tput_SUP m189 : 30|1@1+ (1,0) [0|0] "" TOOL
 SG_ HVESPH_Enrg_Tput_SUP m189 : 31|1@1+ (1,0) [0|0] "" TOOL
 SG_ HVESS_Enrg_Tput m189 : 39|32@0+ (100,0) [0|0] "Wh" TOOL
 SG_ HVESPA_Enrg_Tput m189 : 71|32@0+ (100,0) [0|0] "Wh" TOOL
 SG_ HVESPB_Enrg_Tput m189 : 103|32@0+ (100,0) [0|0] "Wh" TOOL
 SG_ HVESPC_Enrg_Tput m189 : 135|32@0+ (100,0) [0|0] "Wh" TOOL
 SG_ HVESPD_Enrg_Tput m189 : 167|32@0+ (100,0) [0|0] "Wh" TOOL
 SG_ HVESPE_Enrg_Tput m189 : 199|32@0+ (100,0) [0|0] "Wh" TOOL
 SG_ HVESPF_Enrg_Tput m189 : 231|32@0+ (100,0) [0|0] "Wh" TOOL
 SG_ HVESPG_Enrg_Tput m189 : 263|32@0+ (100,0) [0|0] "Wh" TOOL
 SG_ HVESPH_Enrg_Tput m189 : 295|32@0+ (100,0) [0|0] "Wh" TOOL
 SG_ HVESPA_SOH_SUP m190 : 24|1@1+ (1,0) [0|0] "" TOOL
 SG_ HVESPB_SOH_SUP m190 : 25|1@1+ (1,0) [0|0] "" TOOL
 SG_ HVESPC_SOH_SUP m190 : 26|1@1+ (1,0) [0|0] "" TOOL
 SG_ HVESPD_SOH_SUP m190 : 27|1@1+ (1,0) [0|0] "" TOOL
 SG_ HVESPE_SOH_SUP m190 : 28|1@1+ (1,0) [0|0] "" TOOL
 SG_ HVESPF_SOH_SUP m190 : 29|1@1+ (1,0) [0|0] "" TOOL
 SG_ HVESPG_SOH_SUP m190 : 30|1@1+ (1,0) [0|0] "" TOOL
 SG_ HVESPH_SOH_SUP m190 : 31|1@1+ (1,0) [0|0] "" TOOL
 SG_ HVESS_SOH m190 : 32|8@1+ (0.4,0) [0|0] "%" TOOL
 SG_ HVESPA_SOH m190 : 40|8@1+ (0.4,0) [0|0] "%" TOOL
 SG_ HVESPB_SOH m190 : 48|8@1+ (0.4,0) [0|0] "%" TOOL
 SG_ HVESPC_SOH m190 : 56|8@1+ (0.4,0) [0|0] "%" TOOL
 SG_ HVESPD_SOH m190 : 64|8@1+ (0.4,0) [0|0] "%" TOOL
 SG_ HVESPE_SOH m190 : 72|8@1+ (0.4,0) [0|0] "%" TOOL
 SG_ HVESPF_SOH m190 : 80|8@1+ (0.4,0) [0|0] "%" TOOL
 SG_ HVESPG_SOH m190 : 88|8@1+ (0.4,0) [0|0] "%" TOOL
 SG_ HVESPH_SOH m190 : 96|8@1+ (0.4,0) [0|0] "%" TOOL
 SG_ HVESPA_MIN_SOC_SUP m191 : 24|1@1+ (1,0) [0|0] "" TOOL
 SG_ HVESPB_MIN_SOC_SUP m191 : 25|1@1+ (1,0) [0|0] "" TOOL
 SG_ HVESPC_MIN_SOC_SUP m191 : 26|1@1+ (1,0) [0|0] "" TOOL
 SG_ HVESPD_MIN_SOC_SUP m191 : 27|1@1+ (1,0) [0|0] "" TOOL
 SG_ HVESPE_MIN_SOC_SUP m191 : 28|1@1+ (1,0) [0|0] "" TOOL
 SG_ HVESPF_MIN_SOC_SUP m191 : 29|1@1+ (1,0) [0|0] "" TOOL
 SG_ HVESPG_MIN_SOC_SUP m191 : 30|1@1+ (1,0) [0|0] "" TOOL
 SG_ HVESPH_MIN_SOC_SUP m191 : 31|1@1+ (1,0) [0|0] "" TOOL
 SG_ HVESS_MIN_SOC m191 : 39|16@0+ (0.0015625,0) [0|0] "%" TOOL
 SG_ HVESPA_MIN_SOC m191 : 55|16@0+ (0.0015625,0) [0|0] "%" TOOL
 SG_ HVESPB_MIN_SOC m191 : 71|16@0+ (0.0015625,0) [0|0] "%" TOOL
 SG_ HVESPC_MIN_SOC m191 : 87|16@0+ (0.0015625,0) [0|0] "%" TOOL
 SG_ HVESPD_MIN_SOC m191 : 103|16@0+ (0.0015625,0) [0|0] "%" TOOL
 SG_ HVESPE_MIN_SOC m191 : 119|16@0+ (0.0015625,0) [0|0] "%" TOOL
 SG_ HVESPF_MIN_SOC m191 : 135|16@0+ (0.0015625,0) [0|0] "%" TOOL
 SG_ HVESPG_MIN_SOC m191 : 151|16@0+ (0.0015625,0) [0|0] "%" TOOL
 SG_ HVESPH_MIN_SOC m191 : 167|16@0+ (0.0015625,0) [0|0] "%" TOOL
 SG_ HVESPA_MAX_SOC_SUP m193 : 24|1@1+ (1,0) [0|0] "" TOOL
 SG_ HVESPB_MAX_SOC_SUP m193 : 25|1@1+ (1,0) [0|0] "" TOOL
 SG_ HVESPC_MAX_SOC_SUP m193 : 26|1@1+ (1,0) [0|0] "" TOOL
 SG_ HVESPD_MAX_SOC_SUP m193 : 27|1@1+ (1,0) [0|0] "" TOOL
 SG_ HVESPE_MAX_SOC_SUP m193 : 28|1@1+ (1,0) [0|0] "" TOOL
 SG_ HVESPF_MAX_SOC_SUP m193 : 29|1@1+ (1,0) [0|0] "" TOOL
 SG_ HVESPG_MAX_SOC_SUP m193 : 30|1@1+ (1,0) [0|0] "" TOOL
 SG_ HVESPH_MAX_SOC_SUP m193 : 31|1@1+ (1,0) [0|0] "" TOOL
 SG_ HVESS_MAX_SOC m193 : 39|16@0+ (0.0015625,0) [0|0] "%" TOOL
 SG_ HVESPA_MAX_SOC m193 : 55|16@0+ (0.0015625,0) [0|0] "%" TOOL
 SG_ HVESPB_MAX_SOC m193 : 71|16@0+ (0.0015625,0) [0|0] "%" TOOL
 SG_ HVESPC_MAX_SOC m193 : 87|16@0+ (0.0015625,0) [0|0] "%" TOOL
 SG_ HVESPD_MAX_SOC m193 : 103|16@0+ (0.0015625,0) [0|0] "%" TOOL
 SG_ HVESPE_MAX_SOC m193 : 119|16@0+ (0.0015625,0) [0|0] "%" TOOL
 SG_ HVESPF_MAX_SOC m193 : 135|16@0+ (0.0015625,0) [0|0] "%" TOOL
 SG_ HVESPG_MAX_SOC m193 : 151|16@0+ (0.0015625,0) [0|0] "%" TOOL
 SG_ HVESPH_MAX_SOC m193 : 167|16@0+ (0.0015625,0) [0|0] "%" TOOL
 SG_ HVESPA_DEnrg_CAP_SUP m194 : 24|1@1+ (1,0) [0|0] "" TOOL
 SG_ HVESPB_DEnrg_CAP_SUP m194 : 25|1@1+ (1,0) [0|0] "" TOOL
 SG_ HVESPC_DEnrg_CAP_SUP m194 : 26|1@1+ (1,0) [0|0] "" TOOL
 SG_ HVESPD_DEnrg_CAP_SUP m194 : 27|1@1+ (1,0) [0|0] "" TOOL
 SG_ HVESPE_DEnrg_CAP_SUP m194 : 28|1@1+ (1,0) [0|0] "" TOOL
 SG_ HVESPF_DEnrg_CAP_SUP m194 : 29|1@1+ (1,0) [0|0] "" TOOL
 SG_ HVESPG_DEnrg_CAP_SUP m194 : 30|1@1+ (1,0) [0|0] "" TOOL
 SG_ HVESPH_DEnrg_CAP_SUP m194 : 31|1@1+ (1,0) [0|0] "" TOOL
 SG_ HVESS_DEnrg_CAP m194 : 39|24@0+ (0.001,0) [0|0] "kWh" TOOL
 SG_ HVESPA_DEnrg_CAP m194 : 63|24@0+ (0.001,0) [0|0] "kWh" TOOL
 SG_ HVESPB_DEnrg_CAP m194 : 87|24@0+ (0.001,0) [0|0] "kWh" TOOL
 SG_ HVESPC_DEnrg_CAP m194 : 111|24@0+ (0.001,0) [0|0] "kWh" TOOL
 SG_ HVESPD_DEnrg_CAP m194 : 135|24@0+ (0.001,0) [0|0] "kWh" TOOL
 SG_ HVESPE_DEnrg_CAP m194 : 159|24@0+ (0.001,0) [0|0] "kWh" TOOL
 SG_ HVESPF_DEnrg_CAP m194 : 183|24@0+ (0.001,0) [0|0] "kWh" TOOL
 SG_ HVESPG_DEnrg_CAP m194 : 207|24@0+ (0.001,0) [0|0] "kWh" TOOL
 SG_ HVESPH_DEnrg_CAP m194 : 231|24@0+ (0.001,0) [0|0] "kWh" TOOL
 SG_ FLI_A_SUP m195 : 24|1@1+ (1,0) [0|0] "" TOOL
 SG_ FLI_B_SUP m195 : 25|1@1+ (1,0) [0|0] "" TOOL
 SG_ FLI_A m195 : 32|8@1+ (1,0) [0|0] "" TOOL
 SG_ FLI_B m195 : 40|8@1+ (1,0) [0|0] "" TOOL
 SG_ EXH_PM_TIME m196 : 31|32@0+ (1,0) [0|0] "sec" TOOL
 SG_ EXH_PM_OCC_CNT m196 : 63|32@0+ (1,0) [0|0] "count" TOOL
 SG_ LFP_A_SUP m197 : 24|1@1+ (1,0) [0|0] "" TOOL
 SG_ LFP_B_SUP m197 : 25|1@1+ (1,0) [0|0] "" TOOL
 SG_ LFP_A m197 : 39|16@0+ (1,0) [0|0] "" TOOL
 SG_ LFP_B m197 : 55|16@0+ (1,0) [0|0] "" TOOL
 SG_ PM_WARN_ACT_SUP m198 : 24|1@1+ (1,0) [0|0] "" TOOL
 SG_ DPF_REMOVAL_BLOCKED_TIME_SUP m198 : 25|1@1+ (1,0) [0|0] "" TOOL
 SG_ LRIS_FAILURE_TIME_SUP m198 : 26|1@1+ (1,0) [0|0] "" TOOL
 SG_ PCD_FAILURE_TIME_SUP m198 : 27|1@1+ (1,0) [0|0] "" TOOL
 SG_ PM_WARN_ACT m198 : 32|1@1+ (1,0) [0|0] "" TOOL
 SG_ PCL_INDUC_L1 m198 : 33|2@1+ (1,0) [0|0] "" TOOL
 SG_ PCL_INDUC_L2 m198 : 35|2@1+ (1,0) [0|0] "" TOOL
 SG_ PCL_INDUC_L3 m198 : 37|2@1+ (1,0) [0|0] "" TOOL
 SG_ DPF_REMOVAL_BLOCKED_TIME m198 : 47|16@0+ (1,0) [0|0] "h" TOOL
 SG_ LRIS_FAILURE_TIME m198 : 63|16@0+ (1,0) [0|0] "h" TOOL
 SG_ PCD_FAILURE_TIME m198 : 79|16@0+ (1,0) [0|0] "h" TOOL
 SG_ REFLASH_DIST m199 : 31|16@0+ (1,0) [0|0] "km" TOOL
 SG_ NCD_PCD_WL m200 : 24|2@1+ (1,0) [0|0] "" TOOL
 SG_ NCD_WL m200 : 26|2@1+ (1,0) [0|0] "" TOOL
 SG_ PCD_WL m200 : 28|2@1+ (1,0) [0|0] "" TOOL
 SG_ O2S15_PCT_SUP m201 : 24|1@1+ (1,0) [0|0] "" TOOL
 SG_ O2S16_PCT_SUP m201 : 25|1@1+ (1,0) [0|0] "" TOOL
 SG_ O2S25_PCT_SUP m201 : 26|1@1+ (1,0) [0|0] "" TOOL
 SG_ O2S26_PCT_SUP m201 : 27|1@1+ (1,0) [0|0] "" TOOL
 SG_ O2S15_PCT_LAMBDA_SUP m201 : 28|1@1+ (1,0) [0|0] "" TOOL
 SG_ O2S16_PCT_LAMBDA_SUP m201 : 29|1@1+ (1,0) [0|0] "" TOOL
 SG_ O2S25_PCT_LAMBDA_SUP m201 : 30|1@1+ (1,0) [0|0] "" TOOL
 SG_ O2S26_PCT_LAMBDA_SUP m201 : 31|1@1+ (1,0) [0|0] "" TOOL
 SG_ O2S15_PCT m201 : 39|16@0+ (0.001526,0) [0|0] "%" TOOL
 SG_ O2S16_PCT m201 : 55|16@0+ (0.001526,0) [0|0] "%" TOOL
 SG_ O2S25_PCT m201 : 71|16@0+ (0.001526,0) [0|0] "%" TOOL
 SG_ O2S26_PCT m201 : 87|16@0+ (0.001526,0) [0|0] "%" TOOL
 SG_ O2S15_PCT_LAMBDA m201 : 103|16@0+ (0.000122,0) [0|0] "lambda" TOOL
 SG_ O2S16_PCT_LAMBDA m201 : 119|16@0+ (0.000122,0) [0|0] "lambda" TOOL
 SG_ O2S25_PCT_LAMBDA m201 : 135|16@0+ (0.000122,0) [0|0] "lambda" TOOL
 SG_ O2S26_PCT_LAMBDA m201 : 151|16@0+ (0.000122,0) [0|0] "lambda" TOOL
 SG_ TIME_TO_INDUC_L1_SUP m202 : 24|1@1+ (1,0) [0|0] "" TOOL
 SG_ TIME_TO_INDUC_L2_SUP m202 : 25|1@1+ (1,0) [0|0] "" TOOL
 SG_ TIME_TO_INDUC_L3_SUP m202 : 26|1@1+ (1,0) [0|0] "" TOOL
 SG_ TIME_TO_INDUC_L1 m202 : 39|16@0+ (1,0) [0|0] "min" TOOL
 SG_ TIME_TO_INDUC_L2 m202 : 55|16@0+ (1,0) [0|0] "min" TOOL
 SG_ TIME_TO_INDUC_L3 m202 : 71|16@0+ (1,0) [0|0] "min" TOOL
 SG_ EP_12_SUP m203 : 24|1@1+ (1,0) [0|0] "" TOOL
 SG_ EP_22_SUP m203 : 25|1@1+ (1,0) [0|0] "" TOOL
 SG_ EP_12 m203 : 39|16@1+ (0.01,0) [0|0] "kPa" TOOL
 SG_ EP_22 m203 : 55|16@1+ (0.01,0) [0|0] "kPa" TOOL
 SG_ EM_A_RPM_SUP m204 : 24|1@1+ (1,0) [0|0] "" TOOL
 SG_ EM_B_RPM_SUP m204 : 25|1@1+ (1,0) [0|0] "" TOOL
 SG_ EM_C_RPM_SUP m204 : 26|1@1+ (1,0) [0|0] "" TOOL
 SG_ EM_D_RPM_SUP m204 : 27|1@1+ (1,0) [0|0] "" TOOL
 SG_ EM_E_RPM_SUP m204 : 28|1@1+ (1,0) [0|0] "" TOOL
 SG_ EM_F_RPM_SUP m204 : 29|1@1+ (1,0) [0|0] "" TOOL
 SG_ EM_G_RPM_SUP m204 : 30|1@1+ (1,0) [0|0] "" TOOL
 SG_ EM_H_RPM_SUP m204 : 31|1@1+ (1,0) [0|0] "" TOOL
 SG_ EM_A_RPM m204 : 39|16@0+ (1,0) [0|0] "rpm" TOOL
 SG_ EM_B_RPM m204 : 55|16@0+ (1,0) [0|0] "rpm" TOOL
 SG_ EM_C_RPM m204 : 71|16@0+ (1,0) [0|0] "rpm" TOOL
 SG_ EM_D_RPM m204 : 87|16@0+ (1,0) [0|0] "rpm" TOOL
 SG_ EM_E_RPM m204 : 103|16@0+ (1,0) [0|0] "rpm" TOOL
 SG_ EM_F_RPM m204 : 119|16@0+ (1,0) [0|0] "rpm" TOOL
 SG_ EM_G_RPM m204 : 135|16@0+ (1,0) [0|0] "rpm" TOOL
 SG_ EM_H_RPM m204 : 151|16@0+ (1,0) [0|0] "rpm" TOOL
 SG_ EM_A_TQ_SUP m205 : 24|1@1+ (1,0) [0|0] "" TOOL
 SG_ EM_B_TQ_SUP m205 : 25|1@1+ (1,0) [0|0] "" TOOL
 SG_ EM_C_TQ_SUP m205 : 26|1@1+ (1,0) [0|0] "" TOOL
 SG_ EM_D_TQ_SUP m205 : 27|1@1+ (1,0) [0|0] "" TOOL
 SG_ EM_E_TQ_SUP m205 : 28|1@1+ (1,0) [0|0] "" TOOL
 SG_ EM_F_TQ_SUP m205 : 29|1@1+ (1,0) [0|0] "" TOOL
 SG_ EM_G_TQ_SUP m205 : 30|1@1+ (1,0) [0|0] "" TOOL
 SG_ EM_H_TQ_SUP m205 : 31|1@1+ (1,0) [0|0] "" TOOL
 SG_ EM_A_TQ m205 : 39|16@0+ (1,0) [0|0] "Nm" TOOL
 SG_ EM_B_TQ m205 : 55|16@0+ (1,0) [0|0] "Nm" TOOL
 SG_ EM_C_TQ m205 : 71|16@0+ (1,0) [0|0] "Nm" TOOL
 SG_ EM_D_TQ m205 : 87|16@0+ (1,0) [0|0] "Nm" TOOL
 SG_ EM_E_TQ m205 : 103|16@0+ (1,0) [0|0] "Nm" TOOL
 SG_ EM_F_TQ m205 : 119|16@0+ (1,0) [0|0] "Nm" TOOL
 SG_ EM_G_TQ m205 : 135|16@0+ (1,0) [0|0] "Nm" TOOL
 SG_ EM_H_TQ m205 : 151|16@0+ (1,0) [0|0] "Nm" TOOL
 SG_ FRNO m2 : 24|8@1+ (1,0) [0|0] "" TOOL
 SG_ S02_DTC_CNT m1 : 32|7@1+ (1,0) [0|0] "" TOOL
 SG_ S02_MIL m1 : 39|1@1+ (1,0) [0|0] "" TOOL
 SG_ S02_MIS_SUP m1 : 40|1@1+ (1,0) [0|0] "" TOOL
 SG_ S02_FUEL_SUP m1 : 41|1@1+ (1,0) [0|0] "" TOOL
 SG_ S02_CCM_SUP m1 : 42|1@1+ (1,0) [0|0] "" TOOL
 SG_ S02_CIM_SUP m1M : 43|1@1+ (1,0) [0|0] "" TOOL
 SG_ S02_MIS_RDY m1 : 44|1@1+ (1,0) [0|0] "" TOOL
 SG_ S02_FUEL_RDY m1 : 45|1@1+ (1,0) [0|0] "" TOOL
 SG_ S02_CCM_RDY m1 : 46|1@1+ (1,0) [0|0] "" TOOL
 SG_ S02_CAT_SUP m0 : 48|1@1+ (1,0) [0|0] "" TOOL
 SG_ S02_HCAT_SUP m0 : 49|1@1+ (1,0) [0|0] "" TOOL
 SG_ S02_EVAP_SUP m0 : 50|1@1+ (1,0) [0|0] "" TOOL
 SG_ S02_AIR_SUP m0 : 51|1@1+ (1,0) [0|0] "" TOOL
 SG_ S02_GPF_SUP m0 : 52|1@1+ (1,0) [0|0] "" TOOL
 SG_ S02_O2S_SUP m0 : 53|1@1+ (1,0) [0|0] "" TOOL
 SG_ S02_HTR_SUP m0 : 54|1@1+ (1,0) [0|0] "" TOOL
 SG_ S02_EGR_SUP m0 : 55|1@1+ (1,0) [0|0] "" TOOL
 SG_ S02_CAT_RDY m0 : 56|1@1+ (1,0) [0|0] "" TOOL
 SG_ S02_HCAT_RDY m0 : 57|1@1+ (1,0) [0|0] "" TOOL
 SG_ S02_EVAP_RDY m0 : 58|1@1+ (1,0) [0|0] "" TOOL
 SG_ S02_AIR_RDY m0 : 59|1@1+ (1,0) [0|0] "" TOOL
 SG_ S02_GPF_RDY m0 : 60|1@1+ (1,0) [0|0] "" TOOL
 SG_ S02_O2S_RDY m0 : 61|1@1+ (1,0) [0|0] "" TOOL
 SG_ S02_HTR_RDY m0 : 62|1@1+ (1,0) [0|0] "" TOOL
 SG_ S02_EGR_RDY m0 : 63|1@1+ (1,0) [0|0] "" TOOL
 SG_ S02_HCCATSUP m1 : 64|1@1+ (1,0) [0|0] "" TOOL
 SG_ S02_NCAT_SUP m1 : 65|1@1+ (1,0) [0|0] "" TOOL
 SG_ S02_BP_SUP m1 : 67|1@1+ (1,0) [0|0] "" TOOL
 SG_ S02_EGS_SUP m1 : 69|1@1+ (1,0) [0|0] "" TOOL
 SG_ S02_PM_SUP m1 : 70|1@1+ (1,0) [0|0] "" TOOL
 SG_ S02_HCCATRDY m1 : 72|1@1+ (1,0) [0|0] "" TOOL
 SG_ S02_NCAT_RDY m1 : 73|1@1+ (1,0) [0|0] "" TOOL
 SG_ S02_BP_RDY m1 : 75|1@1+ (1,0) [0|0] "" TOOL
 SG_ S02_EGS_RDY m1 : 77|1@1+ (1,0) [0|0] "" TOOL
 SG_ S02_PM_RDY m1 : 78|1@1+ (1,0) [0|0] "" TOOL
 SG_ S02_DTCFRZF m2 : 39|16@0+ (1,0) [0|0] "" TOOL
 SG_ S02_FUELSYSA_OL m3 : 32|1@1+ (1,0) [0|0] "" TOOL
 SG_ S02_FUELSYSA_CL m3 : 33|1@1+ (1,0) [0|0] "" TOOL
 SG_ S02_FUELSYSA_OL_Drive m3 : 34|1@1+ (1,0) [0|0] "" TOOL
 SG_ S02_FUELSYSA_OL_Fault m3 : 35|1@1+ (1,0) [0|0] "" TOOL
 SG_ S02_FUELSYSA_CL_Fault m3 : 36|1@1+ (1,0) [0|0] "" TOOL
 SG_ S02_FUELSYSA_OL_B2 m3 : 37|1@1+ (1,0) [0|0] "" TOOL
 SG_ S02_FUELSYSA_OL_Drive_B2 m3 : 38|1@1+ (1,0) [0|0] "" TOOL
 SG_ S02_FUELSYSA_OL_Fault_B2 m3 : 39|1@1+ (1,0) [0|0] "" TOOL
 SG_ S02_FUELSYSB_OL m3 : 40|1@1+ (1,0) [0|0] "" TOOL
 SG_ S02_FUELSYSB_CL m3 : 41|1@1+ (1,0) [0|0] "" TOOL
 SG_ S02_FUELSYSB_OL_Drive m3 : 42|1@1+ (1,0) [0|0] "" TOOL
 SG_ S02_FUELSYSB_OL_Fault m3 : 43|1@1+ (1,0) [0|0] "" TOOL
 SG_ S02_FUELSYSB_CL_Fault m3 : 44|1@1+ (1,0) [0|0] "" TOOL
 SG_ S02_FUELSYSB_OL_B2 m3 : 45|1@1+ (1,0) [0|0] "" TOOL
 SG_ S02_FUELSYSB_OL_Drive_B2 m3 : 46|1@1+ (1,0) [0|0] "" TOOL
 SG_ S02_FUELSYSB_OL_Fault_B2 m3 : 47|1@1+ (1,0) [0|0] "" TOOL
 SG_ S02_LOAD_PCT m4 : 32|8@1+ (0.3921569,0) [0|100] "%" TOOL
 SG_ S02_ECT m5 : 32|8@1+ (1,-40) [-40|215] "°C " TOOL
 SG_ S02_SHRTFT1 m6 : 32|8@1- (0.78125,0) [-100|99.21875] "%" TOOL
 SG_ S02_SHRTFT3 m6 : 40|8@1- (0.78125,0) [-100|99.21875] "%" TOOL
 SG_ S02_LONGFT1 m7 : 32|8@1- (0.78125,0) [-100|99.21875] "%" TOOL

SG_MUL_VAL_ 2024 S01_PID SID 1-1;
SG_MUL_VAL_ 2024 S02_PID SID 2-2;
SG_MUL_VAL_ 2024 S04_PID SID 4-4;
SG_MUL_VAL_ 2024 S05_PID SID 5-5;
SG_MUL_VAL_ 2024 S06_PID SID 6-6;
SG_MUL_VAL_ 2024 S07_PID SID 7-7;
SG_MUL_VAL_ 2024 S08_PID SID 8-8;
SG_MUL_VAL_ 2024 S09_PID SID 9-9;
SG_MUL_VAL_ 2024 S0A_PID SID 10-10;
SG_MUL_VAL_ 2024 S01_PID00_SupportedIDs_01_20 S01_PID 0-0;
SG_MUL_VAL_ 2024 S02_PID00_SupportedIDs_01_20 S02_PID 0-0;
SG_MUL_VAL_ 2024 S03_PID00_SupportedIDs_01_20 S03_PID 0-0;
SG_MUL_VAL_ 2024 S04_PID00_SupportedIDs_01_20 S04_PID 0-0;
SG_MUL_VAL_ 2024 S05_PID00_SupportedIDs_01_20 S05_PID 0-0;
SG_MUL_VAL_ 2024 S06_PID00_SupportedIDs_01_20 S06_PID 0-0;
SG_MUL_VAL_ 2024 S07_PID00_SupportedIDs_01_20 S07_PID 0-0;
SG_MUL_VAL_ 2024 S08_PID00_SupportedIDs_01_20 S08_PID 0-0;
SG_MUL_VAL_ 2024 S09_PID00_SupportedIDs_01_20 S09_PID 0-0;
SG_MUL_VAL_ 2024 S0A_PID00_SupportedIDs_01_20 S0A_PID 0-0;
SG_MUL_VAL_ 2024 S01_PID20_SupportedIDs_21_40 S01_PID 32-32;
SG_MUL_VAL_ 2024 S02_PID20_SupportedIDs_21_40 S02_PID 32-32;
SG_MUL_VAL_ 2024 S03_PID20_SupportedIDs_21_40 S03_PID 32-32;
SG_MUL_VAL_ 2024 S04_PID20_SupportedIDs_21_40 S04_PID 32-32;
SG_MUL_VAL_ 2024 S05_PID20_SupportedIDs_21_40 S05_PID 32-32;
SG_MUL_VAL_ 2024 S06_PID20_SupportedIDs_21_40 S06_PID 32-32;
SG_MUL_VAL_ 2024 S07_PID20_SupportedIDs_21_40 S07_PID 32-32;
SG_MUL_VAL_ 2024 S08_PID20_SupportedIDs_21_40 S08_PID 32-32;
SG_MUL_VAL_ 2024 S09_PID20_SupportedIDs_21_40 S09_PID 32-32;
SG_MUL_VAL_ 2024 S0A_PID20_SupportedIDs_21_40 S0A_PID 32-32;
SG_MUL_VAL_ 2024 S01_PID40_SupportedIDs_41_60 S01_PID 64-64;
SG_MUL_VAL_ 2024 S02_PID40_SupportedIDs_41_60 S02_PID 64-64;
SG_MUL_VAL_ 2024 S03_PID40_SupportedIDs_41_60 S03_PID 64-64;
SG_MUL_VAL_ 2024 S04_PID40_SupportedIDs_41_60 S04_PID 64-64;
SG_MUL_VAL_ 2024 S05_PID40_SupportedIDs_41_60 S05_PID 64-64;
SG_MUL_VAL_ 2024 S06_PID40_SupportedIDs_41_60 S06_PID 64-64;
SG_MUL_VAL_ 2024 S07_PID40_SupportedIDs_41_60 S07_PID 64-64;
SG_MUL_VAL_ 2024 S08_PID40_SupportedIDs_41_60 S08_PID 64-64;
SG_MUL_VAL_ 2024 S09_PID40_SupportedIDs_41_60 S09_PID 64-64;
SG_MUL_VAL_ 2024 S0A_PID40_SupportedIDs_41_60 S0A_PID 64-64;
SG_MUL_VAL_ 2024 S01_PID60_SupportedIDs_61_80 S01_PID 96-96;
SG_MUL_VAL_ 2024 S02_PID60_SupportedIDs_61_80 S02_PID 96-96;
SG_MUL_VAL_ 2024 S03_PID60_SupportedIDs_61_80 S03_PID 96-96;
SG_MUL_VAL_ 2024 S04_PID60_SupportedIDs_61_80 S04_PID 96-96;
SG_MUL_VAL_ 2024 S05_PID60_SupportedIDs_61_80 S05_PID 96-96;
SG_MUL_VAL_ 2024 S06_PID60_SupportedIDs_61_80 S06_PID 96-96;
SG_MUL_VAL_ 2024 S07_PID60_SupportedIDs_61_80 S07_PID 96-96;
SG_MUL_VAL_ 2024 S08_PID60_SupportedIDs_61_80 S08_PID 96-96;
SG_MUL_VAL_ 2024 S09_PID60_SupportedIDs_61_80 S09_PID 96-96;
SG_MUL_VAL_ 2024 S0A_PID60_SupportedIDs_61_80 S0A_PID 96-96;
SG_MUL_VAL_ 2024 S01_PID80_SupportedIDs_81_A0 S01_PID 128-128;
SG_MUL_VAL_ 2024 S02_PID80_SupportedIDs_81_A0 S02_PID 128-128;
SG_MUL_VAL_ 2024 S03_PID80_SupportedIDs_81_A0 S03_PID 128-128;
SG_MUL_VAL_ 2024 S04_PID80_SupportedIDs_81_A0 S04_PID 128-128;
SG_MUL_VAL_ 2024 S05_PID80_SupportedIDs_81_A0 S05_PID 128-128;
SG_MUL_VAL_ 2024 S06_PID80_SupportedIDs_81_A0 S06_PID 128-128;
SG_MUL_VAL_ 2024 S07_PID80_SupportedIDs_81_A0 S07_PID 128-128;
SG_MUL_VAL_ 2024 S08_PID80_SupportedIDs_81_A0 S08_PID 128-128;
SG_MUL_VAL_ 2024 S09_PID80_SupportedIDs_81_A0 S09_PID 128-128;
SG_MUL_VAL_ 2024 S0A_PID80_SupportedIDs_81_A0 S0A_PID 128-128;
SG_MUL_VAL_ 2024 S01_PIDA0_SupportedIDs_A1_C0 S01_PID 160-160;
SG_MUL_VAL_ 2024 S02_PIDA0_SupportedIDs_A1_C0 S02_PID 160-160;
SG_MUL_VAL_ 2024 S03_PIDA0_SupportedIDs_A1_C0 S03_PID 160-160;
SG_MUL_VAL_ 2024 S04_PIDA0_SupportedIDs_A1_C0 S04_PID 160-160;
SG_MUL_VAL_ 2024 S05_PIDA0_SupportedIDs_A1_C0 S05_PID 160-160;
SG_MUL_VAL_ 2024 S06_PIDA0_SupportedIDs_A1_C0 S06_PID 160-160;
SG_MUL_VAL_ 2024 S07_PIDA0_SupportedIDs_A1_C0 S07_PID 160-160;
SG_MUL_VAL_ 2024 S08_PIDA0_SupportedIDs_A1_C0 S08_PID 160-160;
SG_MUL_VAL_ 2024 S09_PIDA0_SupportedIDs_A1_C0 S09_PID 160-160;
SG_MUL_VAL_ 2024 S0A_PIDA0_SupportedIDs_A1_C0 S0A_PID 160-160;
SG_MUL_VAL_ 2024 S01_PIDC0_SupportedIDs_C1_E0 S01_PID 192-192;
SG_MUL_VAL_ 2024 S02_PIDC0_SupportedIDs_C1_E0 S02_PID 192-192;
SG_MUL_VAL_ 2024 S03_PIDC0_SupportedIDs_C1_E0 S03_PID 192-192;
SG_MUL_VAL_ 2024 S04_PIDC0_SupportedIDs_C1_E0 S04_PID 192-192;
SG_MUL_VAL_ 2024 S05_PIDC0_SupportedIDs_C1_E0 S05_PID 192-192;
SG_MUL_VAL_ 2024 S06_PIDC0_SupportedIDs_C1_E0 S06_PID 192-192;
SG_MUL_VAL_ 2024 S07_PIDC0_SupportedIDs_C1_E0 S07_PID 192-192;
SG_MUL_VAL_ 2024 S08_PIDC0_SupportedIDs_C1_E0 S08_PID 192-192;
SG_MUL_VAL_ 2024 S09_PIDC0_SupportedIDs_C1_E0 S09_PID 192-192;
SG_MUL_VAL_ 2024 S0A_PIDC0_SupportedIDs_C1_E0 S0A_PID 192-192;
SG_MUL_VAL_ 2024 DTC_CNT S01_PID 1-1;
SG_MUL_VAL_ 2024 MIL S01_PID 1-1;
SG_MUL_VAL_ 2024 MIS_SUP S01_PID 1-1;
SG_MUL_VAL_ 2024 FUEL_SUP S01_PID 1-1;
SG_MUL_VAL_ 2024 CCM_SUP S01_PID 1-1;
SG_MUL_VAL_ 2024 CIM_SUP S01_PID 1-1;
SG_MUL_VAL_ 2024 MIS_RDY S01_PID 1-1;
SG_MUL_VAL_ 2024 FUEL_RDY S01_PID 1-1;
SG_MUL_VAL_ 2024 CCM_RDY S01_PID 1-1;
SG_MUL_VAL_ 2024 CAT_SUP CIM_SUP 0-0;
SG_MUL_VAL_ 2024 HCAT_SUP CIM_SUP 0-0;
SG_MUL_VAL_ 2024 EVAP_SUP CIM_SUP 0-0;
SG_MUL_VAL_ 2024 AIR_SUP CIM_SUP 0-0;
SG_MUL_VAL_ 2024 GPF_SUP CIM_SUP 0-0;
SG_MUL_VAL_ 2024 O2S_SUP CIM_SUP 0-0;
SG_MUL_VAL_ 2024 HTR_SUP CIM_SUP 0-0;
SG_MUL_VAL_ 2024 EGR_SUP CIM_SUP 0-0;
SG_MUL_VAL_ 2024 CAT_RDY CIM_SUP 0-0;
SG_MUL_VAL_ 2024 HCAT_RDY CIM_SUP 0-0;
SG_MUL_VAL_ 2024 EVAP_RDY CIM_SUP 0-0;
SG_MUL_VAL_ 2024 AIR_RDY CIM_SUP 0-0;
SG_MUL_VAL_ 2024 GPF_RDY CIM_SUP 0-0;
SG_MUL_VAL_ 2024 O2S_RDY CIM_SUP 0-0;
SG_MUL_VAL_ 2024 HTR_RDY CIM_SUP 0-0;
SG_MUL_VAL_ 2024 EGR_RDY CIM_SUP 0-0;
SG_MUL_VAL_ 2024 HCCATSUP CIM_SUP 1-1;
SG_MUL_VAL_ 2024 NCAT_SUP CIM_SUP 1-1;
SG_MUL_VAL_ 2024 BP_SUP CIM_SUP 1-1;
SG_MUL_VAL_ 2024 EGS_SUP CIM_SUP 1-1;
SG_MUL_VAL_ 2024 PM_SUP CIM_SUP 1-1;
SG_MUL_VAL_ 2024 HCCATRDY CIM_SUP 1-1;
SG_MUL_VAL_ 2024 NCAT_RDY CIM_SUP 1-1;
SG_MUL_VAL_ 2024 BP_RDY CIM_SUP 1-1;
SG_MUL_VAL_ 2024 EGS_RDY CIM_SUP 1-1;
SG_MUL_VAL_ 2024 PM_RDY CIM_SUP 1-1;
SG_MUL_VAL_ 2024 DTCFRZF S01_PID 2-2;
SG_MUL_VAL_ 2024 FUELSYSA_OL S01_PID 3-3;
SG_MUL_VAL_ 2024 FUELSYSA_CL S01_PID 3-3;
SG_MUL_VAL_ 2024 FUELSYSA_OL_Drive S01_PID 3-3;
SG_MUL_VAL_ 2024 FUELSYSA_OL_Fault S01_PID 3-3;
SG_MUL_VAL_ 2024 FUELSYSA_CL_Fault S01_PID 3-3;
SG_MUL_VAL_ 2024 FUELSYSA_OL_B2 S01_PID 3-3;
SG_MUL_VAL_ 2024 FUELSYSA_OL_Drive_B2 S01_PID 3-3;
SG_MUL_VAL_ 2024 FUELSYSA_OL_Fault_B2 S01_PID 3-3;
SG_MUL_VAL_ 2024 FUELSYSB_OL S01_PID 3-3;
SG_MUL_VAL_ 2024 FUELSYSB_CL S01_PID 3-3;
SG_MUL_VAL_ 2024 FUELSYSB_OL_Drive S01_PID 3-3;
SG_MUL_VAL_ 2024 FUELSYSB_OL_Fault S01_PID 3-3;
SG_MUL_VAL_ 2024 FUELSYSB_CL_Fault S01_PID 3-3;
SG_MUL_VAL_ 2024 FUELSYSB_OL_B2 S01_PID 3-3;
SG_MUL_VAL_ 2024 FUELSYSB_OL_Drive_B2 S01_PID 3-3;
SG_MUL_VAL_ 2024 FUELSYSB_OL_Fault_B2 S01_PID 3-3;
SG_MUL_VAL_ 2024 LOAD_PCT S01_PID 4-4;
SG_MUL_VAL_ 2024 ECT S01_PID 5-5;
SG_MUL_VAL_ 2024 SHRTFT1 S01_PID 6-6;
SG_MUL_VAL_ 2024 SHRTFT3 S01_PID 6-6;
SG_MUL_VAL_ 2024 LONGFT1 S01_PID 7-7;
SG_MUL_VAL_ 2024 LONGFT3 S01_PID 7-7;
SG_MUL_VAL_ 2024 SHRTFT2 S01_PID 8-8;
SG_MUL_VAL_ 2024 SHRTFT4 S01_PID 8-8;
SG_MUL_VAL_ 2024 LONGFT2 S01_PID 9-9;
SG_MUL_VAL_ 2024 LONGFT4 S01_PID 9-9;
SG_MUL_VAL_ 2024 FPGAUGE S01_PID 10-10;
SG_MUL_VAL_ 2024 MAP S01_PID 11-11;
SG_MUL_VAL_ 2024 RPM S01_PID 12-12;
SG_MUL_VAL_ 2024 VSS S01_PID 13-13;
SG_MUL_VAL_ 2024 SPARKADV S01_PID 14-14;
SG_MUL_VAL_ 2024 IAT S01_PID 15-15;
SG_MUL_VAL_ 2024 MAF S01_PID 16-16;
SG_MUL_VAL_ 2024 TP S01_PID 17-17;
SG_MUL_VAL_ 2024 AIR_STAT_UPS S01_PID 18-18;
SG_MUL_VAL_ 2024 AIR_STAT_DNS S01_PID 18-18;
SG_MUL_VAL_ 2024 AIR_STAT_OFF S01_PID 18-18;
SG_MUL_VAL_ 2024 AIR_STAT_DIAG S01_PID 18-18;
SG_MUL_VAL_ 2024 O2SLOC_A1 S01_PID 19-19;
SG_MUL_VAL_ 2024 O2SLOC_A2 S01_PID 19-19;
SG_MUL_VAL_ 2024 O2SLOC_A3 S01_PID 19-19;
SG_MUL_VAL_ 2024 O2SLOC_A4 S01_PID 19-19;
SG_MUL_VAL_ 2024 O2SLOC_A5 S01_PID 19-19;
SG_MUL_VAL_ 2024 O2SLOC_A6 S01_PID 19-19;
SG_MUL_VAL_ 2024 O2SLOC_A7 S01_PID 19-19;
SG_MUL_VAL_ 2024 O2SLOC_A8 S01_PID 19-19;
SG_MUL_VAL_ 2024 O2S1 S01_PID 20-20;
SG_MUL_VAL_ 2024 SHRTFT11 S01_PID 20-20;
SG_MUL_VAL_ 2024 O2S2 S01_PID 21-21;
SG_MUL_VAL_ 2024 SHRTFT12 S01_PID 21-21;
SG_MUL_VAL_ 2024 O2S3 S01_PID 22-22;
SG_MUL_VAL_ 2024 SHRTFT13 S01_PID 22-22;
SG_MUL_VAL_ 2024 O2S4 S01_PID 23-23;
SG_MUL_VAL_ 2024 SHRTFT14 S01_PID 23-23;
SG_MUL_VAL_ 2024 O2S5 S01_PID 24-24;
SG_MUL_VAL_ 2024 SHRTFT15 S01_PID 24-24;
SG_MUL_VAL_ 2024 O2S6 S01_PID 25-25;
SG_MUL_VAL_ 2024 SHRTFT16 S01_PID 25-25;
SG_MUL_VAL_ 2024 O2S7 S01_PID 26-26;
SG_MUL_VAL_ 2024 SHRTFT17 S01_PID 26-26;
SG_MUL_VAL_ 2024 O2S8 S01_PID 27-27;
SG_MUL_VAL_ 2024 SHRTFT8 S01_PID 27-27;
SG_MUL_VAL_ 2024 OBDSUP S01_PID 28-28;
SG_MUL_VAL_ 2024 O2SLOC_B1 S01_PID 29-29;
SG_MUL_VAL_ 2024 O2SLOC_B2 S01_PID 29-29;
SG_MUL_VAL_ 2024 O2SLOC_B3 S01_PID 29-29;
SG_MUL_VAL_ 2024 O2SLOC_B4 S01_PID 29-29;
SG_MUL_VAL_ 2024 O2SLOC_B5 S01_PID 29-29;
SG_MUL_VAL_ 2024 O2SLOC_B6 S01_PID 29-29;
SG_MUL_VAL_ 2024 O2SLOC_B7 S01_PID 29-29;
SG_MUL_VAL_ 2024 O2SLOC_B8 S01_PID 29-29;
SG_MUL_VAL_ 2024 PTO_STAT S01_PID 30-30;
SG_MUL_VAL_ 2024 RUNTM S01_PID 31-31;
SG_MUL_VAL_ 2024 MIL_DIST S01_PID 33-33;
SG_MUL_VAL_ 2024 FP S01_PID 34-34;
SG_MUL_VAL_ 2024 FRP S01_PID 35-35;
SG_MUL_VAL_ 2024 LAMBDA_WRV1 S01_PID 36-36;
SG_MUL_VAL_ 2024 O2S_WRV1 S01_PID 36-36;
SG_MUL_VAL_ 2024 LAMBDA_WRV2 S01_PID 37-37;
SG_MUL_VAL_ 2024 O2S_WRV2 S01_PID 37-37;
SG_MUL_VAL_ 2024 LAMBDA_WRV3 S01_PID 38-38;
SG_MUL_VAL_ 2024 O2S_WRV3 S01_PID 38-38;
SG_MUL_VAL_ 2024 LAMBDA_WRV4 S01_PID 39-39;
SG_MUL_VAL_ 2024 O2S_WRV4 S01_PID 39-39;
SG_MUL_VAL_ 2024 LAMBDA_WRV5 S01_PID 40-40;
SG_MUL_VAL_ 2024 O2S_WRV5 S01_PID 40-40;
SG_MUL_VAL_ 2024 LAMBDA_WRV6 S01_PID 41-41;
SG_MUL_VAL_ 2024 O2S_WRV6 S01_PID 41-41;
SG_MUL_VAL_ 2024 LAMBDA_WRV7 S01_PID 42-42;
SG_MUL_VAL_ 2024 O2S_WRV7 S01_PID 42-42;
SG_MUL_VAL_ 2024 LAMBDA_WRV8 S01_PID 43-43;
SG_MUL_VAL_ 2024 O2S_WRV8 S01_PID 43-43;
SG_MUL_VAL_ 2024 EGR_PCT S01_PID 44-44;
SG_MUL_VAL_ 2024 EGR_ERR S01_PID 45-45;
SG_MUL_VAL_ 2024 EVAP_PCT S01_PID 46-46;
SG_MUL_VAL_ 2024 FLI S01_PID 47-47;
SG_MUL_VAL_ 2024 WARM_UPS S01_PID 48-48;
SG_MUL_VAL_ 2024 CLR_DIST S01_PID 49-49;
SG_MUL_VAL_ 2024 EVAP_VP S01_PID 50-50;
SG_MUL_VAL_ 2024 BARO S01_PID 51-51;
SG_MUL_VAL_ 2024 LAMBDA_WRC1 S01_PID 52-52;
SG_MUL_VAL_ 2024 O2S_WRC1 S01_PID 52-52;
SG_MUL_VAL_ 2024 LAMBDA_WRC2 S01_PID 53-53;
SG_MUL_VAL_ 2024 O2S_WRC2 S01_PID 53-53;
SG_MUL_VAL_ 2024 LAMBDA_WRC3 S01_PID 54-54;
SG_MUL_VAL_ 2024 O2S_WRC3 S01_PID 54-54;
SG_MUL_VAL_ 2024 LAMBDA_WRC4 S01_PID 55-55;
SG_MUL_VAL_ 2024 O2S_WRC4 S01_PID 55-55;
SG_MUL_VAL_ 2024 LAMBDA_WRC5 S01_PID 56-56;
SG_MUL_VAL_ 2024 O2S_WRC5 S01_PID 56-56;
SG_MUL_VAL_ 2024 LAMBDA_WRC6 S01_PID 57-57;
SG_MUL_VAL_ 2024 O2S_WRC6 S01_PID 57-57;
SG_MUL_VAL_ 2024 LAMBDA_WRC7 S01_PID 58-58;
SG_MUL_VAL_ 2024 O2S_WRC7 S01_PID 58-58;
SG_MUL_VAL_ 2024 LAMBDA_WRC8 S01_PID 59-59;
SG_MUL_VAL_ 2024 O2S_WRC8 S01_PID 59-59;
SG_MUL_VAL_ 2024 CATEMP11 S01_PID 60-60;
SG_MUL_VAL_ 2024 CATEMP21 S01_PID 61-61;
SG_MUL_VAL_ 2024 CATEMP12 S01_PID 62-62;
SG_MUL_VAL_ 2024 CATEMP22 S01_PID 63-63;
SG_MUL_VAL_ 2024 MIS_ENA S01_PID 65-65;
SG_MUL_VAL_ 2024 FUEL_ENA S01_PID 65-65;
SG_MUL_VAL_ 2024 CCM_ENA S01_PID 65-65;
SG_MUL_VAL_ 2024 PID41_CIM_SUP S01_PID 65-65;
SG_MUL_VAL_ 2024 MIS_CMPL S01_PID 65-65;
SG_MUL_VAL_ 2024 FUELCMPL S01_PID 65-65;
SG_MUL_VAL_ 2024 CCM_CMPL S01_PID 65-65;
SG_MUL_VAL_ 2024 CAT_ENA PID41_CIM_SUP 0-0;
SG_MUL_VAL_ 2024 HCAT_ENA PID41_CIM_SUP 0-0;
SG_MUL_VAL_ 2024 EVAP_ENA PID41_CIM_SUP 0-0;
SG_MUL_VAL_ 2024 AIR_ENA PID41_CIM_SUP 0-0;
SG_MUL_VAL_ 2024 GPF_ENA PID41_CIM_SUP 0-0;
SG_MUL_VAL_ 2024 O2S_ENA PID41_CIM_SUP 0-0;
SG_MUL_VAL_ 2024 HTR_ENA PID41_CIM_SUP 0-0;
SG_MUL_VAL_ 2024 EGR_ENA PID41_CIM_SUP 0-0;
SG_MUL_VAL_ 2024 CAT_CMPL PID41_CIM_SUP 0-0;
SG_MUL_VAL_ 2024 HCATCMPL PID41_CIM_SUP 0-0;
SG_MUL_VAL_ 2024 EVAPCMPL PID41_CIM_SUP 0-0;
SG_MUL_VAL_ 2024 AIR_CMPL PID41_CIM_SUP 0-0;
SG_MUL_VAL_ 2024 GPF_CMPL PID41_CIM_SUP 0-0;
SG_MUL_VAL_ 2024 O2S_CMPL PID41_CIM_SUP 0-0;
SG_MUL_VAL_ 2024 HTR_CMPL PID41_CIM_SUP 0-0;
SG_MUL_VAL_ 2024 EGR_CMPL PID41_CIM_SUP 0-0;
SG_MUL_VAL_ 2024 HCCATENA PID41_CIM_SUP 1-1;
SG_MUL_VAL_ 2024 NCAT_ENA PID41_CIM_SUP 1-1;
SG_MUL_VAL_ 2024 BP_ENA PID41_CIM_SUP 1-1;
SG_MUL_VAL_ 2024 EGS_ENA PID41_CIM_SUP 1-1;
SG_MUL_VAL_ 2024 PM_ENA PID41_CIM_SUP 1-1;
SG_MUL_VAL_ 2024 HCCATCMP PID41_CIM_SUP 1-1;
SG_MUL_VAL_ 2024 NCATCMPL PID41_CIM_SUP 1-1;
SG_MUL_VAL_ 2024 BP_CMPL PID41_CIM_SUP 1-1;
SG_MUL_VAL_ 2024 EGS_CMPL PID41_CIM_SUP 1-1;
SG_MUL_VAL_ 2024 PM_CMPL PID41_CIM_SUP 1-1;
SG_MUL_VAL_ 2024 VPWR S01_PID 66-66;
SG_MUL_VAL_ 2024 LOAD_ABS S01_PID 67-67;
SG_MUL_VAL_ 2024 EQ_RAT S01_PID 68-68;
SG_MUL_VAL_ 2024 TP_R S01_PID 69-69;
SG_MUL_VAL_ 2024 AAT S01_PID 70-70;
SG_MUL_VAL_ 2024 TP_B S01_PID 71-71;
SG_MUL_VAL_ 2024 TP_C S01_PID 72-72;
SG_MUL_VAL_ 2024 APP_D S01_PID 73-73;
SG_MUL_VAL_ 2024 APP_E S01_PID 74-74;
SG_MUL_VAL_ 2024 APP_F S01_PID 75-75;
SG_MUL_VAL_ 2024 TAC_PCT S01_PID 76-76;
SG_MUL_VAL_ 2024 MIL_TIME S01_PID 77-77;
SG_MUL_VAL_ 2024 CLR_TIME S01_PID 78-78;
SG_MUL_VAL_ 2024 ER_MAX S01_PID 79-79;
SG_MUL_VAL_ 2024 O2SV_MAX S01_PID 79-79;
SG_MUL_VAL_ 2024 O2SC_MAX S01_PID 79-79;
SG_MUL_VAL_ 2024 IMAP_MAX S01_PID 79-79;
SG_MUL_VAL_ 2024 AFR_MAX S01_PID 80-80;
SG_MUL_VAL_ 2024 FUEL_TYP S01_PID 81-81;
SG_MUL_VAL_ 2024 ALCH_PCT S01_PID 82-82;
SG_MUL_VAL_ 2024 EVAP_VPA S01_PID 83-83;
SG_MUL_VAL_ 2024 EVAP_VP2 S01_PID 84-84;
SG_MUL_VAL_ 2024 STSO2FT1 S01_PID 85-85;
SG_MUL_VAL_ 2024 STSO2FT3 S01_PID 85-85;
SG_MUL_VAL_ 2024 LGSO2FT1 S01_PID 86-86;
SG_MUL_VAL_ 2024 LGSO2FT3 S01_PID 86-86;
SG_MUL_VAL_ 2024 STSO2FT2 S01_PID 87-87;
SG_MUL_VAL_ 2024 STSO2FT4 S01_PID 87-87;
SG_MUL_VAL_ 2024 LGSO2FT2 S01_PID 88-88;
SG_MUL_VAL_ 2024 LGSO2FT4 S01_PID 88-88;
SG_MUL_VAL_ 2024 FRP2 S01_PID 89-89;
SG_MUL_VAL_ 2024 APP_R S01_PID 90-90;
SG_MUL_VAL_ 2024 BAT_PWR S01_PID 91-91;
SG_MUL_VAL_ 2024 EOT S01_PID 92-92;
SG_MUL_VAL_ 2024 FUEL_TIMING S01_PID 93-93;
SG_MUL_VAL_ 2024 FUEL_RATE S01_PID 94-94;
SG_MUL_VAL_ 2024 EMIS_SUP S01_PID 95-95;
SG_MUL_VAL_ 2024 TQ_DD S01_PID 97-97;
SG_MUL_VAL_ 2024 TQ_ACT S01_PID 98-98;
SG_MUL_VAL_ 2024 TQ_REF S01_PID 99-99;
SG_MUL_VAL_ 2024 TQ_MAX1 S01_PID 100-100;
SG_MUL_VAL_ 2024 TQ_MAX2 S01_PID 100-100;
SG_MUL_VAL_ 2024 TQ_MAX3 S01_PID 100-100;
SG_MUL_VAL_ 2024 TQ_MAX4 S01_PID 100-100;
SG_MUL_VAL_ 2024 TQ_MAX5 S01_PID 100-100;
SG_MUL_VAL_ 2024 PTO_STAT_SUP S01_PID 101-101;
SG_MUL_VAL_ 2024 ND_STAT_SUP S01_PID 101-101;
SG_MUL_VAL_ 2024 NG_STAT_SUP S01_PID 101-101;
SG_MUL_VAL_ 2024 GPL_STAT_SUP S01_PID 101-101;
SG_MUL_VAL_ 2024 GEAR_RCMD_SUP S01_PID 101-101;
SG_MUL_VAL_ 2024 PTO_STAT2 S01_PID 101-101;
SG_MUL_VAL_ 2024 ND_STAT S01_PID 101-101;
SG_MUL_VAL_ 2024 NG_STAT S01_PID 101-101;
SG_MUL_VAL_ 2024 GPL_STAT S01_PID 101-101;
SG_MUL_VAL_ 2024 GEAR_RCMD S01_PID 101-101;
SG_MUL_VAL_ 2024 MAFA_SUP S01_PID 102-102;
SG_MUL_VAL_ 2024 MAFB_SUP S01_PID 102-102;
SG_MUL_VAL_ 2024 MAFA S01_PID 102-102;
SG_MUL_VAL_ 2024 MAFB S01_PID 102-102;
SG_MUL_VAL_ 2024 ECT1_SUP S01_PID 103-103;
SG_MUL_VAL_ 2024 ECT2_SUP S01_PID 103-103;
SG_MUL_VAL_ 2024 ECT1 S01_PID 103-103;
SG_MUL_VAL_ 2024 ECT2 S01_PID 103-103;
SG_MUL_VAL_ 2024 IAT11_SUP S01_PID 104-104;
SG_MUL_VAL_ 2024 IAT12_SUP S01_PID 104-104;
SG_MUL_VAL_ 2024 IAT13_SUP S01_PID 104-104;
SG_MUL_VAL_ 2024 IAT21_SUP S01_PID 104-104;
SG_MUL_VAL_ 2024 IAT22_SUP S01_PID 104-104;
SG_MUL_VAL_ 2024 IAT23_SUP S01_PID 104-104;
SG_MUL_VAL_ 2024 IAT11 S01_PID 104-104;
SG_MUL_VAL_ 2024 IAT12 S01_PID 104-104;
SG_MUL_VAL_ 2024 IAT13 S01_PID 104-104;
SG_MUL_VAL_ 2024 IAT21 S01_PID 104-104;
SG_MUL_VAL_ 2024 IAT22 S01_PID 104-104;
SG_MUL_VAL_ 2024 IAT23 S01_PID 104-104;
SG_MUL_VAL_ 2024 EGR_A_CMD_SUP S01_PID 105-105;
SG_MUL_VAL_ 2024 EGR_A_ACT_SUP S01_PID 105-105;
SG_MUL_VAL_ 2024 EGR_A_ERR_SUP S01_PID 105-105;
SG_MUL_VAL_ 2024 EGR_B_CMD_SUP S01_PID 105-105;
SG_MUL_VAL_ 2024 EGR_B_ACT_SUP S01_PID 105-105;
SG_MUL_VAL_ 2024 EGR_B_ERR_SUP S01_PID 105-105;
SG_MUL_VAL_ 2024 EGR_A_CMD S01_PID 105-105;
SG_MUL_VAL_ 2024 EGR_A_ACT S01_PID 105-105;
SG_MUL_VAL_ 2024 EGR_A_ERR S01_PID 105-105;
SG_MUL_VAL_ 2024 EGR_B_CMD S01_PID 105-105;
SG_MUL_VAL_ 2024 EGR_B_ACT S01_PID 105-105;
SG_MUL_VAL_ 2024 EGR_B_ERR S01_PID 105-105;
SG_MUL_VAL_ 2024 IAF_A_CMD_SUP S01_PID 106-106;
SG_MUL_VAL_ 2024 IAF_A_REL_SUP S01_PID 106-106;
SG_MUL_VAL_ 2024 IAF_B_CMD_SUP S01_PID 106-106;
SG_MUL_VAL_ 2024 IAF_B_REL_SUP S01_PID 106-106;
SG_MUL_VAL_ 2024 IAF_A_CMD S01_PID 106-106;
SG_MUL_VAL_ 2024 IAF_A_REL S01_PID 106-106;
SG_MUL_VAL_ 2024 IAF_B_CMD S01_PID 106-106;
SG_MUL_VAL_ 2024 IAF_B_REL S01_PID 106-106;
SG_MUL_VAL_ 2024 EGRTA_SUP S01_PID 107-107;
SG_MUL_VAL_ 2024 EGRTC_SUP S01_PID 107-107;
SG_MUL_VAL_ 2024 EGRTB_SUP S01_PID 107-107;
SG_MUL_VAL_ 2024 EGRTD_SUP S01_PID 107-107;
SG_MUL_VAL_ 2024 EGRTA_WR_SUP S01_PID 107-107;
SG_MUL_VAL_ 2024 EGRTC_WR_SUP S01_PID 107-107;
SG_MUL_VAL_ 2024 EGRTB_WR_SUP S01_PID 107-107;
SG_MUL_VAL_ 2024 EGRTD_WR_SUP S01_PID 107-107;
SG_MUL_VAL_ 2024 EGRTA EGRTA_SUP 1-1;
SG_MUL_VAL_ 2024 EGRTC EGRTC_SUP 1-1;
SG_MUL_VAL_ 2024 EGRTB EGRTB_SUP 1-1;
SG_MUL_VAL_ 2024 EGRTD EGRTD_SUP 1-1;
SG_MUL_VAL_ 2024 EGRTA_WR EGRTA_SUP 0-0;
SG_MUL_VAL_ 2024 EGRTC_WR EGRTC_SUP 0-0;
SG_MUL_VAL_ 2024 EGRTB_WR EGRTB_SUP 0-0;
SG_MUL_VAL_ 2024 EGRTD_WR EGRTD_SUP 0-0;
SG_MUL_VAL_ 2024 TAC_A_CMD_SUP S01_PID 108-108;
SG_MUL_VAL_ 2024 TP_A_REL_SUP S01_PID 108-108;
SG_MUL_VAL_ 2024 TAC_B_CMD_SUP S01_PID 108-108;
SG_MUL_VAL_ 2024 TP_B_REL_SUP S01_PID 108-108;
SG_MUL_VAL_ 2024 TAC_A_CMD S01_PID 108-108;
SG_MUL_VAL_ 2024 TP_A_REL S01_PID 108-108;
SG_MUL_VAL_ 2024 TAC_B_CMD S01_PID 108-108;
SG_MUL_VAL_ 2024 TP_B_REL S01_PID 108-108;
SG_MUL_VAL_ 2024 FRP_A_CMD_SUP S01_PID 109-109;
SG_MUL_VAL_ 2024 FRP_A_SUP S01_PID 109-109;
SG_MUL_VAL_ 2024 FRT_A_SUP S01_PID 109-109;
SG_MUL_VAL_ 2024 FRP_B_CMD_SUP S01_PID 109-109;
SG_MUL_VAL_ 2024 FRP_B_SUP S01_PID 109-109;
SG_MUL_VAL_ 2024 FRT_B_SUP S01_PID 109-109;
SG_MUL_VAL_ 2024 FRP_A_CMD S01_PID 109-109;
SG_MUL_VAL_ 2024 FRP_A S01_PID 109-109;
SG_MUL_VAL_ 2024 FRT_A  S01_PID 109-109;
SG_MUL_VAL_ 2024 FRP_B_CMD S01_PID 109-109;
SG_MUL_VAL_ 2024 FRP_B S01_PID 109-109;
SG_MUL_VAL_ 2024 FRT_B S01_PID 109-109;
SG_MUL_VAL_ 2024 ICP_A_CMD_SUP S01_PID 110-110;
SG_MUL_VAL_ 2024 ICP_A_SUP S01_PID 110-110;
SG_MUL_VAL_ 2024 ICP_B_CMD_SUP S01_PID 110-110;
SG_MUL_VAL_ 2024 ICP_B_SUP S01_PID 110-110;
SG_MUL_VAL_ 2024 ICP_A_CMD S01_PID 110-110;
SG_MUL_VAL_ 2024 ICP_A S01_PID 110-110;
SG_MUL_VAL_ 2024 ICP_B_CMD S01_PID 110-110;
SG_MUL_VAL_ 2024 ICP_B S01_PID 110-110;
SG_MUL_VAL_ 2024 TCA_CINP_SUP S01_PID 111-111;
SG_MUL_VAL_ 2024 TCB_CINP_SUP S01_PID 111-111;
SG_MUL_VAL_ 2024 TCA_CINP_WR_SUP S01_PID 111-111;
SG_MUL_VAL_ 2024 TCB_CINP_WR_SUP S01_PID 111-111;
SG_MUL_VAL_ 2024 TCA_CINP TCA_CINP_SUP 1-1;
SG_MUL_VAL_ 2024 TCB_CINP TCB_CINP_SUP 1-1;
SG_MUL_VAL_ 2024 TCA_CINP_WR TCA_CINP_SUP 0-0;
SG_MUL_VAL_ 2024 TCB_CINP_WR TCB_CINP_SUP 0-0;
SG_MUL_VAL_ 2024 BP_A_CMD_SUP S01_PID 112-112;
SG_MUL_VAL_ 2024 BP_A_ACT_SUP S01_PID 112-112;
SG_MUL_VAL_ 2024 BP_A_SUP S01_PID 112-112;
SG_MUL_VAL_ 2024 BP_B_CMD_SUP S01_PID 112-112;
SG_MUL_VAL_ 2024 BP_B_ACT_SUP S01_PID 112-112;
SG_MUL_VAL_ 2024 BP_B_SUP S01_PID 112-112;
SG_MUL_VAL_ 2024 BP_A_CMD S01_PID 112-112;
SG_MUL_VAL_ 2024 BP_A_ACT S01_PID 112-112;
SG_MUL_VAL_ 2024 BP_B_CMD S01_PID 112-112;
SG_MUL_VAL_ 2024 BP_B_ACT S01_PID 112-112;
SG_MUL_VAL_ 2024 BP_A S01_PID 112-112;
SG_MUL_VAL_ 2024 BP_B S01_PID 112-112;
SG_MUL_VAL_ 2024 VGT_A_CMD_SUP S01_PID 113-113;
SG_MUL_VAL_ 2024 VGT_A_ACT_SUP S01_PID 113-113;
SG_MUL_VAL_ 2024 VGT_A_SUP S01_PID 113-113;
SG_MUL_VAL_ 2024 VGT_B_CMD_SUP S01_PID 113-113;
SG_MUL_VAL_ 2024 VGT_B_ACT_SUP S01_PID 113-113;
SG_MUL_VAL_ 2024 VGT_B_SUP S01_PID 113-113;
SG_MUL_VAL_ 2024 VGT_A_CMD S01_PID 113-113;
SG_MUL_VAL_ 2024 VGT_A_ACT S01_PID 113-113;
SG_MUL_VAL_ 2024 VGT_B_CMD S01_PID 113-113;
SG_MUL_VAL_ 2024 VGT_B_ACT S01_PID 113-113;
SG_MUL_VAL_ 2024 VGT_A S01_PID 113-113;
SG_MUL_VAL_ 2024 VGT_B S01_PID 113-113;
SG_MUL_VAL_ 2024 WG_A_CMD_SUP S01_PID 114-114;
SG_MUL_VAL_ 2024 WG_A_ACT_SUP S01_PID 114-114;
SG_MUL_VAL_ 2024 WG_B_CMD_SUP S01_PID 114-114;
SG_MUL_VAL_ 2024 WG_B_ACT_SUP S01_PID 114-114;
SG_MUL_VAL_ 2024 WG_A_CMD S01_PID 114-114;
SG_MUL_VAL_ 2024 WG_A_ACT S01_PID 114-114;
SG_MUL_VAL_ 2024 WG_B_CMD S01_PID 114-114;
SG_MUL_VAL_ 2024 WG_B_ACT S01_PID 114-114;
SG_MUL_VAL_ 2024 EP_11_SUP S01_PID 115-115;
SG_MUL_VAL_ 2024 EP_21_SUP S01_PID 115-115;
SG_MUL_VAL_ 2024 EP_11 S01_PID 115-115;
SG_MUL_VAL_ 2024 EP_21 S01_PID 115-115;
SG_MUL_VAL_ 2024 TCA_RPM_SUP S01_PID 116-116;
SG_MUL_VAL_ 2024 TCB_RPM_SUP S01_PID 116-116;
SG_MUL_VAL_ 2024 TCA_RPM S01_PID 116-116;
SG_MUL_VAL_ 2024 TCB_RPM S01_PID 116-116;
SG_MUL_VAL_ 2024 TCA_CINT_SUP S01_PID 117-117;
SG_MUL_VAL_ 2024 TCA_COUTT_SUP S01_PID 117-117;
SG_MUL_VAL_ 2024 TCA_TINT_SUP S01_PID 117-117;
SG_MUL_VAL_ 2024 TCA_TOUTT_SUP S01_PID 117-117;
SG_MUL_VAL_ 2024 TCA_CINT S01_PID 117-117;
SG_MUL_VAL_ 2024 TCA_COUTT S01_PID 117-117;
SG_MUL_VAL_ 2024 TCA_TINT S01_PID 117-117;
SG_MUL_VAL_ 2024 TCA_TOUTT S01_PID 117-117;
SG_MUL_VAL_ 2024 CACT_11_SUP S01_PID 119-119;
SG_MUL_VAL_ 2024 CACT_12_SUP S01_PID 119-119;
SG_MUL_VAL_ 2024 CACT_21_SUP S01_PID 119-119;
SG_MUL_VAL_ 2024 CACT_22_SUP S01_PID 119-119;
SG_MUL_VAL_ 2024 CACT_11 S01_PID 119-119;
SG_MUL_VAL_ 2024 CACT_12 S01_PID 119-119;
SG_MUL_VAL_ 2024 CACT_21 S01_PID 119-119;
SG_MUL_VAL_ 2024 CACT_22 S01_PID 119-119;
SG_MUL_VAL_ 2024 EGT11_SUP S01_PID 120-120;
SG_MUL_VAL_ 2024 EGT12_SUP S01_PID 120-120;
SG_MUL_VAL_ 2024 EGT13_SUP S01_PID 120-120;
SG_MUL_VAL_ 2024 EGT14_SUP S01_PID 120-120;
SG_MUL_VAL_ 2024 EGT11 S01_PID 120-120;
SG_MUL_VAL_ 2024 EGT12 S01_PID 120-120;
SG_MUL_VAL_ 2024 EGT13 S01_PID 120-120;
SG_MUL_VAL_ 2024 EGT14 S01_PID 120-120;
SG_MUL_VAL_ 2024 EGT21_SUP S01_PID 121-121;
SG_MUL_VAL_ 2024 EGT22_SUP S01_PID 121-121;
SG_MUL_VAL_ 2024 EGT23_SUP S01_PID 121-121;
SG_MUL_VAL_ 2024 EGT24_SUP S01_PID 121-121;
SG_MUL_VAL_ 2024 EGT21 S01_PID 121-121;
SG_MUL_VAL_ 2024 EGT22 S01_PID 121-121;
SG_MUL_VAL_ 2024 EGT23 S01_PID 121-121;
SG_MUL_VAL_ 2024 EGT24 S01_PID 121-121;
SG_MUL_VAL_ 2024 PF1_DP_SUP S01_PID 122-122;
SG_MUL_VAL_ 2024 PF1_INP_SUP S01_PID 122-122;
SG_MUL_VAL_ 2024 PF1_OUTP_SUP S01_PID 122-122;
SG_MUL_VAL_ 2024 PF1_DP S01_PID 122-122;
SG_MUL_VAL_ 2024 PF1_INP S01_PID 122-122;
SG_MUL_VAL_ 2024 PF1_OUTP S01_PID 122-122;
SG_MUL_VAL_ 2024 PF2_DP_SUP S01_PID 123-123;
SG_MUL_VAL_ 2024 PF2_INP_SUP S01_PID 123-123;
SG_MUL_VAL_ 2024 PF2_OUTP_SUP S01_PID 123-123;
SG_MUL_VAL_ 2024 PF2_DP S01_PID 123-123;
SG_MUL_VAL_ 2024 PF2_INP S01_PID 123-123;
SG_MUL_VAL_ 2024 PF2_OUTP S01_PID 123-123;
SG_MUL_VAL_ 2024 PF1_INT_SUP S01_PID 124-124;
SG_MUL_VAL_ 2024 PF1_OUTT_SUP S01_PID 124-124;
SG_MUL_VAL_ 2024 PF2_INT_SUP S01_PID 124-124;
SG_MUL_VAL_ 2024 PF2_OUTT_SUP S01_PID 124-124;
SG_MUL_VAL_ 2024 PF1_INT S01_PID 124-124;
SG_MUL_VAL_ 2024 PF1_OUTT S01_PID 124-124;
SG_MUL_VAL_ 2024 PF2_INT S01_PID 124-124;
SG_MUL_VAL_ 2024 PF2_OUTT S01_PID 124-124;
SG_MUL_VAL_ 2024 NNTE_IN S01_PID 125-125;
SG_MUL_VAL_ 2024 NNTE_OUT S01_PID 125-125;
SG_MUL_VAL_ 2024 NNTE_CAA S01_PID 125-125;
SG_MUL_VAL_ 2024 NNTE_DEF S01_PID 125-125;
SG_MUL_VAL_ 2024 PNTE_IN S01_PID 126-126;
SG_MUL_VAL_ 2024 PNTE_OUT S01_PID 126-126;
SG_MUL_VAL_ 2024 PNTE_CAA S01_PID 126-126;
SG_MUL_VAL_ 2024 PNTE_DEF S01_PID 126-126;
SG_MUL_VAL_ 2024 RUN_TIME_SUP S01_PID 127-127;
SG_MUL_VAL_ 2024 IDLE_TIME_SUP S01_PID 127-127;
SG_MUL_VAL_ 2024 PTO_TIME_SUP S01_PID 127-127;
SG_MUL_VAL_ 2024 RUN_TIME S01_PID 127-127;
SG_MUL_VAL_ 2024 IDLE_TIME S01_PID 127-127;
SG_MUL_VAL_ 2024 PTO_TIME S01_PID 127-127;
SG_MUL_VAL_ 2024 AECD1_TIME_SUP S01_PID 129-129;
SG_MUL_VAL_ 2024 AECD2_TIME_SUP S01_PID 129-129;
SG_MUL_VAL_ 2024 AECD3_TIME_SUP S01_PID 129-129;
SG_MUL_VAL_ 2024 AECD4_TIME_SUP S01_PID 129-129;
SG_MUL_VAL_ 2024 AECD5_TIME_SUP S01_PID 129-129;
SG_MUL_VAL_ 2024 AECD1_TIME1 S01_PID 129-129;
SG_MUL_VAL_ 2024 AECD1_TIME2 S01_PID 129-129;
SG_MUL_VAL_ 2024 AECD2_TIME1 S01_PID 129-129;
SG_MUL_VAL_ 2024 AECD2_TIME2 S01_PID 129-129;
SG_MUL_VAL_ 2024 AECD3_TIME1 S01_PID 129-129;
SG_MUL_VAL_ 2024 AECD3_TIME2 S01_PID 129-129;
SG_MUL_VAL_ 2024 AECD4_TIME1 S01_PID 129-129;
SG_MUL_VAL_ 2024 AECD4_TIME2 S01_PID 129-129;
SG_MUL_VAL_ 2024 AECD5_TIME1 S01_PID 129-129;
SG_MUL_VAL_ 2024 AECD5_TIME2 S01_PID 129-129;
SG_MUL_VAL_ 2024 AECD6_TIME_SUP S01_PID 130-130;
SG_MUL_VAL_ 2024 AECD7_TIME_SUP S01_PID 130-130;
SG_MUL_VAL_ 2024 AECD8_TIME_SUP S01_PID 130-130;
SG_MUL_VAL_ 2024 AECD9_TIME_SUP S01_PID 130-130;
SG_MUL_VAL_ 2024 AECD10_TIME_SUP S01_PID 130-130;
SG_MUL_VAL_ 2024 AECD6_TIME1 S01_PID 130-130;
SG_MUL_VAL_ 2024 AECD6_TIME2 S01_PID 130-130;
SG_MUL_VAL_ 2024 AECD7_TIME1 S01_PID 130-130;
SG_MUL_VAL_ 2024 AECD7_TIME2 S01_PID 130-130;
SG_MUL_VAL_ 2024 AECD8_TIME1 S01_PID 130-130;
SG_MUL_VAL_ 2024 AECD8_TIME2 S01_PID 130-130;
SG_MUL_VAL_ 2024 AECD9_TIME1 S01_PID 130-130;
SG_MUL_VAL_ 2024 AECD9_TIME2 S01_PID 130-130;
SG_MUL_VAL_ 2024 AECD10_TIME1 S01_PID 130-130;
SG_MUL_VAL_ 2024 AECD10_TIME2 S01_PID 130-130;
SG_MUL_VAL_ 2024 NOX11_SUP S01_PID 131-131;
SG_MUL_VAL_ 2024 NOX12_SUP S01_PID 131-131;
SG_MUL_VAL_ 2024 NOX21_SUP S01_PID 131-131;
SG_MUL_VAL_ 2024 NOX22_SUP S01_PID 131-131;
SG_MUL_VAL_ 2024 NOX11_RDY S01_PID 131-131;
SG_MUL_VAL_ 2024 NOX12_RDY S01_PID 131-131;
SG_MUL_VAL_ 2024 NOX21_RDY S01_PID 131-131;
SG_MUL_VAL_ 2024 NOX22_RDY S01_PID 131-131;
SG_MUL_VAL_ 2024 NOX11 S01_PID 131-131;
SG_MUL_VAL_ 2024 NOX12 S01_PID 131-131;
SG_MUL_VAL_ 2024 NOX21 S01_PID 131-131;
SG_MUL_VAL_ 2024 NOX22 S01_PID 131-131;
SG_MUL_VAL_ 2024 MST S01_PID 132-132;
SG_MUL_VAL_ 2024 REAG_RATE_SUP S01_PID 133-133;
SG_MUL_VAL_ 2024 REAG_DEMD_SUP S01_PID 133-133;
SG_MUL_VAL_ 2024 REAG_LVL_SUP S01_PID 133-133;
SG_MUL_VAL_ 2024 NWI_TIME_SUP S01_PID 133-133;
SG_MUL_VAL_ 2024 REAG_RATE S01_PID 133-133;
SG_MUL_VAL_ 2024 REAG_DEMD S01_PID 133-133;
SG_MUL_VAL_ 2024 REAG_LVL S01_PID 133-133;
SG_MUL_VAL_ 2024 NWI_TIME S01_PID 133-133;
SG_MUL_VAL_ 2024 PM11_SUP S01_PID 134-134;
SG_MUL_VAL_ 2024 PM21_SUP S01_PID 134-134;
SG_MUL_VAL_ 2024 PM11 S01_PID 134-134;
SG_MUL_VAL_ 2024 PM21 S01_PID 134-134;
SG_MUL_VAL_ 2024 MAP_A_SUP S01_PID 135-135;
SG_MUL_VAL_ 2024 MAP_B_SUP S01_PID 135-135;
SG_MUL_VAL_ 2024 MAP_A S01_PID 135-135;
SG_MUL_VAL_ 2024 MAP_B S01_PID 135-135;
SG_MUL_VAL_ 2024 SCR_IND_SYS_LEVEL_LOW S01_PID 136-136;
SG_MUL_VAL_ 2024 SCR_IND_SYS_INCORR_REAG S01_PID 136-136;
SG_MUL_VAL_ 2024 SCR_IND_SYS_CONSUMP_DEVIATION S01_PID 136-136;
SG_MUL_VAL_ 2024 SCR_IND_SYS_NOx_LEVEL S01_PID 136-136;
SG_MUL_VAL_ 2024 SCR_IND_SYS_ACTIVE S01_PID 136-136;
SG_MUL_VAL_ 2024 SCR_IND_SYS_HIST1_LEVEL_LOW S01_PID 136-136;
SG_MUL_VAL_ 2024 SCR_IND_SYS_HIST1_INCORR_REAG S01_PID 136-136;
SG_MUL_VAL_ 2024 SCR_IND_SYS_HIST1_CONSUMP_DEVIATION S01_PID 136-136;
SG_MUL_VAL_ 2024 SCR_IND_SYS_HIST1_NOx_LEVEL S01_PID 136-136;
SG_MUL_VAL_ 2024 SCR_IND_SYS_HIST2_LEVEL_LOW S01_PID 136-136;
SG_MUL_VAL_ 2024 SCR_IND_SYS_HIST2_INCORR_REAG S01_PID 136-136;
SG_MUL_VAL_ 2024 SCR_IND_SYS_HIST2_CONSUMP_DEVIATION S01_PID 136-136;
SG_MUL_VAL_ 2024 SCR_IND_SYS_HIST2_NOx_LEVEL S01_PID 136-136;
SG_MUL_VAL_ 2024 SCR_IND_SYS_HIST3_LEVEL_LOW S01_PID 136-136;
SG_MUL_VAL_ 2024 SCR_IND_SYS_HIST3_INCORR_REAG S01_PID 136-136;
SG_MUL_VAL_ 2024 SCR_IND_SYS_HIST3_CONSUMP_DEVIATION S01_PID 136-136;
SG_MUL_VAL_ 2024 SCR_IND_SYS_HIST3_NOx_LEVEL S01_PID 136-136;
SG_MUL_VAL_ 2024 SCR_IND_SYS_HIST4_LEVEL_LOW S01_PID 136-136;
SG_MUL_VAL_ 2024 SCR_IND_SYS_HIST4_INCORR_REAG S01_PID 136-136;
SG_MUL_VAL_ 2024 SCR_IND_SYS_HIST4_CONSUMP_DEVIATION S01_PID 136-136;
SG_MUL_VAL_ 2024 SCR_IND_SYS_HIST4_NOx_LEVEL S01_PID 136-136;
SG_MUL_VAL_ 2024 SCR_IND_DIST_1N S01_PID 136-136;
SG_MUL_VAL_ 2024 SCR_IND_DIST_1D S01_PID 136-136;
SG_MUL_VAL_ 2024 SCR_IND_DIST_2N S01_PID 136-136;
SG_MUL_VAL_ 2024 SCR_IND_DIST_3N S01_PID 136-136;
SG_MUL_VAL_ 2024 SCR_IND_DIST_4N S01_PID 136-136;
SG_MUL_VAL_ 2024 AECD11_TIME_SUP S01_PID 137-137;
SG_MUL_VAL_ 2024 AECD12_TIME_SUP S01_PID 137-137;
SG_MUL_VAL_ 2024 AECD13_TIME_SUP S01_PID 137-137;
SG_MUL_VAL_ 2024 AECD14_TIME_SUP S01_PID 137-137;
SG_MUL_VAL_ 2024 AECD15_TIME_SUP S01_PID 137-137;
SG_MUL_VAL_ 2024 AECD11_TIME1 S01_PID 137-137;
SG_MUL_VAL_ 2024 AECD11_TIME2 S01_PID 137-137;
SG_MUL_VAL_ 2024 AECD12_TIME1 S01_PID 137-137;
SG_MUL_VAL_ 2024 AECD12_TIME2 S01_PID 137-137;
SG_MUL_VAL_ 2024 AECD13_TIME1 S01_PID 137-137;
SG_MUL_VAL_ 2024 AECD13_TIME2 S01_PID 137-137;
SG_MUL_VAL_ 2024 AECD14_TIME1 S01_PID 137-137;
SG_MUL_VAL_ 2024 AECD14_TIME2 S01_PID 137-137;
SG_MUL_VAL_ 2024 AECD15_TIME1 S01_PID 137-137;
SG_MUL_VAL_ 2024 AECD15_TIME2 S01_PID 137-137;
SG_MUL_VAL_ 2024 AECD16_TIME_SUP S01_PID 138-138;
SG_MUL_VAL_ 2024 AECD17_TIME_SUP S01_PID 138-138;
SG_MUL_VAL_ 2024 AECD18_TIME_SUP S01_PID 138-138;
SG_MUL_VAL_ 2024 AECD19_TIME_SUP S01_PID 138-138;
SG_MUL_VAL_ 2024 AECD20_TIME_SUP S01_PID 138-138;
SG_MUL_VAL_ 2024 AECD16_TIME1 S01_PID 138-138;
SG_MUL_VAL_ 2024 AECD16_TIME2 S01_PID 138-138;
SG_MUL_VAL_ 2024 AECD17_TIME1 S01_PID 138-138;
SG_MUL_VAL_ 2024 AECD17_TIME2 S01_PID 138-138;
SG_MUL_VAL_ 2024 AECD18_TIME1 S01_PID 138-138;
SG_MUL_VAL_ 2024 AECD18_TIME2 S01_PID 138-138;
SG_MUL_VAL_ 2024 AECD19_TIME1 S01_PID 138-138;
SG_MUL_VAL_ 2024 AECD19_TIME2 S01_PID 138-138;
SG_MUL_VAL_ 2024 AECD20_TIME1 S01_PID 138-138;
SG_MUL_VAL_ 2024 AECD20_TIME2 S01_PID 138-138;
SG_MUL_VAL_ 2024 PF_REGEN_STAT_SUP S01_PID 139-139;
SG_MUL_VAL_ 2024 PF_REGEN_TYPE_SUP S01_PID 139-139;
SG_MUL_VAL_ 2024 NOX_ADS_REGEN_SUP S01_PID 139-139;
SG_MUL_VAL_ 2024 NOX_ADS_DESULF_SUP S01_PID 139-139;
SG_MUL_VAL_ 2024 PF_REGEN_PCT_SUP S01_PID 139-139;
SG_MUL_VAL_ 2024 PF_REGEN_AVGT_SUP S01_PID 139-139;
SG_MUL_VAL_ 2024 PF_REGEN_AVGD_SUP S01_PID 139-139;
SG_MUL_VAL_ 2024 PF_REGEN_STAT S01_PID 139-139;
SG_MUL_VAL_ 2024 PF_REGEN_TYPE S01_PID 139-139;
SG_MUL_VAL_ 2024 NOX_ADS_REGEN S01_PID 139-139;
SG_MUL_VAL_ 2024 NOX_ADS_DESULF S01_PID 139-139;
SG_MUL_VAL_ 2024 PF_REGEN_PCT S01_PID 139-139;
SG_MUL_VAL_ 2024 PF_REGEN_AVGT S01_PID 139-139;
SG_MUL_VAL_ 2024 PF_REGEN_AVGD S01_PID 139-139;
SG_MUL_VAL_ 2024 O2S11_PCT_SUP S01_PID 140-140;
SG_MUL_VAL_ 2024 O2S12_PCT_SUP S01_PID 140-140;
SG_MUL_VAL_ 2024 O2S21_PCT_SUP S01_PID 140-140;
SG_MUL_VAL_ 2024 O2S22_PCT_SUP S01_PID 140-140;
SG_MUL_VAL_ 2024 O2S11_PCT_LAMBDA_SUP S01_PID 140-140;
SG_MUL_VAL_ 2024 O2S12_PCT_LAMBDA_SUP S01_PID 140-140;
SG_MUL_VAL_ 2024 O2S21_PCT_LAMBDA_SUP S01_PID 140-140;
SG_MUL_VAL_ 2024 O2S22_PCT_LAMBDA_SUP S01_PID 140-140;
SG_MUL_VAL_ 2024 O2S11_PCT S01_PID 140-140;
SG_MUL_VAL_ 2024 O2S12_PCT S01_PID 140-140;
SG_MUL_VAL_ 2024 O2S21_PCT S01_PID 140-140;
SG_MUL_VAL_ 2024 O2S22_PCT S01_PID 140-140;
SG_MUL_VAL_ 2024 O2S11_PCT_LAMBDA S01_PID 140-140;
SG_MUL_VAL_ 2024 O2S12_PCT_LAMBDA S01_PID 140-140;
SG_MUL_VAL_ 2024 O2S21_PCT_LAMBDA S01_PID 140-140;
SG_MUL_VAL_ 2024 O2S22_PCT_LAMBDA S01_PID 140-140;
SG_MUL_VAL_ 2024 TP_G S01_PID 141-141;
SG_MUL_VAL_ 2024 TQ_FR S01_PID 142-142;
SG_MUL_VAL_ 2024 PM11_STA_SUP S01_PID 143-143;
SG_MUL_VAL_ 2024 PM11_SIGNAL_SUP S01_PID 143-143;
SG_MUL_VAL_ 2024 PM21_STA_SUP S01_PID 143-143;
SG_MUL_VAL_ 2024 PM21_SIGNAL_SUP S01_PID 143-143;
SG_MUL_VAL_ 2024 PM11_ACTIVE S01_PID 143-143;
SG_MUL_VAL_ 2024 PM11_REGEN S01_PID 143-143;
SG_MUL_VAL_ 2024 PM11_NOV S01_PID 143-143;
SG_MUL_VAL_ 2024 PM21_ACTIVE S01_PID 143-143;
SG_MUL_VAL_ 2024 PM21_REGEN S01_PID 143-143;
SG_MUL_VAL_ 2024 PM21_NOV S01_PID 143-143;
SG_MUL_VAL_ 2024 MI_DISP_VOBD S01_PID 144-144;
SG_MUL_VAL_ 2024 MI_MODE_VOBD S01_PID 144-144;
SG_MUL_VAL_ 2024 VOBD_RDY S01_PID 144-144;
SG_MUL_VAL_ 2024 VOBD_MI_TIME S01_PID 144-144;
SG_MUL_VAL_ 2024 MI_MODE_ECU S01_PID 145-145;
SG_MUL_VAL_ 2024 OBD_MI_TIME S01_PID 145-145;
SG_MUL_VAL_ 2024 OBD_B1_TIME S01_PID 145-145;
SG_MUL_VAL_ 2024 FP1_CL_SUP S01_PID 146-146;
SG_MUL_VAL_ 2024 FIQ1_CL_SUP S01_PID 146-146;
SG_MUL_VAL_ 2024 FIT1_CL_SUP S01_PID 146-146;
SG_MUL_VAL_ 2024 IFB1_CL_SUP S01_PID 146-146;
SG_MUL_VAL_ 2024 FP2_CL_SUP S01_PID 146-146;
SG_MUL_VAL_ 2024 FIQ2_CL_SUP S01_PID 146-146;
SG_MUL_VAL_ 2024 FIT2_CL_SUP S01_PID 146-146;
SG_MUL_VAL_ 2024 IFB2_CL_SUP S01_PID 146-146;
SG_MUL_VAL_ 2024 FP1_CL S01_PID 146-146;
SG_MUL_VAL_ 2024 FIQ1_CL S01_PID 146-146;
SG_MUL_VAL_ 2024 FIT1_CL S01_PID 146-146;
SG_MUL_VAL_ 2024 IFB1_CL S01_PID 146-146;
SG_MUL_VAL_ 2024 FP2_CL S01_PID 146-146;
SG_MUL_VAL_ 2024 FIQ2_CL S01_PID 146-146;
SG_MUL_VAL_ 2024 FIT2_CL S01_PID 146-146;
SG_MUL_VAL_ 2024 IFB2_CL S01_PID 146-146;
SG_MUL_VAL_ 2024 MI_TIME_CUM_SUP S01_PID 147-147;
SG_MUL_VAL_ 2024 MI_TIME_CUM S01_PID 147-147;
SG_MUL_VAL_ 2024 NOX_WARN_ACT_SUP S01_PID 148-148;
SG_MUL_VAL_ 2024 REAG_QUAL_TIME_SUP S01_PID 148-148;
SG_MUL_VAL_ 2024 REAG_CON_TIME_SUP S01_PID 148-148;
SG_MUL_VAL_ 2024 REAG_DOSE_TIME_SUP S01_PID 148-148;
SG_MUL_VAL_ 2024 EGR_TIME_SUP S01_PID 148-148;
SG_MUL_VAL_ 2024 NOX_DTC_TIME_SUP S01_PID 148-148;
SG_MUL_VAL_ 2024 NOX_WARN_ACT S01_PID 148-148;
SG_MUL_VAL_ 2024 INDUC_L1 S01_PID 148-148;
SG_MUL_VAL_ 2024 INDUC_L2 S01_PID 148-148;
SG_MUL_VAL_ 2024 INDUC_L3 S01_PID 148-148;
SG_MUL_VAL_ 2024 REAG_QUAL_TIME S01_PID 148-148;
SG_MUL_VAL_ 2024 REAG_CON_TIME S01_PID 148-148;
SG_MUL_VAL_ 2024 REAG_DOSE_TIME S01_PID 148-148;
SG_MUL_VAL_ 2024 EGR_TIME S01_PID 148-148;
SG_MUL_VAL_ 2024 NOX_DTC_TIME S01_PID 148-148;
SG_MUL_VAL_ 2024 SCR_NH3_TGT_A_SUP S01_PID 149-149;
SG_MUL_VAL_ 2024 SCR_NH3_ACT_A_SUP S01_PID 149-149;
SG_MUL_VAL_ 2024 SCR_NH3_TGT_B_SUP S01_PID 149-149;
SG_MUL_VAL_ 2024 SCR_NH3_ACT_B_SUP S01_PID 149-149;
SG_MUL_VAL_ 2024 SCR_NH3_TGT_A S01_PID 149-149;
SG_MUL_VAL_ 2024 SCR_NH3_ACT_A S01_PID 149-149;
SG_MUL_VAL_ 2024 SCR_NH3_TGT_B S01_PID 149-149;
SG_MUL_VAL_ 2024 SCR_NH3_ACT_B S01_PID 149-149;
SG_MUL_VAL_ 2024 HC_INJ_FL_SUP S01_PID 150-150;
SG_MUL_VAL_ 2024 HC_INJ_DC_SUP S01_PID 150-150;
SG_MUL_VAL_ 2024 AFT_FP_SUP S01_PID 150-150;
SG_MUL_VAL_ 2024 HC_INJ_FL S01_PID 150-150;
SG_MUL_VAL_ 2024 HC_INJ_DC S01_PID 150-150;
SG_MUL_VAL_ 2024 AFT_FP S01_PID 150-150;
SG_MUL_VAL_ 2024 NOx_EO_SUP S01_PID 151-151;
SG_MUL_VAL_ 2024 NOx_TP_SUP S01_PID 151-151;
SG_MUL_VAL_ 2024 NOx_EO S01_PID 151-151;
SG_MUL_VAL_ 2024 NOx_TP S01_PID 151-151;
SG_MUL_VAL_ 2024 EGT15_SUP S01_PID 152-152;
SG_MUL_VAL_ 2024 EGT16_SUP S01_PID 152-152;
SG_MUL_VAL_ 2024 EGT17_SUP S01_PID 152-152;
SG_MUL_VAL_ 2024 EGT18_SUP S01_PID 152-152;
SG_MUL_VAL_ 2024 EGT15 S01_PID 152-152;
SG_MUL_VAL_ 2024 EGT16 S01_PID 152-152;
SG_MUL_VAL_ 2024 EGT17 S01_PID 152-152;
SG_MUL_VAL_ 2024 EGT18 S01_PID 152-152;
SG_MUL_VAL_ 2024 EGT25_SUP S01_PID 153-153;
SG_MUL_VAL_ 2024 EGT26_SUP S01_PID 153-153;
SG_MUL_VAL_ 2024 EGT27_SUP S01_PID 153-153;
SG_MUL_VAL_ 2024 EGT28_SUP S01_PID 153-153;
SG_MUL_VAL_ 2024 EGT25 S01_PID 153-153;
SG_MUL_VAL_ 2024 EGT26 S01_PID 153-153;
SG_MUL_VAL_ 2024 EGT27 S01_PID 153-153;
SG_MUL_VAL_ 2024 EGT28 S01_PID 153-153;
SG_MUL_VAL_ 2024 HEV_CHRG_STA_SUP S01_PID 154-154;
SG_MUL_VAL_ 2024 HEV_BATT_V_SUP S01_PID 154-154;
SG_MUL_VAL_ 2024 HEV_BATT_A_SUP S01_PID 154-154;
SG_MUL_VAL_ 2024 EHEV_CHRG_STA_SUP S01_PID 154-154;
SG_MUL_VAL_ 2024 HEV_CHRG_STA S01_PID 154-154;
SG_MUL_VAL_ 2024 EHEV_CHRG_STA S01_PID 154-154;
SG_MUL_VAL_ 2024 HEV_BATT_V S01_PID 154-154;
SG_MUL_VAL_ 2024 HEV_BATT_A S01_PID 154-154;
SG_MUL_VAL_ 2024 DEF_TYPE_SUP S01_PID 155-155;
SG_MUL_VAL_ 2024 DEF_CON_SUP S01_PID 155-155;
SG_MUL_VAL_ 2024 DEF_T_SUP S01_PID 155-155;
SG_MUL_VAL_ 2024 DEF_LVL_SUP S01_PID 155-155;
SG_MUL_VAL_ 2024 DEF_TYPE S01_PID 155-155;
SG_MUL_VAL_ 2024 DEF_CON S01_PID 155-155;
SG_MUL_VAL_ 2024 DEF_T S01_PID 155-155;
SG_MUL_VAL_ 2024 DEF_LVL S01_PID 155-155;
SG_MUL_VAL_ 2024 O2S13_PCT_SUP S01_PID 156-156;
SG_MUL_VAL_ 2024 O2S14_PCT_SUP S01_PID 156-156;
SG_MUL_VAL_ 2024 O2S23_PCT_SUP S01_PID 156-156;
SG_MUL_VAL_ 2024 O2S24_PCT_SUP S01_PID 156-156;
SG_MUL_VAL_ 2024 O2S13_PCT_LAMBDA_SUP S01_PID 156-156;
SG_MUL_VAL_ 2024 O2S14_PCT_LAMBDA_SUP S01_PID 156-156;
SG_MUL_VAL_ 2024 O2S23_PCT_LAMBDA_SUP S01_PID 156-156;
SG_MUL_VAL_ 2024 O2S24_PCT_LAMBDA_SUP S01_PID 156-156;
SG_MUL_VAL_ 2024 O2S13_PCT S01_PID 156-156;
SG_MUL_VAL_ 2024 O2S14_PCT S01_PID 156-156;
SG_MUL_VAL_ 2024 O2S23_PCT S01_PID 156-156;
SG_MUL_VAL_ 2024 O2S24_PCT S01_PID 156-156;
SG_MUL_VAL_ 2024 O2S13_PCT_LAMBDA S01_PID 156-156;
SG_MUL_VAL_ 2024 O2S14_PCT_LAMBDA S01_PID 156-156;
SG_MUL_VAL_ 2024 O2S23_PCT_LAMBDA S01_PID 156-156;
SG_MUL_VAL_ 2024 O2S24_PCT_LAMBDA S01_PID 156-156;
SG_MUL_VAL_ 2024 FUEL_RATE_GS S01_PID 157-157;
SG_MUL_VAL_ 2024 VFUEL_RATE S01_PID 157-157;
SG_MUL_VAL_ 2024 EXH_RATE S01_PID 158-158;
SG_MUL_VAL_ 2024 FUELSYSA_B1_SUP S01_PID 159-159;
SG_MUL_VAL_ 2024 FUELSYSB_B1_SUP S01_PID 159-159;
SG_MUL_VAL_ 2024 FUELSYSA_B2_SUP S01_PID 159-159;
SG_MUL_VAL_ 2024 FUELSYSB_B2_SUP S01_PID 159-159;
SG_MUL_VAL_ 2024 FUELSYSA_B3_SUP S01_PID 159-159;
SG_MUL_VAL_ 2024 FUELSYSB_B3_SUP S01_PID 159-159;
SG_MUL_VAL_ 2024 FUELSYSA_B4_SUP S01_PID 159-159;
SG_MUL_VAL_ 2024 FUELSYSB_B4_SUP S01_PID 159-159;
SG_MUL_VAL_ 2024 FUELSYSA_B1 S01_PID 159-159;
SG_MUL_VAL_ 2024 FUELSYSB_B1 S01_PID 159-159;
SG_MUL_VAL_ 2024 FUELSYSA_B2 S01_PID 159-159;
SG_MUL_VAL_ 2024 FUELSYSB_B2 S01_PID 159-159;
SG_MUL_VAL_ 2024 FUELSYSA_B3 S01_PID 159-159;
SG_MUL_VAL_ 2024 FUELSYSB_B3 S01_PID 159-159;
SG_MUL_VAL_ 2024 FUELSYSA_B4 S01_PID 159-159;
SG_MUL_VAL_ 2024 FUELSYSB_B4 S01_PID 159-159;
SG_MUL_VAL_ 2024 NOXC11_SUP S01_PID 161-161;
SG_MUL_VAL_ 2024 NOXC12_SUP S01_PID 161-161;
SG_MUL_VAL_ 2024 NOXC21_SUP S01_PID 161-161;
SG_MUL_VAL_ 2024 NOXC22_SUP S01_PID 161-161;
SG_MUL_VAL_ 2024 NOXC11_RDY S01_PID 161-161;
SG_MUL_VAL_ 2024 NOXC12_RDY S01_PID 161-161;
SG_MUL_VAL_ 2024 NOXC21_RDY S01_PID 161-161;
SG_MUL_VAL_ 2024 NOXC22_RDY S01_PID 161-161;
SG_MUL_VAL_ 2024 NOXC11 S01_PID 161-161;
SG_MUL_VAL_ 2024 NOXC12 S01_PID 161-161;
SG_MUL_VAL_ 2024 NOXC21 S01_PID 161-161;
SG_MUL_VAL_ 2024 NOXC22 S01_PID 161-161;
SG_MUL_VAL_ 2024 CYL_RATE S01_PID 162-162;
SG_MUL_VAL_ 2024 EVAP_A_VP_SUP S01_PID 163-163;
SG_MUL_VAL_ 2024 EVAP_A_VP_WR_SUP S01_PID 163-163;
SG_MUL_VAL_ 2024 EVAP_B_VP_SUP S01_PID 163-163;
SG_MUL_VAL_ 2024 EVAP_B_VP_WR_SUP S01_PID 163-163;
SG_MUL_VAL_ 2024 EVAP_SEAL_SUP S01_PID 163-163;
SG_MUL_VAL_ 2024 EVAP_SEAL S01_PID 163-163;
SG_MUL_VAL_ 2024 EVAP_A_VP S01_PID 163-163;
SG_MUL_VAL_ 2024 EVAP_A_VP_WR S01_PID 163-163;
SG_MUL_VAL_ 2024 EVAP_B_VP S01_PID 163-163;
SG_MUL_VAL_ 2024 EVAP_B_VP_WR S01_PID 163-163;
SG_MUL_VAL_ 2024 GEAR_ACT_SUP S01_PID 164-164;
SG_MUL_VAL_ 2024 GEAR_RAT_SUP S01_PID 164-164;
SG_MUL_VAL_ 2024 GEAR_ACT S01_PID 164-164;
SG_MUL_VAL_ 2024 GEAR_RAT S01_PID 164-164;
SG_MUL_VAL_ 2024 DEF_CMD_SUP S01_PID 165-165;
SG_MUL_VAL_ 2024 DEF_UCDC_SUP S01_PID 165-165;
SG_MUL_VAL_ 2024 DEF_CMD S01_PID 165-165;
SG_MUL_VAL_ 2024 DEF_UCDC S01_PID 165-165;
SG_MUL_VAL_ 2024 ODO S01_PID 166-166;
SG_MUL_VAL_ 2024 NOX13_SUP S01_PID 167-167;
SG_MUL_VAL_ 2024 NOX14_SUP S01_PID 167-167;
SG_MUL_VAL_ 2024 NOX23_SUP S01_PID 167-167;
SG_MUL_VAL_ 2024 NOX24_SUP S01_PID 167-167;
SG_MUL_VAL_ 2024 NOX13_RDY S01_PID 167-167;
SG_MUL_VAL_ 2024 NOX14_RDY S01_PID 167-167;
SG_MUL_VAL_ 2024 NOX23_RDY S01_PID 167-167;
SG_MUL_VAL_ 2024 NOX24_RDY S01_PID 167-167;
SG_MUL_VAL_ 2024 NOX13 S01_PID 167-167;
SG_MUL_VAL_ 2024 NOX14 S01_PID 167-167;
SG_MUL_VAL_ 2024 NOX23 S01_PID 167-167;
SG_MUL_VAL_ 2024 NOX24 S01_PID 167-167;
SG_MUL_VAL_ 2024 NOXC13_SUP S01_PID 168-168;
SG_MUL_VAL_ 2024 NOXC14_SUP S01_PID 168-168;
SG_MUL_VAL_ 2024 NOXC23_SUP S01_PID 168-168;
SG_MUL_VAL_ 2024 NOXC24_SUP S01_PID 168-168;
SG_MUL_VAL_ 2024 NOXC13_RDY S01_PID 168-168;
SG_MUL_VAL_ 2024 NOXC14_RDY S01_PID 168-168;
SG_MUL_VAL_ 2024 NOXC23_RDY S01_PID 168-168;
SG_MUL_VAL_ 2024 NOXC24_RDY S01_PID 168-168;
SG_MUL_VAL_ 2024 NOXC13 S01_PID 168-168;
SG_MUL_VAL_ 2024 NOXC14 S01_PID 168-168;
SG_MUL_VAL_ 2024 NOXC23 S01_PID 168-168;
SG_MUL_VAL_ 2024 NOXC24 S01_PID 168-168;
SG_MUL_VAL_ 2024 ABS_DISABLED_SUP S01_PID 169-169;
SG_MUL_VAL_ 2024 ABS_DISABLED S01_PID 169-169;
SG_MUL_VAL_ 2024 V_SET S01_PID 170-170;
SG_MUL_VAL_ 2024 FRP_AF_SUP S01_PID 171-171;
SG_MUL_VAL_ 2024 FRT_AF_SUP S01_PID 171-171;
SG_MUL_VAL_ 2024 FTP_AF_SUP S01_PID 171-171;
SG_MUL_VAL_ 2024 FTPW_AF_SUP S01_PID 171-171;
SG_MUL_VAL_ 2024 FTT_AF_SUP S01_PID 171-171;
SG_MUL_VAL_ 2024 FRP_AF S01_PID 171-171;
SG_MUL_VAL_ 2024 FRT_AF S01_PID 171-171;
SG_MUL_VAL_ 2024 FTP_AF S01_PID 171-171;
SG_MUL_VAL_ 2024 FTPW_AF S01_PID 171-171;
SG_MUL_VAL_ 2024 FTT_AF S01_PID 171-171;
SG_MUL_VAL_ 2024 CKC_P_SUP S01_PID 173-173;
SG_MUL_VAL_ 2024 CKC_OSEP_RPM_SUP S01_PID 173-173;
SG_MUL_VAL_ 2024 CKC_P S01_PID 173-173;
SG_MUL_VAL_ 2024 CKC_OSEP_RPM S01_PID 173-173;
SG_MUL_VAL_ 2024 EVAP_PP_SUP S01_PID 174-174;
SG_MUL_VAL_ 2024 EVAP_PP_WR_SUP S01_PID 174-174;
SG_MUL_VAL_ 2024 EVAP_PP S01_PID 174-174;
SG_MUL_VAL_ 2024 EVAP_PP_WR S01_PID 174-174;
SG_MUL_VAL_ 2024 AIR_FL_TGT S01_PID 175-175;
SG_MUL_VAL_ 2024 EGR_M_FL_A_SUP S01_PID 176-176;
SG_MUL_VAL_ 2024 EGR_M_FL_B_SUP S01_PID 176-176;
SG_MUL_VAL_ 2024 EGR_M_FL_A S01_PID 176-176;
SG_MUL_VAL_ 2024 EGR_M_FL_B S01_PID 176-176;
SG_MUL_VAL_ 2024 CIFSI1_SUP S01_PID 177-177;
SG_MUL_VAL_ 2024 CIFSI2_SUP S01_PID 177-177;
SG_MUL_VAL_ 2024 CIFSI1_SHRTFT_SUP S01_PID 177-177;
SG_MUL_VAL_ 2024 CIFSI1_LONGFT_SUP S01_PID 177-177;
SG_MUL_VAL_ 2024 CIFSI2_SHRTFT_SUP S01_PID 177-177;
SG_MUL_VAL_ 2024 CIFSI2_LONGFT_SUP S01_PID 177-177;
SG_MUL_VAL_ 2024 CIFSI1_OL S01_PID 177-177;
SG_MUL_VAL_ 2024 CIFSI1_CL S01_PID 177-177;
SG_MUL_VAL_ 2024 CIFSI1_OL_Fault S01_PID 177-177;
SG_MUL_VAL_ 2024 CIFSI2_OL S01_PID 177-177;
SG_MUL_VAL_ 2024 CIFSI2_CL S01_PID 177-177;
SG_MUL_VAL_ 2024 CIFSI2_OL_Fault S01_PID 177-177;
SG_MUL_VAL_ 2024 CIFSI1_SHRTFT S01_PID 177-177;
SG_MUL_VAL_ 2024 CIFSI1_LONGFT S01_PID 177-177;
SG_MUL_VAL_ 2024 CIFSI2_SHRTFT S01_PID 177-177;
SG_MUL_VAL_ 2024 CIFSI2_LONGFT S01_PID 177-177;
SG_MUL_VAL_ 2024 BAT_RET S01_PID 178-178;
SG_MUL_VAL_ 2024 HVESPA_ACR_SUP S01_PID 179-179;
SG_MUL_VAL_ 2024 HVESPB_ACR_SUP S01_PID 179-179;
SG_MUL_VAL_ 2024 HVESPC_ACR_SUP S01_PID 179-179;
SG_MUL_VAL_ 2024 HVESPD_ACR_SUP S01_PID 179-179;
SG_MUL_VAL_ 2024 HVESPE_ACR_SUP S01_PID 179-179;
SG_MUL_VAL_ 2024 HVESPF_ACR_SUP S01_PID 179-179;
SG_MUL_VAL_ 2024 HVESPG_ACR_SUP S01_PID 179-179;
SG_MUL_VAL_ 2024 HVESPH_ACR_SUP S01_PID 179-179;
SG_MUL_VAL_ 2024 HVESS_ACR S01_PID 179-179;
SG_MUL_VAL_ 2024 HVESPA_ACR S01_PID 179-179;
SG_MUL_VAL_ 2024 HVESPB_ACR S01_PID 179-179;
SG_MUL_VAL_ 2024 HVESPC_ACR S01_PID 179-179;
SG_MUL_VAL_ 2024 HVESPD_ACR S01_PID 179-179;
SG_MUL_VAL_ 2024 HVESPE_ACR S01_PID 179-179;
SG_MUL_VAL_ 2024 HVESPF_ACR S01_PID 179-179;
SG_MUL_VAL_ 2024 HVESPG_ACR S01_PID 179-179;
SG_MUL_VAL_ 2024 HVESPH_ACR S01_PID 179-179;
SG_MUL_VAL_ 2024 HVESPA_Temp_SUP S01_PID 180-180;
SG_MUL_VAL_ 2024 HVESPB_Temp_SUP S01_PID 180-180;
SG_MUL_VAL_ 2024 HVESPC_Temp_SUP S01_PID 180-180;
SG_MUL_VAL_ 2024 HVESPD_Temp_SUP S01_PID 180-180;
SG_MUL_VAL_ 2024 HVESPE_Temp_SUP S01_PID 180-180;
SG_MUL_VAL_ 2024 HVESPF_Temp_SUP S01_PID 180-180;
SG_MUL_VAL_ 2024 HVESPG_Temp_SUP S01_PID 180-180;
SG_MUL_VAL_ 2024 HVESPH_Temp_SUP S01_PID 180-180;
SG_MUL_VAL_ 2024 HVESS_Temp S01_PID 180-180;
SG_MUL_VAL_ 2024 HVESPA_Temp S01_PID 180-180;
SG_MUL_VAL_ 2024 HVESPB_Temp S01_PID 180-180;
SG_MUL_VAL_ 2024 HVESPC_Temp S01_PID 180-180;
SG_MUL_VAL_ 2024 HVESPD_Temp S01_PID 180-180;
SG_MUL_VAL_ 2024 HVESPE_Temp S01_PID 180-180;
SG_MUL_VAL_ 2024 HVESPF_Temp S01_PID 180-180;
SG_MUL_VAL_ 2024 HVESPG_Temp S01_PID 180-180;
SG_MUL_VAL_ 2024 HVESPH_Temp S01_PID 180-180;
SG_MUL_VAL_ 2024 HVESPA_Cur_SUP S01_PID 181-181;
SG_MUL_VAL_ 2024 HVESPB_Cur_SUP S01_PID 181-181;
SG_MUL_VAL_ 2024 HVESPC_Cur_SUP S01_PID 181-181;
SG_MUL_VAL_ 2024 HVESPD_Cur_SUP S01_PID 181-181;
SG_MUL_VAL_ 2024 HVESPE_Cur_SUP S01_PID 181-181;
SG_MUL_VAL_ 2024 HVESPF_Cur_SUP S01_PID 181-181;
SG_MUL_VAL_ 2024 HVESPG_Cur_SUP S01_PID 181-181;
SG_MUL_VAL_ 2024 HVESPH_Cur_SUP S01_PID 181-181;
SG_MUL_VAL_ 2024 HVESS_Cur S01_PID 181-181;
SG_MUL_VAL_ 2024 HVESPA_Cur S01_PID 181-181;
SG_MUL_VAL_ 2024 HVESPB_Cur S01_PID 181-181;
SG_MUL_VAL_ 2024 HVESPC_Cur S01_PID 181-181;
SG_MUL_VAL_ 2024 HVESPD_Cur S01_PID 181-181;
SG_MUL_VAL_ 2024 HVESPE_Cur S01_PID 181-181;
SG_MUL_VAL_ 2024 HVESPF_Cur S01_PID 181-181;
SG_MUL_VAL_ 2024 HVESPG_Cur S01_PID 181-181;
SG_MUL_VAL_ 2024 HVESPH_Cur S01_PID 181-181;
SG_MUL_VAL_ 2024 HVESPA_Volt_SUP S01_PID 182-182;
SG_MUL_VAL_ 2024 HVESPB_Volt_SUP S01_PID 182-182;
SG_MUL_VAL_ 2024 HVESPC_Volt_SUP S01_PID 182-182;
SG_MUL_VAL_ 2024 HVESPD_Volt_SUP S01_PID 182-182;
SG_MUL_VAL_ 2024 HVESPE_Volt_SUP S01_PID 182-182;
SG_MUL_VAL_ 2024 HVESPF_Volt_SUP S01_PID 182-182;
SG_MUL_VAL_ 2024 HVESPG_Volt_SUP S01_PID 182-182;
SG_MUL_VAL_ 2024 HVESPH_Volt_SUP S01_PID 182-182;
SG_MUL_VAL_ 2024 HVESS_Volt S01_PID 182-182;
SG_MUL_VAL_ 2024 HVESPA_Volt S01_PID 182-182;
SG_MUL_VAL_ 2024 HVESPB_Volt S01_PID 182-182;
SG_MUL_VAL_ 2024 HVESPC_Volt S01_PID 182-182;
SG_MUL_VAL_ 2024 HVESPD_Volt S01_PID 182-182;
SG_MUL_VAL_ 2024 HVESPE_Volt S01_PID 182-182;
SG_MUL_VAL_ 2024 HVESPF_Volt S01_PID 182-182;
SG_MUL_VAL_ 2024 HVESPG_Volt S01_PID 182-182;
SG_MUL_VAL_ 2024 HVESPH_Volt S01_PID 182-182;
SG_MUL_VAL_ 2024 HEV_Batt_Min_Cell_Temp_SUP S01_PID 183-183;
SG_MUL_VAL_ 2024 HEV_Batt_Max_Cell_Temp_SUP S01_PID 183-183;
SG_MUL_VAL_ 2024 HEV_Batt_Ave_Cell_Temp_SUP S01_PID 183-183;
SG_MUL_VAL_ 2024 HEV_Batt_Bus_Bar_Temp_SUP S01_PID 183-183;
SG_MUL_VAL_ 2024 HEV_Batt_Coolant_Temp_SUP S01_PID 183-183;
SG_MUL_VAL_ 2024 HEV_Batt_Therm_Mode_SUP S01_PID 183-183;
SG_MUL_VAL_ 2024 HEV_Batt_Min_Cell_Temp S01_PID 183-183;
SG_MUL_VAL_ 2024 HEV_Batt_Max_Cell_Temp S01_PID 183-183;
SG_MUL_VAL_ 2024 HEV_Batt_Ave_Cell_Temp S01_PID 183-183;
SG_MUL_VAL_ 2024 HEV_Batt_Bus_Bar_Temp S01_PID 183-183;
SG_MUL_VAL_ 2024 HEV_Batt_Coolant_Temp S01_PID 183-183;
SG_MUL_VAL_ 2024 HEV_Batt_Therm_Mode S01_PID 183-183;
SG_MUL_VAL_ 2024 HEV_Batt_Time_Since_Last_Balance S01_PID 184-184;
SG_MUL_VAL_ 2024 HEV_Batt_Min_Cell_Voltage S01_PID 185-185;
SG_MUL_VAL_ 2024 HEV_Batt_Max_Cell_Voltage S01_PID 185-185;
SG_MUL_VAL_ 2024 HEV_Batt_PWR_Available S01_PID 186-186;
SG_MUL_VAL_ 2024 HEV_Batt_Charge_Current_Limit S01_PID 186-186;
SG_MUL_VAL_ 2024 HEV_Batt_Discharge_Current_Limit S01_PID 186-186;
SG_MUL_VAL_ 2024 HVESPA_Enrg_In_SUP S01_PID 187-187;
SG_MUL_VAL_ 2024 HVESPB_Enrg_In_SUP S01_PID 187-187;
SG_MUL_VAL_ 2024 HVESPC_Enrg_In_SUP S01_PID 187-187;
SG_MUL_VAL_ 2024 HVESPD_Enrg_In_SUP S01_PID 187-187;
SG_MUL_VAL_ 2024 HVESPE_Enrg_In_SUP S01_PID 187-187;
SG_MUL_VAL_ 2024 HVESPF_Enrg_In_SUP S01_PID 187-187;
SG_MUL_VAL_ 2024 HVESPG_Enrg_In_SUP S01_PID 187-187;
SG_MUL_VAL_ 2024 HVESPH_Enrg_In_SUP S01_PID 187-187;
SG_MUL_VAL_ 2024 HVESS_Enrg_In S01_PID 187-187;
SG_MUL_VAL_ 2024 HVESPA_Enrg_In S01_PID 187-187;
SG_MUL_VAL_ 2024 HVESPB_Enrg_In S01_PID 187-187;
SG_MUL_VAL_ 2024 HVESPC_Enrg_In S01_PID 187-187;
SG_MUL_VAL_ 2024 HVESPD_Enrg_In S01_PID 187-187;
SG_MUL_VAL_ 2024 HVESPE_Enrg_In S01_PID 187-187;
SG_MUL_VAL_ 2024 HVESPF_Enrg_In S01_PID 187-187;
SG_MUL_VAL_ 2024 HVESPG_Enrg_In S01_PID 187-187;
SG_MUL_VAL_ 2024 HVESPH_Enrg_In S01_PID 187-187;
SG_MUL_VAL_ 2024 HVESPA_Enrg_Out_SUP S01_PID 188-188;
SG_MUL_VAL_ 2024 HVESPB_Enrg_Out_SUP S01_PID 188-188;
SG_MUL_VAL_ 2024 HVESPC_Enrg_Out_SUP S01_PID 188-188;
SG_MUL_VAL_ 2024 HVESPD_Enrg_Out_SUP S01_PID 188-188;
SG_MUL_VAL_ 2024 HVESPE_Enrg_Out_SUP S01_PID 188-188;
SG_MUL_VAL_ 2024 HVESPF_Enrg_Out_SUP S01_PID 188-188;
SG_MUL_VAL_ 2024 HVESPG_Enrg_Out_SUP S01_PID 188-188;
SG_MUL_VAL_ 2024 HVESPH_Enrg_Out_SUP S01_PID 188-188;
SG_MUL_VAL_ 2024 HVESS_Enrg_Out S01_PID 188-188;
SG_MUL_VAL_ 2024 HVESPA_Enrg_Out S01_PID 188-188;
SG_MUL_VAL_ 2024 HVESPB_Enrg_Out S01_PID 188-188;
SG_MUL_VAL_ 2024 HVESPC_Enrg_Out S01_PID 188-188;
SG_MUL_VAL_ 2024 HVESPD_Enrg_Out S01_PID 188-188;
SG_MUL_VAL_ 2024 HVESPE_Enrg_Out S01_PID 188-188;
SG_MUL_VAL_ 2024 HVESPF_Enrg_Out S01_PID 188-188;
SG_MUL_VAL_ 2024 HVESPG_Enrg_Out S01_PID 188-188;
SG_MUL_VAL_ 2024 HVESPH_Enrg_Out S01_PID 188-188;
SG_MUL_VAL_ 2024 HVESPA_Enrg_Tput_SUP S01_PID 189-189;
SG_MUL_VAL_ 2024 HVESPB_Enrg_Tput_SUP S01_PID 189-189;
SG_MUL_VAL_ 2024 HVESPC_Enrg_Tput_SUP S01_PID 189-189;
SG_MUL_VAL_ 2024 HVESPD_Enrg_Tput_SUP S01_PID 189-189;
SG_MUL_VAL_ 2024 HVESPE_Enrg_Tput_SUP S01_PID 189-189;
SG_MUL_VAL_ 2024 HVESPF_Enrg_Tput_SUP S01_PID 189-189;
SG_MUL_VAL_ 2024 HVESPG_Enrg_Tput_SUP S01_PID 189-189;
SG_MUL_VAL_ 2024 HVESPH_Enrg_Tput_SUP S01_PID 189-189;
SG_MUL_VAL_ 2024 HVESS_Enrg_Tput S01_PID 189-189;
SG_MUL_VAL_ 2024 HVESPA_Enrg_Tput S01_PID 189-189;
SG_MUL_VAL_ 2024 HVESPB_Enrg_Tput S01_PID 189-189;
SG_MUL_VAL_ 2024 HVESPC_Enrg_Tput S01_PID 189-189;
SG_MUL_VAL_ 2024 HVESPD_Enrg_Tput S01_PID 189-189;
SG_MUL_VAL_ 2024 HVESPE_Enrg_Tput S01_PID 189-189;
SG_MUL_VAL_ 2024 HVESPF_Enrg_Tput S01_PID 189-189;
SG_MUL_VAL_ 2024 HVESPG_Enrg_Tput S01_PID 189-189;
SG_MUL_VAL_ 2024 HVESPH_Enrg_Tput S01_PID 189-189;
SG_MUL_VAL_ 2024 HVESPA_SOH_SUP S01_PID 190-190;
SG_MUL_VAL_ 2024 HVESPB_SOH_SUP S01_PID 190-190;
SG_MUL_VAL_ 2024 HVESPC_SOH_SUP S01_PID 190-190;
SG_MUL_VAL_ 2024 HVESPD_SOH_SUP S01_PID 190-190;
SG_MUL_VAL_ 2024 HVESPE_SOH_SUP S01_PID 190-190;
SG_MUL_VAL_ 2024 HVESPF_SOH_SUP S01_PID 190-190;
SG_MUL_VAL_ 2024 HVESPG_SOH_SUP S01_PID 190-190;
SG_MUL_VAL_ 2024 HVESPH_SOH_SUP S01_PID 190-190;
SG_MUL_VAL_ 2024 HVESS_SOH S01_PID 190-190;
SG_MUL_VAL_ 2024 HVESPA_SOH S01_PID 190-190;
SG_MUL_VAL_ 2024 HVESPB_SOH S01_PID 190-190;
SG_MUL_VAL_ 2024 HVESPC_SOH S01_PID 190-190;
SG_MUL_VAL_ 2024 HVESPD_SOH S01_PID 190-190;
SG_MUL_VAL_ 2024 HVESPE_SOH S01_PID 190-190;
SG_MUL_VAL_ 2024 HVESPF_SOH S01_PID 190-190;
SG_MUL_VAL_ 2024 HVESPG_SOH S01_PID 190-190;
SG_MUL_VAL_ 2024 HVESPH_SOH S01_PID 190-190;
SG_MUL_VAL_ 2024 HVESPA_MIN_SOC_SUP S01_PID 191-191;
SG_MUL_VAL_ 2024 HVESPB_MIN_SOC_SUP S01_PID 191-191;
SG_MUL_VAL_ 2024 HVESPC_MIN_SOC_SUP S01_PID 191-191;
SG_MUL_VAL_ 2024 HVESPD_MIN_SOC_SUP S01_PID 191-191;
SG_MUL_VAL_ 2024 HVESPE_MIN_SOC_SUP S01_PID 191-191;
SG_MUL_VAL_ 2024 HVESPF_MIN_SOC_SUP S01_PID 191-191;
SG_MUL_VAL_ 2024 HVESPG_MIN_SOC_SUP S01_PID 191-191;
SG_MUL_VAL_ 2024 HVESPH_MIN_SOC_SUP S01_PID 191-191;
SG_MUL_VAL_ 2024 HVESS_MIN_SOC S01_PID 191-191;
SG_MUL_VAL_ 2024 HVESPA_MIN_SOC S01_PID 191-191;
SG_MUL_VAL_ 2024 HVESPB_MIN_SOC S01_PID 191-191;
SG_MUL_VAL_ 2024 HVESPC_MIN_SOC S01_PID 191-191;
SG_MUL_VAL_ 2024 HVESPD_MIN_SOC S01_PID 191-191;
SG_MUL_VAL_ 2024 HVESPE_MIN_SOC S01_PID 191-191;
SG_MUL_VAL_ 2024 HVESPF_MIN_SOC S01_PID 191-191;
SG_MUL_VAL_ 2024 HVESPG_MIN_SOC S01_PID 191-191;
SG_MUL_VAL_ 2024 HVESPH_MIN_SOC S01_PID 191-191;
SG_MUL_VAL_ 2024 HVESPA_MAX_SOC_SUP S01_PID 193-193;
SG_MUL_VAL_ 2024 HVESPB_MAX_SOC_SUP S01_PID 193-193;
SG_MUL_VAL_ 2024 HVESPC_MAX_SOC_SUP S01_PID 193-193;
SG_MUL_VAL_ 2024 HVESPD_MAX_SOC_SUP S01_PID 193-193;
SG_MUL_VAL_ 2024 HVESPE_MAX_SOC_SUP S01_PID 193-193;
SG_MUL_VAL_ 2024 HVESPF_MAX_SOC_SUP S01_PID 193-193;
SG_MUL_VAL_ 2024 HVESPG_MAX_SOC_SUP S01_PID 193-193;
SG_MUL_VAL_ 2024 HVESPH_MAX_SOC_SUP S01_PID 193-193;
SG_MUL_VAL_ 2024 HVESS_MAX_SOC S01_PID 193-193;
SG_MUL_VAL_ 2024 HVESPA_MAX_SOC S01_PID 193-193;
SG_MUL_VAL_ 2024 HVESPB_MAX_SOC S01_PID 193-193;
SG_MUL_VAL_ 2024 HVESPC_MAX_SOC S01_PID 193-193;
SG_MUL_VAL_ 2024 HVESPD_MAX_SOC S01_PID 193-193;
SG_MUL_VAL_ 2024 HVESPE_MAX_SOC S01_PID 193-193;
SG_MUL_VAL_ 2024 HVESPF_MAX_SOC S01_PID 193-193;
SG_MUL_VAL_ 2024 HVESPG_MAX_SOC S01_PID 193-193;
SG_MUL_VAL_ 2024 HVESPH_MAX_SOC S01_PID 193-193;
SG_MUL_VAL_ 2024 HVESPA_DEnrg_CAP_SUP S01_PID 194-194;
SG_MUL_VAL_ 2024 HVESPB_DEnrg_CAP_SUP S01_PID 194-194;
SG_MUL_VAL_ 2024 HVESPC_DEnrg_CAP_SUP S01_PID 194-194;
SG_MUL_VAL_ 2024 HVESPD_DEnrg_CAP_SUP S01_PID 194-194;
SG_MUL_VAL_ 2024 HVESPE_DEnrg_CAP_SUP S01_PID 194-194;
SG_MUL_VAL_ 2024 HVESPF_DEnrg_CAP_SUP S01_PID 194-194;
SG_MUL_VAL_ 2024 HVESPG_DEnrg_CAP_SUP S01_PID 194-194;
SG_MUL_VAL_ 2024 HVESPH_DEnrg_CAP_SUP S01_PID 194-194;
SG_MUL_VAL_ 2024 HVESS_DEnrg_CAP S01_PID 194-194;
SG_MUL_VAL_ 2024 HVESPA_DEnrg_CAP S01_PID 194-194;
SG_MUL_VAL_ 2024 HVESPB_DEnrg_CAP S01_PID 194-194;
SG_MUL_VAL_ 2024 HVESPC_DEnrg_CAP S01_PID 194-194;
SG_MUL_VAL_ 2024 HVESPD_DEnrg_CAP S01_PID 194-194;
SG_MUL_VAL_ 2024 HVESPE_DEnrg_CAP S01_PID 194-194;
SG_MUL_VAL_ 2024 HVESPF_DEnrg_CAP S01_PID 194-194;
SG_MUL_VAL_ 2024 HVESPG_DEnrg_CAP S01_PID 194-194;
SG_MUL_VAL_ 2024 HVESPH_DEnrg_CAP S01_PID 194-194;
SG_MUL_VAL_ 2024 FLI_A_SUP S01_PID 195-195;
SG_MUL_VAL_ 2024 FLI_B_SUP S01_PID 195-195;
SG_MUL_VAL_ 2024 FLI_A S01_PID 195-195;
SG_MUL_VAL_ 2024 FLI_B S01_PID 195-195;
SG_MUL_VAL_ 2024 EXH_PM_TIME S01_PID 196-196;
SG_MUL_VAL_ 2024 EXH_PM_OCC_CNT S01_PID 196-196;
SG_MUL_VAL_ 2024 LFP_A_SUP S01_PID 197-197;
SG_MUL_VAL_ 2024 LFP_B_SUP S01_PID 197-197;
SG_MUL_VAL_ 2024 LFP_A S01_PID 197-197;
SG_MUL_VAL_ 2024 LFP_B S01_PID 197-197;
SG_MUL_VAL_ 2024 PM_WARN_ACT_SUP S01_PID 198-198;
SG_MUL_VAL_ 2024 DPF_REMOVAL_BLOCKED_TIME_SUP S01_PID 198-198;
SG_MUL_VAL_ 2024 LRIS_FAILURE_TIME_SUP S01_PID 198-198;
SG_MUL_VAL_ 2024 PCD_FAILURE_TIME_SUP S01_PID 198-198;
SG_MUL_VAL_ 2024 PM_WARN_ACT S01_PID 198-198;
SG_MUL_VAL_ 2024 PCL_INDUC_L1 S01_PID 198-198;
SG_MUL_VAL_ 2024 PCL_INDUC_L2 S01_PID 198-198;
SG_MUL_VAL_ 2024 PCL_INDUC_L3 S01_PID 198-198;
SG_MUL_VAL_ 2024 DPF_REMOVAL_BLOCKED_TIME S01_PID 198-198;
SG_MUL_VAL_ 2024 LRIS_FAILURE_TIME S01_PID 198-198;
SG_MUL_VAL_ 2024 PCD_FAILURE_TIME S01_PID 198-198;
SG_MUL_VAL_ 2024 REFLASH_DIST S01_PID 199-199;
SG_MUL_VAL_ 2024 NCD_PCD_WL S01_PID 200-200;
SG_MUL_VAL_ 2024 NCD_WL S01_PID 200-200;
SG_MUL_VAL_ 2024 PCD_WL S01_PID 200-200;
SG_MUL_VAL_ 2024 O2S15_PCT_SUP S01_PID 201-201;
SG_MUL_VAL_ 2024 O2S16_PCT_SUP S01_PID 201-201;
SG_MUL_VAL_ 2024 O2S25_PCT_SUP S01_PID 201-201;
SG_MUL_VAL_ 2024 O2S26_PCT_SUP S01_PID 201-201;
SG_MUL_VAL_ 2024 O2S15_PCT_LAMBDA_SUP S01_PID 201-201;
SG_MUL_VAL_ 2024 O2S16_PCT_LAMBDA_SUP S01_PID 201-201;
SG_MUL_VAL_ 2024 O2S25_PCT_LAMBDA_SUP S01_PID 201-201;
SG_MUL_VAL_ 2024 O2S26_PCT_LAMBDA_SUP S01_PID 201-201;
SG_MUL_VAL_ 2024 O2S15_PCT S01_PID 201-201;
SG_MUL_VAL_ 2024 O2S16_PCT S01_PID 201-201;
SG_MUL_VAL_ 2024 O2S25_PCT S01_PID 201-201;
SG_MUL_VAL_ 2024 O2S26_PCT S01_PID 201-201;
SG_MUL_VAL_ 2024 O2S15_PCT_LAMBDA S01_PID 201-201;
SG_MUL_VAL_ 2024 O2S16_PCT_LAMBDA S01_PID 201-201;
SG_MUL_VAL_ 2024 O2S25_PCT_LAMBDA S01_PID 201-201;
SG_MUL_VAL_ 2024 O2S26_PCT_LAMBDA S01_PID 201-201;
SG_MUL_VAL_ 2024 TIME_TO_INDUC_L1_SUP S01_PID 202-202;
SG_MUL_VAL_ 2024 TIME_TO_INDUC_L2_SUP S01_PID 202-202;
SG_MUL_VAL_ 2024 TIME_TO_INDUC_L3_SUP S01_PID 202-202;
SG_MUL_VAL_ 2024 TIME_TO_INDUC_L1 S01_PID 202-202;
SG_MUL_VAL_ 2024 TIME_TO_INDUC_L2 S01_PID 202-202;
SG_MUL_VAL_ 2024 TIME_TO_INDUC_L3 S01_PID 202-202;
SG_MUL_VAL_ 2024 EP_12_SUP S01_PID 203-203;
SG_MUL_VAL_ 2024 EP_22_SUP S01_PID 203-203;
SG_MUL_VAL_ 2024 EP_12 S01_PID 203-203;
SG_MUL_VAL_ 2024 EP_22 S01_PID 203-203;
SG_MUL_VAL_ 2024 EM_A_RPM_SUP S01_PID 204-204;
SG_MUL_VAL_ 2024 EM_B_RPM_SUP S01_PID 204-204;
SG_MUL_VAL_ 2024 EM_C_RPM_SUP S01_PID 204-204;
SG_MUL_VAL_ 2024 EM_D_RPM_SUP S01_PID 204-204;
SG_MUL_VAL_ 2024 EM_E_RPM_SUP S01_PID 204-204;
SG_MUL_VAL_ 2024 EM_F_RPM_SUP S01_PID 204-204;
SG_MUL_VAL_ 2024 EM_G_RPM_SUP S01_PID 204-204;
SG_MUL_VAL_ 2024 EM_H_RPM_SUP S01_PID 204-204;
SG_MUL_VAL_ 2024 EM_A_RPM S01_PID 204-204;
SG_MUL_VAL_ 2024 EM_B_RPM S01_PID 204-204;
SG_MUL_VAL_ 2024 EM_C_RPM S01_PID 204-204;
SG_MUL_VAL_ 2024 EM_D_RPM S01_PID 204-204;
SG_MUL_VAL_ 2024 EM_E_RPM S01_PID 204-204;
SG_MUL_VAL_ 2024 EM_F_RPM S01_PID 204-204;
SG_MUL_VAL_ 2024 EM_G_RPM S01_PID 204-204;
SG_MUL_VAL_ 2024 EM_H_RPM S01_PID 204-204;
SG_MUL_VAL_ 2024 EM_A_TQ_SUP S01_PID 205-205;
SG_MUL_VAL_ 2024 EM_B_TQ_SUP S01_PID 205-205;
SG_MUL_VAL_ 2024 EM_C_TQ_SUP S01_PID 205-205;
SG_MUL_VAL_ 2024 EM_D_TQ_SUP S01_PID 205-205;
SG_MUL_VAL_ 2024 EM_E_TQ_SUP S01_PID 205-205;
SG_MUL_VAL_ 2024 EM_F_TQ_SUP S01_PID 205-205;
SG_MUL_VAL_ 2024 EM_G_TQ_SUP S01_PID 205-205;
SG_MUL_VAL_ 2024 EM_H_TQ_SUP S01_PID 205-205;
SG_MUL_VAL_ 2024 EM_A_TQ S01_PID 205-205;
SG_MUL_VAL_ 2024 EM_B_TQ S01_PID 205-205;
SG_MUL_VAL_ 2024 EM_C_TQ S01_PID 205-205;
SG_MUL_VAL_ 2024 EM_D_TQ S01_PID 205-205;
SG_MUL_VAL_ 2024 EM_E_TQ S01_PID 205-205;
SG_MUL_VAL_ 2024 EM_F_TQ S01_PID 205-205;
SG_MUL_VAL_ 2024 EM_G_TQ S01_PID 205-205;
SG_MUL_VAL_ 2024 EM_H_TQ S01_PID 205-205;
SG_MUL_VAL_ 2024 FRNO S02_PID 1-31, 33-63, 65-95, 97-127, 129-159, 161-191, 193-255;
SG_MUL_VAL_ 2024 S02_DTC_CNT S02_PID 1-1;
SG_MUL_VAL_ 2024 S02_MIL S02_PID 1-1;
SG_MUL_VAL_ 2024 S02_MIS_SUP S02_PID 1-1;
SG_MUL_VAL_ 2024 S02_FUEL_SUP S02_PID 1-1;
SG_MUL_VAL_ 2024 S02_CCM_SUP S02_PID 1-1;
SG_MUL_VAL_ 2024 S02_CIM_SUP S02_PID 1-1;
SG_MUL_VAL_ 2024 S02_MIS_RDY S02_PID 1-1;
SG_MUL_VAL_ 2024 S02_FUEL_RDY S02_PID 1-1;
SG_MUL_VAL_ 2024 S02_CCM_RDY S02_PID 1-1;
SG_MUL_VAL_ 2024 S02_CAT_SUP S02_CIM_SUP 0-0;
SG_MUL_VAL_ 2024 S02_HCAT_SUP S02_CIM_SUP 0-0;
SG_MUL_VAL_ 2024 S02_EVAP_SUP S02_CIM_SUP 0-0;
SG_MUL_VAL_ 2024 S02_AIR_SUP S02_CIM_SUP 0-0;
SG_MUL_VAL_ 2024 S02_GPF_SUP S02_CIM_SUP 0-0;
SG_MUL_VAL_ 2024 S02_O2S_SUP S02_CIM_SUP 0-0;
SG_MUL_VAL_ 2024 S02_HTR_SUP S02_CIM_SUP 0-0;
SG_MUL_VAL_ 2024 S02_EGR_SUP S02_CIM_SUP 0-0;
SG_MUL_VAL_ 2024 S02_CAT_RDY S02_CIM_SUP 0-0;
SG_MUL_VAL_ 2024 S02_HCAT_RDY S02_CIM_SUP 0-0;
SG_MUL_VAL_ 2024 S02_EVAP_RDY S02_CIM_SUP 0-0;
SG_MUL_VAL_ 2024 S02_AIR_RDY S02_CIM_SUP 0-0;
SG_MUL_VAL_ 2024 S02_GPF_RDY S02_CIM_SUP 0-0;
SG_MUL_VAL_ 2024 S02_O2S_RDY S02_CIM_SUP 0-0;
SG_MUL_VAL_ 2024 S02_HTR_RDY S02_CIM_SUP 0-0;
SG_MUL_VAL_ 2024 S02_EGR_RDY S02_CIM_SUP 0-0;
SG_MUL_VAL_ 2024 S02_HCCATSUP S02_CIM_SUP 1-1;
SG_MUL_VAL_ 2024 S02_NCAT_SUP S02_CIM_SUP 1-1;
SG_MUL_VAL_ 2024 S02_BP_SUP S02_CIM_SUP 1-1;
SG_MUL_VAL_ 2024 S02_EGS_SUP S02_CIM_SUP 1-1;
SG_MUL_VAL_ 2024 S02_PM_SUP S02_CIM_SUP 1-1;
SG_MUL_VAL_ 2024 S02_HCCATRDY S02_CIM_SUP 1-1;
SG_MUL_VAL_ 2024 S02_NCAT_RDY S02_CIM_SUP 1-1;
SG_MUL_VAL_ 2024 S02_BP_RDY S02_CIM_SUP 1-1;
SG_MUL_VAL_ 2024 S02_EGS_RDY S02_CIM_SUP 1-1;
SG_MUL_VAL_ 2024 S02_PM_RDY S02_CIM_SUP 1-1;
SG_MUL_VAL_ 2024 S02_DTCFRZF S02_PID 2-2;
SG_MUL_VAL_ 2024 S02_FUELSYSA_OL S02_PID 3-3;
SG_MUL_VAL_ 2024 S02_FUELSYSA_CL S02_PID 3-3;
SG_MUL_VAL_ 2024 S02_FUELSYSA_OL_Drive S02_PID 3-3;
SG_MUL_VAL_ 2024 S02_FUELSYSA_OL_Fault S02_PID 3-3;
SG_MUL_VAL_ 2024 S02_FUELSYSA_CL_Fault S02_PID 3-3;
SG_MUL_VAL_ 2024 S02_FUELSYSA_OL_B2 S02_PID 3-3;
SG_MUL_VAL_ 2024 S02_FUELSYSA_OL_Drive_B2 S02_PID 3-3;
SG_MUL_VAL_ 2024 S02_FUELSYSA_OL_Fault_B2 S02_PID 3-3;
SG_MUL_VAL_ 2024 S02_FUELSYSB_OL S02_PID 3-3;
SG_MUL_VAL_ 2024 S02_FUELSYSB_CL S02_PID 3-3;
SG_MUL_VAL_ 2024 S02_FUELSYSB_OL_Drive S02_PID 3-3;
SG_MUL_VAL_ 2024 S02_FUELSYSB_OL_Fault S02_PID 3-3;
SG_MUL_VAL_ 2024 S02_FUELSYSB_CL_Fault S02_PID 3-3;
SG_MUL_VAL_ 2024 S02_FUELSYSB_OL_B2 S02_PID 3-3;
SG_MUL_VAL_ 2024 S02_FUELSYSB_OL_Drive_B2 S02_PID 3-3;
SG_MUL_VAL_ 2024 S02_FUELSYSB_OL_Fault_B2 S02_PID 3-3;
SG_MUL_VAL_ 2024 S02_LOAD_PCT S02_PID 4-4;
SG_MUL_VAL_ 2024 S02_ECT S02_PID 5-5;
SG_MUL_VAL_ 2024 S02_SHRTFT1 S02_PID 6-6;
SG_MUL_VAL_ 2024 S02_SHRTFT3 S02_PID 6-6;
SG_MUL_VAL_ 2024 S02_LONGFT1 S02_PID 7-7;
