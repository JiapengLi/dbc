VERSION "v0.0.1"

NS_ :

BS_:

BU_:

BO_ 2024 RX: 64 ECU
 SG_ RXLEN : 0|8@1+ (1,0) [0|0] "" TOOL
 SG_ SERVICE M : 8|4@1+ (1,0) [0|0] "" TOOL
 SG_ RXACK : 12|4@1+ (1,0) [0|0] "" TOOL
 SG_ S01_PID m1M : 16|8@1+ (1,0) [0|0] "" TOOL
 SG_ S02_PID m2M : 16|8@1+ (1,0) [0|0] "" TOOL
 SG_ S03_PID m3M : 16|8@1+ (1,0) [0|0] "" TOOL
 SG_ S04_PID m4M : 16|8@1+ (1,0) [0|0] "" TOOL
 SG_ S05_PID m5M : 16|8@1+ (1,0) [0|0] "" TOOL
 SG_ S06_PID m6M : 16|8@1+ (1,0) [0|0] "" TOOL
 SG_ S07_PID m7M : 16|8@1+ (1,0) [0|0] "" TOOL
 SG_ S08_PID m8M : 16|8@1+ (1,0) [0|0] "" TOOL
 SG_ S09_PID m9M : 16|8@1+ (1,0) [0|0] "" TOOL
 SG_ S0A_PID m10M : 16|8@1+ (1,0) [0|0] "" TOOL
 SG_ S01_PID00_SupportedIDs_01_20 m0 : 24|32@1+ (1,0) [0|0] "" TOOL
 SG_ S02_PID00_SupportedIDs_01_20 m0 : 24|32@1+ (1,0) [0|0] "" TOOL
 SG_ S03_PID00_SupportedIDs_01_20 m0 : 24|32@1+ (1,0) [0|0] "" TOOL
 SG_ S04_PID00_SupportedIDs_01_20 m0 : 24|32@1+ (1,0) [0|0] "" TOOL
 SG_ S05_PID00_SupportedIDs_01_20 m0 : 24|32@1+ (1,0) [0|0] "" TOOL
 SG_ S06_PID00_SupportedIDs_01_20 m0 : 24|32@1+ (1,0) [0|0] "" TOOL
 SG_ S07_PID00_SupportedIDs_01_20 m0 : 24|32@1+ (1,0) [0|0] "" TOOL
 SG_ S08_PID00_SupportedIDs_01_20 m0 : 24|32@1+ (1,0) [0|0] "" TOOL
 SG_ S09_PID00_SupportedIDs_01_20 m0 : 24|32@1+ (1,0) [0|0] "" TOOL
 SG_ S0A_PID00_SupportedIDs_01_20 m0 : 24|32@1+ (1,0) [0|0] "" TOOL
 SG_ S01_PID20_SupportedIDs_21_40 m32 : 24|32@1+ (1,0) [0|0] "" TOOL
 SG_ S02_PID20_SupportedIDs_21_40 m32 : 24|32@1+ (1,0) [0|0] "" TOOL
 SG_ S03_PID20_SupportedIDs_21_40 m32 : 24|32@1+ (1,0) [0|0] "" TOOL
 SG_ S04_PID20_SupportedIDs_21_40 m32 : 24|32@1+ (1,0) [0|0] "" TOOL
 SG_ S05_PID20_SupportedIDs_21_40 m32 : 24|32@1+ (1,0) [0|0] "" TOOL
 SG_ S06_PID20_SupportedIDs_21_40 m32 : 24|32@1+ (1,0) [0|0] "" TOOL
 SG_ S07_PID20_SupportedIDs_21_40 m32 : 24|32@1+ (1,0) [0|0] "" TOOL
 SG_ S08_PID20_SupportedIDs_21_40 m32 : 24|32@1+ (1,0) [0|0] "" TOOL
 SG_ S09_PID20_SupportedIDs_21_40 m32 : 24|32@1+ (1,0) [0|0] "" TOOL
 SG_ S0A_PID20_SupportedIDs_21_40 m32 : 24|32@1+ (1,0) [0|0] "" TOOL
 SG_ S01_PID40_SupportedIDs_41_60 m64 : 24|32@1+ (1,0) [0|0] "" TOOL
 SG_ S02_PID40_SupportedIDs_41_60 m64 : 24|32@1+ (1,0) [0|0] "" TOOL
 SG_ S03_PID40_SupportedIDs_41_60 m64 : 24|32@1+ (1,0) [0|0] "" TOOL
 SG_ S04_PID40_SupportedIDs_41_60 m64 : 24|32@1+ (1,0) [0|0] "" TOOL
 SG_ S05_PID40_SupportedIDs_41_60 m64 : 24|32@1+ (1,0) [0|0] "" TOOL
 SG_ S06_PID40_SupportedIDs_41_60 m64 : 24|32@1+ (1,0) [0|0] "" TOOL
 SG_ S07_PID40_SupportedIDs_41_60 m64 : 24|32@1+ (1,0) [0|0] "" TOOL
 SG_ S08_PID40_SupportedIDs_41_60 m64 : 24|32@1+ (1,0) [0|0] "" TOOL
 SG_ S09_PID40_SupportedIDs_41_60 m64 : 24|32@1+ (1,0) [0|0] "" TOOL
 SG_ S0A_PID40_SupportedIDs_41_60 m64 : 24|32@1+ (1,0) [0|0] "" TOOL
 SG_ S01_PID60_SupportedIDs_61_80 m96 : 24|32@1+ (1,0) [0|0] "" TOOL
 SG_ S02_PID60_SupportedIDs_61_80 m96 : 24|32@1+ (1,0) [0|0] "" TOOL
 SG_ S03_PID60_SupportedIDs_61_80 m96 : 24|32@1+ (1,0) [0|0] "" TOOL
 SG_ S04_PID60_SupportedIDs_61_80 m96 : 24|32@1+ (1,0) [0|0] "" TOOL
 SG_ S05_PID60_SupportedIDs_61_80 m96 : 24|32@1+ (1,0) [0|0] "" TOOL
 SG_ S06_PID60_SupportedIDs_61_80 m96 : 24|32@1+ (1,0) [0|0] "" TOOL
 SG_ S07_PID60_SupportedIDs_61_80 m96 : 24|32@1+ (1,0) [0|0] "" TOOL
 SG_ S08_PID60_SupportedIDs_61_80 m96 : 24|32@1+ (1,0) [0|0] "" TOOL
 SG_ S09_PID60_SupportedIDs_61_80 m96 : 24|32@1+ (1,0) [0|0] "" TOOL
 SG_ S0A_PID60_SupportedIDs_61_80 m96 : 24|32@1+ (1,0) [0|0] "" TOOL
 SG_ S01_PID80_SupportedIDs_81_A0 m128 : 24|32@1+ (1,0) [0|0] "" TOOL
 SG_ S02_PID80_SupportedIDs_81_A0 m128 : 24|32@1+ (1,0) [0|0] "" TOOL
 SG_ S03_PID80_SupportedIDs_81_A0 m128 : 24|32@1+ (1,0) [0|0] "" TOOL
 SG_ S04_PID80_SupportedIDs_81_A0 m128 : 24|32@1+ (1,0) [0|0] "" TOOL
 SG_ S05_PID80_SupportedIDs_81_A0 m128 : 24|32@1+ (1,0) [0|0] "" TOOL
 SG_ S06_PID80_SupportedIDs_81_A0 m128 : 24|32@1+ (1,0) [0|0] "" TOOL
 SG_ S07_PID80_SupportedIDs_81_A0 m128 : 24|32@1+ (1,0) [0|0] "" TOOL
 SG_ S08_PID80_SupportedIDs_81_A0 m128 : 24|32@1+ (1,0) [0|0] "" TOOL
 SG_ S09_PID80_SupportedIDs_81_A0 m128 : 24|32@1+ (1,0) [0|0] "" TOOL
 SG_ S0A_PID80_SupportedIDs_81_A0 m128 : 24|32@1+ (1,0) [0|0] "" TOOL
 SG_ S01_PIDA0_SupportedIDs_A1_C0 m160 : 24|32@1+ (1,0) [0|0] "" TOOL
 SG_ S02_PIDA0_SupportedIDs_A1_C0 m160 : 24|32@1+ (1,0) [0|0] "" TOOL
 SG_ S03_PIDA0_SupportedIDs_A1_C0 m160 : 24|32@1+ (1,0) [0|0] "" TOOL
 SG_ S04_PIDA0_SupportedIDs_A1_C0 m160 : 24|32@1+ (1,0) [0|0] "" TOOL
 SG_ S05_PIDA0_SupportedIDs_A1_C0 m160 : 24|32@1+ (1,0) [0|0] "" TOOL
 SG_ S06_PIDA0_SupportedIDs_A1_C0 m160 : 24|32@1+ (1,0) [0|0] "" TOOL
 SG_ S07_PIDA0_SupportedIDs_A1_C0 m160 : 24|32@1+ (1,0) [0|0] "" TOOL
 SG_ S08_PIDA0_SupportedIDs_A1_C0 m160 : 24|32@1+ (1,0) [0|0] "" TOOL
 SG_ S09_PIDA0_SupportedIDs_A1_C0 m160 : 24|32@1+ (1,0) [0|0] "" TOOL
 SG_ S0A_PIDA0_SupportedIDs_A1_C0 m160 : 24|32@1+ (1,0) [0|0] "" TOOL
 SG_ S01_PIDC0_SupportedIDs_C1_E0 m192 : 24|32@1+ (1,0) [0|0] "" TOOL
 SG_ S02_PIDC0_SupportedIDs_C1_E0 m192 : 24|32@1+ (1,0) [0|0] "" TOOL
 SG_ S03_PIDC0_SupportedIDs_C1_E0 m192 : 24|32@1+ (1,0) [0|0] "" TOOL
 SG_ S04_PIDC0_SupportedIDs_C1_E0 m192 : 24|32@1+ (1,0) [0|0] "" TOOL
 SG_ S05_PIDC0_SupportedIDs_C1_E0 m192 : 24|32@1+ (1,0) [0|0] "" TOOL
 SG_ S06_PIDC0_SupportedIDs_C1_E0 m192 : 24|32@1+ (1,0) [0|0] "" TOOL
 SG_ S07_PIDC0_SupportedIDs_C1_E0 m192 : 24|32@1+ (1,0) [0|0] "" TOOL
 SG_ S08_PIDC0_SupportedIDs_C1_E0 m192 : 24|32@1+ (1,0) [0|0] "" TOOL
 SG_ S09_PIDC0_SupportedIDs_C1_E0 m192 : 24|32@1+ (1,0) [0|0] "" TOOL
 SG_ S0A_PIDC0_SupportedIDs_C1_E0 m192 : 24|32@1+ (1,0) [0|0] "" TOOL

 SG_ S09_PID02_VIN m2 : 32|136@1+ (1,0) [0|0] "" TOOL

SG_MUL_VAL_ 2024 S01_PID SERVICE 1-1;
SG_MUL_VAL_ 2024 S02_PID SERVICE 2-2;
SG_MUL_VAL_ 2024 S03_PID SERVICE 3-3;
SG_MUL_VAL_ 2024 S04_PID SERVICE 4-4;
SG_MUL_VAL_ 2024 S05_PID SERVICE 5-5;
SG_MUL_VAL_ 2024 S06_PID SERVICE 6-6;
SG_MUL_VAL_ 2024 S07_PID SERVICE 7-7;
SG_MUL_VAL_ 2024 S08_PID SERVICE 8-8;
SG_MUL_VAL_ 2024 S09_PID SERVICE 9-9;
SG_MUL_VAL_ 2024 S0A_PID SERVICE 10-10;

SG_MUL_VAL_ 2024 S01_PID00_SupportedIDs_01_20 S01_PID 0-0;
SG_MUL_VAL_ 2024 S02_PID00_SupportedIDs_01_20 S02_PID 0-0;
SG_MUL_VAL_ 2024 S03_PID00_SupportedIDs_01_20 S03_PID 0-0;
SG_MUL_VAL_ 2024 S04_PID00_SupportedIDs_01_20 S04_PID 0-0;
SG_MUL_VAL_ 2024 S05_PID00_SupportedIDs_01_20 S05_PID 0-0;
SG_MUL_VAL_ 2024 S06_PID00_SupportedIDs_01_20 S06_PID 0-0;
SG_MUL_VAL_ 2024 S07_PID00_SupportedIDs_01_20 S07_PID 0-0;
SG_MUL_VAL_ 2024 S08_PID00_SupportedIDs_01_20 S08_PID 0-0;
SG_MUL_VAL_ 2024 S09_PID00_SupportedIDs_01_20 S09_PID 0-0;
SG_MUL_VAL_ 2024 S0A_PID00_SupportedIDs_01_20 S0A_PID 0-0;
SG_MUL_VAL_ 2024 S01_PID20_SupportedIDs_21_40 S01_PID 32-32;
SG_MUL_VAL_ 2024 S02_PID20_SupportedIDs_21_40 S02_PID 32-32;
SG_MUL_VAL_ 2024 S03_PID20_SupportedIDs_21_40 S03_PID 32-32;
SG_MUL_VAL_ 2024 S04_PID20_SupportedIDs_21_40 S04_PID 32-32;
SG_MUL_VAL_ 2024 S05_PID20_SupportedIDs_21_40 S05_PID 32-32;
SG_MUL_VAL_ 2024 S06_PID20_SupportedIDs_21_40 S06_PID 32-32;
SG_MUL_VAL_ 2024 S07_PID20_SupportedIDs_21_40 S07_PID 32-32;
SG_MUL_VAL_ 2024 S08_PID20_SupportedIDs_21_40 S08_PID 32-32;
SG_MUL_VAL_ 2024 S09_PID20_SupportedIDs_21_40 S09_PID 32-32;
SG_MUL_VAL_ 2024 S0A_PID20_SupportedIDs_21_40 S0A_PID 32-32;
SG_MUL_VAL_ 2024 S01_PID40_SupportedIDs_41_60 S01_PID 64-64;
SG_MUL_VAL_ 2024 S02_PID40_SupportedIDs_41_60 S02_PID 64-64;
SG_MUL_VAL_ 2024 S03_PID40_SupportedIDs_41_60 S03_PID 64-64;
SG_MUL_VAL_ 2024 S04_PID40_SupportedIDs_41_60 S04_PID 64-64;
SG_MUL_VAL_ 2024 S05_PID40_SupportedIDs_41_60 S05_PID 64-64;
SG_MUL_VAL_ 2024 S06_PID40_SupportedIDs_41_60 S06_PID 64-64;
SG_MUL_VAL_ 2024 S07_PID40_SupportedIDs_41_60 S07_PID 64-64;
SG_MUL_VAL_ 2024 S08_PID40_SupportedIDs_41_60 S08_PID 64-64;
SG_MUL_VAL_ 2024 S09_PID40_SupportedIDs_41_60 S09_PID 64-64;
SG_MUL_VAL_ 2024 S0A_PID40_SupportedIDs_41_60 S0A_PID 64-64;
SG_MUL_VAL_ 2024 S01_PID60_SupportedIDs_61_80 S01_PID 96-96;
SG_MUL_VAL_ 2024 S02_PID60_SupportedIDs_61_80 S02_PID 96-96;
SG_MUL_VAL_ 2024 S03_PID60_SupportedIDs_61_80 S03_PID 96-96;
SG_MUL_VAL_ 2024 S04_PID60_SupportedIDs_61_80 S04_PID 96-96;
SG_MUL_VAL_ 2024 S05_PID60_SupportedIDs_61_80 S05_PID 96-96;
SG_MUL_VAL_ 2024 S06_PID60_SupportedIDs_61_80 S06_PID 96-96;
SG_MUL_VAL_ 2024 S07_PID60_SupportedIDs_61_80 S07_PID 96-96;
SG_MUL_VAL_ 2024 S08_PID60_SupportedIDs_61_80 S08_PID 96-96;
SG_MUL_VAL_ 2024 S09_PID60_SupportedIDs_61_80 S09_PID 96-96;
SG_MUL_VAL_ 2024 S0A_PID60_SupportedIDs_61_80 S0A_PID 96-96;
SG_MUL_VAL_ 2024 S01_PID80_SupportedIDs_81_A0 S01_PID 128-128;
SG_MUL_VAL_ 2024 S02_PID80_SupportedIDs_81_A0 S02_PID 128-128;
SG_MUL_VAL_ 2024 S03_PID80_SupportedIDs_81_A0 S03_PID 128-128;
SG_MUL_VAL_ 2024 S04_PID80_SupportedIDs_81_A0 S04_PID 128-128;
SG_MUL_VAL_ 2024 S05_PID80_SupportedIDs_81_A0 S05_PID 128-128;
SG_MUL_VAL_ 2024 S06_PID80_SupportedIDs_81_A0 S06_PID 128-128;
SG_MUL_VAL_ 2024 S07_PID80_SupportedIDs_81_A0 S07_PID 128-128;
SG_MUL_VAL_ 2024 S08_PID80_SupportedIDs_81_A0 S08_PID 128-128;
SG_MUL_VAL_ 2024 S09_PID80_SupportedIDs_81_A0 S09_PID 128-128;
SG_MUL_VAL_ 2024 S0A_PID80_SupportedIDs_81_A0 S0A_PID 128-128;
SG_MUL_VAL_ 2024 S01_PIDA0_SupportedIDs_A1_C0 S01_PID 160-160;
SG_MUL_VAL_ 2024 S02_PIDA0_SupportedIDs_A1_C0 S02_PID 160-160;
SG_MUL_VAL_ 2024 S03_PIDA0_SupportedIDs_A1_C0 S03_PID 160-160;
SG_MUL_VAL_ 2024 S04_PIDA0_SupportedIDs_A1_C0 S04_PID 160-160;
SG_MUL_VAL_ 2024 S05_PIDA0_SupportedIDs_A1_C0 S05_PID 160-160;
SG_MUL_VAL_ 2024 S06_PIDA0_SupportedIDs_A1_C0 S06_PID 160-160;
SG_MUL_VAL_ 2024 S07_PIDA0_SupportedIDs_A1_C0 S07_PID 160-160;
SG_MUL_VAL_ 2024 S08_PIDA0_SupportedIDs_A1_C0 S08_PID 160-160;
SG_MUL_VAL_ 2024 S09_PIDA0_SupportedIDs_A1_C0 S09_PID 160-160;
SG_MUL_VAL_ 2024 S0A_PIDA0_SupportedIDs_A1_C0 S0A_PID 160-160;
SG_MUL_VAL_ 2024 S01_PIDC0_SupportedIDs_C1_E0 S01_PID 192-192;
SG_MUL_VAL_ 2024 S02_PIDC0_SupportedIDs_C1_E0 S02_PID 192-192;
SG_MUL_VAL_ 2024 S03_PIDC0_SupportedIDs_C1_E0 S03_PID 192-192;
SG_MUL_VAL_ 2024 S04_PIDC0_SupportedIDs_C1_E0 S04_PID 192-192;
SG_MUL_VAL_ 2024 S05_PIDC0_SupportedIDs_C1_E0 S05_PID 192-192;
SG_MUL_VAL_ 2024 S06_PIDC0_SupportedIDs_C1_E0 S06_PID 192-192;
SG_MUL_VAL_ 2024 S07_PIDC0_SupportedIDs_C1_E0 S07_PID 192-192;
SG_MUL_VAL_ 2024 S08_PIDC0_SupportedIDs_C1_E0 S08_PID 192-192;
SG_MUL_VAL_ 2024 S09_PIDC0_SupportedIDs_C1_E0 S09_PID 192-192;
SG_MUL_VAL_ 2024 S0A_PIDC0_SupportedIDs_C1_E0 S0A_PID 192-192;
SG_MUL_VAL_ 2024 S09_PID02_VIN S09_PID 2-2;
