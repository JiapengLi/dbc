VERSION "v0.0.1"

NS_ :

BS_:

BU_:

BO_ 2024 RX: 64 ECU
 SG_ SID M : 8|4@1+ (1,0) [0|0] "" TOOL
 SG_ S02_PID m2M : 16|8@1+ (1,0) [0|0] "" TOOL
 SG_ S09_PID m9M : 16|8@1+ (1,0) [0|0] "" TOOL
 SG_ S02_LONGFT3 m7 : 40|8@1- (0.78125,0) [-100|99.21875] "%" TOOL
 SG_ S02_SHRTFT2 m8 : 32|8@1- (0.78125,0) [-100|99.21875] "%" TOOL
 SG_ S02_SHRTFT4 m8 : 40|8@1- (0.78125,0) [-100|99.21875] "%" TOOL
 SG_ S02_LONGFT2 m9 : 32|8@1- (0.78125,0) [-100|99.21875] "%" TOOL
 SG_ S02_LONGFT4 m9 : 40|8@1- (0.78125,0) [-100|99.21875] "%" TOOL
 SG_ S02_FPGAUGE m10 : 32|8@1+ (3,0) [0|0] "kPa" TOOL
 SG_ S02_MAP m11 : 32|8@1+ (1,0) [0|0] "kPa" TOOL
 SG_ S02_RPM m12 : 39|16@0+ (0.25,0) [0|0] "rpm" TOOL
 SG_ S02_VSS m13 : 32|8@1+ (1,0) [0|0] "km/h" TOOL
 SG_ S02_SPARKADV m14 : 32|8@1+ (0.5,64) [0|0] "°" TOOL
 SG_ S02_IAT m15 : 32|8@1+ (1,-40) [0|0] "°C " TOOL
 SG_ S02_MAF m16 : 39|16@0+ (0.01,0) [0|0] "g/s" TOOL
 SG_ S02_TP m17 : 32|8@1+ (0.3921569,0) [0|0] "%" TOOL
 SG_ S02_AIR_STAT_UPS m18 : 32|1@1+ (1,0) [0|0] "" TOOL
 SG_ S02_AIR_STAT_DNS m18 : 33|1@1+ (1,0) [0|0] "" TOOL
 SG_ S02_AIR_STAT_OFF m18 : 34|1@1+ (1,0) [0|0] "" TOOL
 SG_ S02_AIR_STAT_DIAG m18 : 35|1@1+ (1,0) [0|0] "" TOOL
 SG_ S02_O2SLOC_A1 m19 : 32|1@1+ (1,0) [0|0] "" TOOL
 SG_ S02_O2SLOC_A2 m19 : 33|1@1+ (1,0) [0|0] "" TOOL
 SG_ S02_O2SLOC_A3 m19 : 34|1@1+ (1,0) [0|0] "" TOOL
 SG_ S02_O2SLOC_A4 m19 : 35|1@1+ (1,0) [0|0] "" TOOL
 SG_ S02_O2SLOC_A5 m19 : 36|1@1+ (1,0) [0|0] "" TOOL
 SG_ S02_O2SLOC_A6 m19 : 37|1@1+ (1,0) [0|0] "" TOOL
 SG_ S02_O2SLOC_A7 m19 : 38|1@1+ (1,0) [0|0] "" TOOL
 SG_ S02_O2SLOC_A8 m19 : 39|1@1+ (1,0) [0|0] "" TOOL
 SG_ S02_O2S1 m20 : 32|8@1+ (0.005,0) [0|0] "V" TOOL
 SG_ S02_SHRTFT11 m20 : 40|8@1- (0.78125,0) [0|0] "%" TOOL
 SG_ S02_O2S2 m21 : 32|8@1+ (0.005,0) [0|0] "V" TOOL
 SG_ S02_SHRTFT12 m21 : 40|8@1- (0.78125,0) [0|0] "%" TOOL
 SG_ S02_O2S3 m22 : 32|8@1+ (0.005,0) [0|0] "V" TOOL
 SG_ S02_SHRTFT13 m22 : 40|8@1- (0.78125,0) [0|0] "%" TOOL
 SG_ S02_O2S4 m23 : 32|8@1+ (0.005,0) [0|0] "V" TOOL
 SG_ S02_SHRTFT14 m23 : 40|8@1- (0.78125,0) [0|0] "%" TOOL
 SG_ S02_O2S5 m24 : 32|8@1+ (0.005,0) [0|0] "V" TOOL
 SG_ S02_SHRTFT15 m24 : 40|8@1- (0.78125,0) [0|0] "%" TOOL
 SG_ S02_O2S6 m25 : 32|8@1+ (0.005,0) [0|0] "V" TOOL
 SG_ S02_SHRTFT16 m25 : 40|8@1- (0.78125,0) [0|0] "%" TOOL
 SG_ S02_O2S7 m26 : 32|8@1+ (0.005,0) [0|0] "V" TOOL
 SG_ S02_SHRTFT17 m26 : 40|8@1- (0.78125,0) [0|0] "%" TOOL
 SG_ S02_O2S8 m27 : 32|8@1+ (0.005,0) [0|0] "V" TOOL
 SG_ S02_SHRTFT8 m27 : 40|8@1- (0.78125,0) [0|0] "%" TOOL
 SG_ S02_OBDSUP m28 : 32|8@1+ (1,0) [0|0] "" TOOL
 SG_ S02_O2SLOC_B1 m29 : 32|1@1+ (1,0) [0|0] "" TOOL
 SG_ S02_O2SLOC_B2 m29 : 33|1@1+ (1,0) [0|0] "" TOOL
 SG_ S02_O2SLOC_B3 m29 : 34|1@1+ (1,0) [0|0] "" TOOL
 SG_ S02_O2SLOC_B4 m29 : 35|1@1+ (1,0) [0|0] "" TOOL
 SG_ S02_O2SLOC_B5 m29 : 36|1@1+ (1,0) [0|0] "" TOOL
 SG_ S02_O2SLOC_B6 m29 : 37|1@1+ (1,0) [0|0] "" TOOL
 SG_ S02_O2SLOC_B7 m29 : 38|1@1+ (1,0) [0|0] "" TOOL
 SG_ S02_O2SLOC_B8 m29 : 39|1@1+ (1,0) [0|0] "" TOOL
 SG_ S02_PTO_STAT m30 : 32|1@1+ (1,0) [0|0] "" TOOL
 SG_ S02_RUNTM m31 : 39|16@0+ (1,0) [0|0] "sec" TOOL
 SG_ S02_MIL_DIST m33 : 39|16@0+ (1,0) [0|0] "km" TOOL
 SG_ S02_FP m34 : 39|16@0+ (0.079,0) [0|0] "kPa" TOOL
 SG_ S02_FRP m35 : 39|16@0+ (10,0) [0|0] "kPa" TOOL
 SG_ S02_LAMBDA_WRV1 m36 : 39|16@0+ (0.0000305,0) [0|0] "" TOOL
 SG_ S02_O2S_WRV1 m36 : 55|16@0+ (0.000122,0) [0|0] "V" TOOL
 SG_ S02_LAMBDA_WRV2 m37 : 39|16@0+ (0.0000305,0) [0|0] "" TOOL
 SG_ S02_O2S_WRV2 m37 : 55|16@0+ (0.000122,0) [0|0] "V" TOOL
 SG_ S02_LAMBDA_WRV3 m38 : 39|16@0+ (0.0000305,0) [0|0] "" TOOL
 SG_ S02_O2S_WRV3 m38 : 55|16@0+ (0.000122,0) [0|0] "V" TOOL
 SG_ S02_LAMBDA_WRV4 m39 : 39|16@0+ (0.0000305,0) [0|0] "" TOOL
 SG_ S02_O2S_WRV4 m39 : 55|16@0+ (0.000122,0) [0|0] "V" TOOL
 SG_ S02_LAMBDA_WRV5 m40 : 39|16@0+ (0.0000305,0) [0|0] "" TOOL
 SG_ S02_O2S_WRV5 m40 : 55|16@0+ (0.000122,0) [0|0] "V" TOOL
 SG_ S02_LAMBDA_WRV6 m41 : 39|16@0+ (0.0000305,0) [0|0] "" TOOL
 SG_ S02_O2S_WRV6 m41 : 55|16@0+ (0.000122,0) [0|0] "V" TOOL
 SG_ S02_LAMBDA_WRV7 m42 : 39|16@0+ (0.0000305,0) [0|0] "" TOOL
 SG_ S02_O2S_WRV7 m42 : 55|16@0+ (0.000122,0) [0|0] "V" TOOL
 SG_ S02_LAMBDA_WRV8 m43 : 39|16@0+ (0.0000305,0) [0|0] "" TOOL
 SG_ S02_O2S_WRV8 m43 : 55|16@0+ (0.000122,0) [0|0] "V" TOOL
 SG_ S02_EGR_PCT m44 : 32|8@1+ (0.392156862745098,0) [0|0] "%" TOOL
 SG_ S02_EGR_ERR m45 : 32|8@1- (0.78125,0) [0|0] "%" TOOL
 SG_ S02_EVAP_PCT m46 : 32|8@1+ (0.392156862745098,0) [0|0] "%" TOOL
 SG_ S02_FLI m47 : 32|8@1+ (0.392156862745098,0) [0|0] "%" TOOL
 SG_ S02_WARM_UPS m48 : 32|8@1+ (1,0) [0|0] "" TOOL
 SG_ S02_CLR_DIST m49 : 39|16@0+ (1,0) [0|0] "" TOOL
 SG_ S02_EVAP_VP m50 : 39|16@0- (0.25,0) [0|0] "Pa" TOOL
 SG_ S02_BARO m51 : 32|8@1+ (1,0) [0|0] "kPa" TOOL
 SG_ S02_LAMBDA_WRC1 m52 : 39|16@0+ (0.0000305,0) [0|0] "" TOOL
 SG_ S02_O2S_WRC1 m52 : 55|16@0+ (0.00390625,0) [0|0] "mA" TOOL
 SG_ S02_LAMBDA_WRC2 m53 : 39|16@0+ (0.0000305,0) [0|0] "" TOOL
 SG_ S02_O2S_WRC2 m53 : 55|16@0+ (0.00390625,0) [0|0] "mA" TOOL
 SG_ S02_LAMBDA_WRC3 m54 : 39|16@0+ (0.0000305,0) [0|0] "" TOOL
 SG_ S02_O2S_WRC3 m54 : 55|16@0+ (0.00390625,0) [0|0] "mA" TOOL
 SG_ S02_LAMBDA_WRC4 m55 : 39|16@0+ (0.0000305,0) [0|0] "" TOOL
 SG_ S02_O2S_WRC4 m55 : 55|16@0+ (0.00390625,0) [0|0] "mA" TOOL
 SG_ S02_LAMBDA_WRC5 m56 : 39|16@0+ (0.0000305,0) [0|0] "" TOOL
 SG_ S02_O2S_WRC5 m56 : 55|16@0+ (0.00390625,0) [0|0] "mA" TOOL
 SG_ S02_LAMBDA_WRC6 m57 : 39|16@0+ (0.0000305,0) [0|0] "" TOOL
 SG_ S02_O2S_WRC6 m57 : 55|16@0+ (0.00390625,0) [0|0] "mA" TOOL
 SG_ S02_LAMBDA_WRC7 m58 : 39|16@0+ (0.0000305,0) [0|0] "" TOOL
 SG_ S02_O2S_WRC7 m58 : 55|16@0+ (0.00390625,0) [0|0] "mA" TOOL
 SG_ S02_LAMBDA_WRC8 m59 : 39|16@0+ (0.0000305,0) [0|0] "" TOOL
 SG_ S02_O2S_WRC8 m59 : 55|16@0+ (0.00390625,0) [0|0] "mA" TOOL
 SG_ S02_CATEMP11 m60 : 39|16@0+ (0.1,-40) [0|0] "" TOOL
 SG_ S02_CATEMP21 m61 : 39|16@0+ (0.1,-40) [0|0] "" TOOL
 SG_ S02_CATEMP12 m62 : 39|16@0+ (0.1,-40) [0|0] "" TOOL
 SG_ S02_CATEMP22 m63 : 39|16@0+ (0.1,-40) [0|0] "" TOOL
 SG_ S02_MIS_ENA m65 : 40|1@1+ (1,0) [0|0] "" TOOL
 SG_ S02_FUEL_ENA m65 : 41|1@1+ (1,0) [0|0] "" TOOL
 SG_ S02_CCM_ENA m65 : 42|1@1+ (1,0) [0|0] "" TOOL
 SG_ S02_PID41_CIM_SUP m65M : 43|1@1+ (1,0) [0|0] "" TOOL
 SG_ S02_MIS_CMPL m65 : 44|1@1+ (1,0) [0|0] "" TOOL
 SG_ S02_FUELCMPL m65 : 45|1@1+ (1,0) [0|0] "" TOOL
 SG_ S02_CCM_CMPL m65 : 46|1@1+ (1,0) [0|0] "" TOOL
 SG_ S02_CAT_ENA m0 : 48|1@1+ (1,0) [0|0] "" TOOL
 SG_ S02_HCAT_ENA m0 : 49|1@1+ (1,0) [0|0] "" TOOL
 SG_ S02_EVAP_ENA m0 : 50|1@1+ (1,0) [0|0] "" TOOL
 SG_ S02_AIR_ENA m0 : 51|1@1+ (1,0) [0|0] "" TOOL
 SG_ S02_GPF_ENA m0 : 52|1@1+ (1,0) [0|0] "" TOOL
 SG_ S02_O2S_ENA m0 : 53|1@1+ (1,0) [0|0] "" TOOL
 SG_ S02_HTR_ENA m0 : 54|1@1+ (1,0) [0|0] "" TOOL
 SG_ S02_EGR_ENA m0 : 55|1@1+ (1,0) [0|0] "" TOOL
 SG_ S02_CAT_CMPL m0 : 56|1@1+ (1,0) [0|0] "" TOOL
 SG_ S02_HCATCMPL m0 : 57|1@1+ (1,0) [0|0] "" TOOL
 SG_ S02_EVAPCMPL m0 : 58|1@1+ (1,0) [0|0] "" TOOL
 SG_ S02_AIR_CMPL m0 : 59|1@1+ (1,0) [0|0] "" TOOL
 SG_ S02_GPF_CMPL m0 : 60|1@1+ (1,0) [0|0] "" TOOL
 SG_ S02_O2S_CMPL m0 : 61|1@1+ (1,0) [0|0] "" TOOL
 SG_ S02_HTR_CMPL m0 : 62|1@1+ (1,0) [0|0] "" TOOL
 SG_ S02_EGR_CMPL m0 : 63|1@1+ (1,0) [0|0] "" TOOL
 SG_ S02_HCCATENA m1 : 48|1@1+ (1,0) [0|0] "" TOOL
 SG_ S02_NCAT_ENA m1 : 49|1@1+ (1,0) [0|0] "" TOOL
 SG_ S02_BP_ENA m1 : 51|1@1+ (1,0) [0|0] "" TOOL
 SG_ S02_EGS_ENA m1 : 53|1@1+ (1,0) [0|0] "" TOOL
 SG_ S02_PM_ENA m1 : 54|1@1+ (1,0) [0|0] "" TOOL
 SG_ S02_HCCATCMP m1 : 56|1@1+ (1,0) [0|0] "" TOOL
 SG_ S02_NCATCMPL m1 : 57|1@1+ (1,0) [0|0] "" TOOL
 SG_ S02_BP_CMPL m1 : 59|1@1+ (1,0) [0|0] "" TOOL
 SG_ S02_EGS_CMPL m1 : 61|1@1+ (1,0) [0|0] "" TOOL
 SG_ S02_PM_CMPL m1 : 62|1@1+ (1,0) [0|0] "" TOOL
 SG_ S02_VPWR m66 : 39|16@0+ (0.001,0) [0|0] "V" TOOL
 SG_ S02_LOAD_ABS m67 : 39|16@0+ (0.392156862745098,0) [0|0] "%" TOOL
 SG_ S02_EQ_RAT m68 : 39|16@0+ (0.0000305,0) [0|0] "" TOOL
 SG_ S02_TP_R m69 : 32|8@1+ (0.392156862745098,0) [0|0] "%" TOOL
 SG_ S02_AAT m70 : 32|8@1+ (1,-40) [0|0] "°C " TOOL
 SG_ S02_TP_B m71 : 32|8@1+ (0.392156862745098,0) [0|0] "%" TOOL
 SG_ S02_TP_C m72 : 32|8@1+ (0.392156862745098,0) [0|0] "%" TOOL
 SG_ S02_APP_D m73 : 32|8@1+ (0.392156862745098,0) [0|0] "%" TOOL
 SG_ S02_APP_E m74 : 32|8@1+ (0.392156862745098,0) [0|0] "%" TOOL
 SG_ S02_APP_F m75 : 32|8@1+ (0.392156862745098,0) [0|0] "%" TOOL
 SG_ S02_TAC_PCT m76 : 32|8@1+ (0.392156862745098,0) [0|0] "%" TOOL
 SG_ S02_MIL_TIME m77 : 39|16@0+ (1,0) [0|0] "min" TOOL
 SG_ S02_CLR_TIME m78 : 39|16@0+ (1,0) [0|0] "min" TOOL
 SG_ S02_ER_MAX m79 : 32|8@1+ (1,0) [0|0] "" TOOL
 SG_ S02_O2SV_MAX m79 : 40|8@1+ (1,0) [0|0] "V" TOOL
 SG_ S02_O2SC_MAX m79 : 48|8@1+ (1,0) [0|0] "mA" TOOL
 SG_ S02_IMAP_MAX m79 : 56|8@1+ (10,0) [0|0] "kPa" TOOL
 SG_ S02_AFR_MAX m80 : 32|8@1+ (10,0) [0|0] "g/s" TOOL
 SG_ S02_FUEL_TYP m81 : 32|8@1+ (1,0) [0|0] "" TOOL
 SG_ S02_ALCH_PCT m82 : 32|8@1+ (0.392156862745098,0) [0|0] "%" TOOL
 SG_ S02_EVAP_VPA m83 : 39|16@0+ (0.005,0) [0|0] "kPa" TOOL
 SG_ S02_EVAP_VP2 m84 : 39|16@0- (1,0) [0|0] "Pa" TOOL
 SG_ S02_STSO2FT1 m85 : 32|8@1- (0.78125,0) [0|0] "%" TOOL
 SG_ S02_STSO2FT3 m85 : 40|8@1- (0.78125,0) [0|0] "%" TOOL
 SG_ S02_LGSO2FT1 m86 : 32|8@1- (0.78125,0) [0|0] "%" TOOL
 SG_ S02_LGSO2FT3 m86 : 40|8@1- (0.78125,0) [0|0] "%" TOOL
 SG_ S02_STSO2FT2 m87 : 32|8@1- (0.78125,0) [0|0] "%" TOOL
 SG_ S02_STSO2FT4 m87 : 40|8@1- (0.78125,0) [0|0] "%" TOOL
 SG_ S02_LGSO2FT2 m88 : 32|8@1- (0.78125,0) [0|0] "%" TOOL
 SG_ S02_LGSO2FT4 m88 : 40|8@1- (0.78125,0) [0|0] "%" TOOL
 SG_ S02_FRP2 m89 : 39|16@0+ (10,0) [0|0] "kPa" TOOL
 SG_ S02_APP_R m90 : 32|8@1+ (0.392156862745098,0) [0|0] "%" TOOL
 SG_ S02_BAT_PWR m91 : 32|8@1+ (0.392156862745098,0) [0|0] "%" TOOL
 SG_ S02_EOT m92 : 32|8@1+ (1,-40) [0|0] "°C " TOOL
 SG_ S02_FUEL_TIMING m93 : 39|16@0+ (0.0078125,-210) [0|0] "°" TOOL
 SG_ S02_FUEL_RATE m94 : 39|16@0+ (0.05,0) [0|0] "L/h" TOOL
 SG_ S02_EMIS_SUP m95 : 32|8@1+ (1,-125) [0|0] "%" TOOL
 SG_ S02_TQ_DD m97 : 32|8@1+ (1,-125) [0|0] "%" TOOL
 SG_ S02_TQ_ACT m98 : 32|8@1+ (1,-125) [0|0] "%" TOOL
 SG_ S02_TQ_REF m99 : 39|16@0+ (1,0) [0|0] "Nm" TOOL
 SG_ S02_TQ_MAX1 m100 : 32|8@1+ (1,-125) [0|0] "%" TOOL
 SG_ S02_TQ_MAX2 m100 : 40|8@1+ (1,-125) [0|0] "%" TOOL
 SG_ S02_TQ_MAX3 m100 : 48|8@1+ (1,-125) [0|0] "%" TOOL
 SG_ S02_TQ_MAX4 m100 : 56|8@1+ (1,-125) [0|0] "%" TOOL
 SG_ S02_TQ_MAX5 m100 : 64|8@1+ (1,-125) [0|0] "%" TOOL
 SG_ S02_PTO_STAT_SUP m101 : 32|1@1+ (1,0) [0|0] "" TOOL
 SG_ S02_ND_STAT_SUP m101 : 33|1@1+ (1,0) [0|0] "" TOOL
 SG_ S02_NG_STAT_SUP m101 : 34|1@1+ (1,0) [0|0] "" TOOL
 SG_ S02_GPL_STAT_SUP m101 : 35|1@1+ (1,0) [0|0] "" TOOL
 SG_ S02_GEAR_RCMD_SUP m101 : 36|1@1+ (1,0) [0|0] "" TOOL
 SG_ S02_PTO_STAT2 m101 : 40|1@1+ (1,0) [0|0] "" TOOL
 SG_ S02_ND_STAT m101 : 41|1@1+ (1,0) [0|0] "" TOOL
 SG_ S02_NG_STAT m101 : 42|1@1+ (1,0) [0|0] "" TOOL
 SG_ S02_GPL_STAT m101 : 43|1@1+ (1,0) [0|0] "" TOOL
 SG_ S02_GEAR_RCMD m101 : 44|4@1+ (1,0) [0|0] "" TOOL
 SG_ S02_MAFA_SUP m102 : 32|1@1+ (1,0) [0|0] "" TOOL
 SG_ S02_MAFB_SUP m102 : 33|1@1+ (1,0) [0|0] "" TOOL
 SG_ S02_MAFA m102 : 47|16@0+ (0.03125,0) [0|0] "g/s" TOOL
 SG_ S02_MAFB m102 : 63|16@0+ (0.03125,0) [0|0] "g/s" TOOL
 SG_ S02_ECT1_SUP m103 : 32|1@1+ (1,0) [0|0] "" TOOL
 SG_ S02_ECT2_SUP m103 : 33|1@1+ (1,0) [0|0] "" TOOL
 SG_ S02_ECT1 m103 : 40|8@1+ (1,-40) [0|0] "°C " TOOL
 SG_ S02_ECT2 m103 : 48|8@1+ (1,-40) [0|0] "°C " TOOL
 SG_ S02_IAT11_SUP m104 : 32|1@1+ (1,0) [0|0] "" TOOL
 SG_ S02_IAT12_SUP m104 : 33|1@1+ (1,0) [0|0] "" TOOL
 SG_ S02_IAT13_SUP m104 : 34|1@1+ (1,0) [0|0] "" TOOL
 SG_ S02_IAT21_SUP m104 : 35|1@1+ (1,0) [0|0] "" TOOL
 SG_ S02_IAT22_SUP m104 : 36|1@1+ (1,0) [0|0] "" TOOL
 SG_ S02_IAT23_SUP m104 : 37|1@1+ (1,0) [0|0] "" TOOL
 SG_ S02_IAT11 m104 : 40|8@1+ (1,-40) [0|0] "°C " TOOL
 SG_ S02_IAT12 m104 : 48|8@1+ (1,-40) [0|0] "°C " TOOL
 SG_ S02_IAT13 m104 : 56|8@1+ (1,-40) [0|0] "°C " TOOL
 SG_ S02_IAT21 m104 : 64|8@1+ (1,-40) [0|0] "°C " TOOL
 SG_ S02_IAT22 m104 : 72|8@1+ (1,-40) [0|0] "°C " TOOL
 SG_ S02_IAT23 m104 : 80|8@1+ (1,-40) [0|0] "°C " TOOL
 SG_ S02_EGR_A_CMD_SUP m105 : 32|1@1+ (1,0) [0|0] "" TOOL
 SG_ S02_EGR_A_ACT_SUP m105 : 33|1@1+ (1,0) [0|0] "" TOOL
 SG_ S02_EGR_A_ERR_SUP m105 : 34|1@1+ (1,0) [0|0] "" TOOL
 SG_ S02_EGR_B_CMD_SUP m105 : 35|1@1+ (1,0) [0|0] "" TOOL
 SG_ S02_EGR_B_ACT_SUP m105 : 36|1@1+ (1,0) [0|0] "" TOOL
 SG_ S02_EGR_B_ERR_SUP m105 : 37|1@1+ (1,0) [0|0] "" TOOL
 SG_ S02_EGR_A_CMD m105 : 40|8@1- (0.78125,0) [0|0] "%" TOOL
 SG_ S02_EGR_A_ACT m105 : 48|8@1- (0.78125,0) [0|0] "%" TOOL
 SG_ S02_EGR_A_ERR m105 : 56|8@1- (0.78125,0) [0|0] "%" TOOL
 SG_ S02_EGR_B_CMD m105 : 64|8@1- (0.78125,0) [0|0] "%" TOOL
 SG_ S02_EGR_B_ACT m105 : 72|8@1- (0.78125,0) [0|0] "%" TOOL
 SG_ S02_EGR_B_ERR m105 : 80|8@1- (0.78125,0) [0|0] "%" TOOL
 SG_ S02_IAF_A_CMD_SUP m106 : 32|1@1+ (1,0) [0|0] "" TOOL
 SG_ S02_IAF_A_REL_SUP m106 : 33|1@1+ (1,0) [0|0] "" TOOL
 SG_ S02_IAF_B_CMD_SUP m106 : 34|1@1+ (1,0) [0|0] "" TOOL
 SG_ S02_IAF_B_REL_SUP m106 : 35|1@1+ (1,0) [0|0] "" TOOL
 SG_ S02_IAF_A_CMD m106 : 40|8@1+ (0.392156862745098,0) [0|0] "%" TOOL
 SG_ S02_IAF_A_REL m106 : 48|8@1+ (0.392156862745098,0) [0|0] "%" TOOL
 SG_ S02_IAF_B_CMD m106 : 56|8@1+ (0.392156862745098,0) [0|0] "%" TOOL
 SG_ S02_IAF_B_REL m106 : 64|8@1+ (0.392156862745098,0) [0|0] "%" TOOL
 SG_ S02_EGRTA_SUP m107M : 32|1@1+ (1,0) [0|0] "" TOOL
 SG_ S02_EGRTC_SUP m107M : 33|1@1+ (1,0) [0|0] "" TOOL
 SG_ S02_EGRTB_SUP m107M : 34|1@1+ (1,0) [0|0] "" TOOL
 SG_ S02_EGRTD_SUP m107M : 35|1@1+ (1,0) [0|0] "" TOOL
 SG_ S02_EGRTA_WR_SUP m107M : 36|1@1+ (1,0) [0|0] "" TOOL
 SG_ S02_EGRTC_WR_SUP m107M : 37|1@1+ (1,0) [0|0] "" TOOL
 SG_ S02_EGRTB_WR_SUP m107M : 38|1@1+ (1,0) [0|0] "" TOOL
 SG_ S02_EGRTD_WR_SUP m107M : 39|1@1+ (1,0) [0|0] "" TOOL
 SG_ S02_EGRTA m1 : 40|8@1+ (1,-40) [0|0] "°C " TOOL
 SG_ S02_EGRTC m1 : 48|8@1+ (1,-40) [0|0] "°C " TOOL
 SG_ S02_EGRTB m1 : 56|8@1+ (1,-40) [0|0] "°C " TOOL
 SG_ S02_EGRTD m1 : 64|8@1+ (1,-40) [0|0] "°C " TOOL
 SG_ S02_EGRTA_WR m0 : 40|8@1+ (4,-40) [0|0] "°C " TOOL
 SG_ S02_EGRTC_WR m0 : 48|8@1+ (4,-40) [0|0] "°C " TOOL
 SG_ S02_EGRTB_WR m0 : 56|8@1+ (4,-40) [0|0] "°C " TOOL
 SG_ S02_EGRTD_WR m0 : 64|8@1+ (4,-40) [0|0] "°C " TOOL
 SG_ S02_TAC_A_CMD_SUP m108 : 32|1@1+ (1,0) [0|0] "" TOOL
 SG_ S02_TP_A_REL_SUP m108 : 33|1@1+ (1,0) [0|0] "" TOOL
 SG_ S02_TAC_B_CMD_SUP m108 : 34|1@1+ (1,0) [0|0] "" TOOL
 SG_ S02_TP_B_REL_SUP m108 : 35|1@1+ (1,0) [0|0] "" TOOL
 SG_ S02_TAC_A_CMD m108 : 40|8@1+ (0.392156862745098,0) [0|0] "%" TOOL
 SG_ S02_TP_A_REL m108 : 48|8@1+ (0.392156862745098,0) [0|0] "%" TOOL
 SG_ S02_TAC_B_CMD m108 : 56|8@1+ (0.392156862745098,0) [0|0] "%" TOOL
 SG_ S02_TP_B_REL m108 : 64|8@1+ (0.392156862745098,0) [0|0] "%" TOOL
 SG_ S02_FRP_A_CMD_SUP m109 : 32|1@1+ (1,0) [0|0] "" TOOL
 SG_ S02_FRP_A_SUP m109 : 33|1@1+ (1,0) [0|0] "" TOOL
 SG_ S02_FRT_A_SUP m109 : 34|1@1+ (1,0) [0|0] "" TOOL
 SG_ S02_FRP_B_CMD_SUP m109 : 35|1@1+ (1,0) [0|0] "" TOOL
 SG_ S02_FRP_B_SUP m109 : 36|1@1+ (1,0) [0|0] "" TOOL
 SG_ S02_FRT_B_SUP m109 : 37|1@1+ (1,0) [0|0] "" TOOL
 SG_ S02_FRP_A_CMD m109 : 47|16@0+ (10,0) [0|0] "kPa" TOOL
 SG_ S02_FRP_A m109 : 63|16@0+ (10,0) [0|0] "kPa" TOOL
 SG_ S02_FRT_A  m109 : 72|8@1+ (1,-40) [0|0] "°C " TOOL
 SG_ S02_FRP_B_CMD m109 : 87|16@0+ (10,0) [0|0] "kPa" TOOL
 SG_ S02_FRP_B m109 : 103|16@0+ (10,0) [0|0] "kPa" TOOL
 SG_ S02_FRT_B m109 : 112|8@1+ (1,-40) [0|0] "°C " TOOL
 SG_ S02_ICP_A_CMD_SUP m110 : 32|1@1+ (1,0) [0|0] "" TOOL
 SG_ S02_ICP_A_SUP m110 : 33|1@1+ (1,0) [0|0] "" TOOL
 SG_ S02_ICP_B_CMD_SUP m110 : 34|1@1+ (1,0) [0|0] "" TOOL
 SG_ S02_ICP_B_SUP m110 : 35|1@1+ (1,0) [0|0] "" TOOL
 SG_ S02_ICP_A_CMD m110 : 47|16@0+ (10,0) [0|0] "kPa" TOOL
 SG_ S02_ICP_A m110 : 63|16@0+ (10,0) [0|0] "kPa" TOOL
 SG_ S02_ICP_B_CMD m110 : 79|16@0+ (10,0) [0|0] "kPa" TOOL
 SG_ S02_ICP_B m110 : 95|16@0+ (10,0) [0|0] "kPa" TOOL
 SG_ S02_TCA_CINP_SUP m111M : 32|1@1+ (1,0) [0|0] "" TOOL
 SG_ S02_TCB_CINP_SUP m111M : 33|1@1+ (1,0) [0|0] "" TOOL
 SG_ S02_TCA_CINP_WR_SUP m111M : 34|1@1+ (1,0) [0|0] "" TOOL
 SG_ S02_TCB_CINP_WR_SUP m111M : 35|1@1+ (1,0) [0|0] "" TOOL
 SG_ S02_TCA_CINP m1 : 40|8@1+ (1,0) [0|0] "kPa" TOOL
 SG_ S02_TCB_CINP m1 : 48|8@1+ (1,0) [0|0] "kPa" TOOL
 SG_ S02_TCA_CINP_WR m0 : 40|8@1+ (8,0) [0|0] "kPa" TOOL
 SG_ S02_TCB_CINP_WR m0 : 48|8@1+ (8,0) [0|0] "kPa" TOOL
 SG_ S02_BP_A_CMD_SUP m112 : 32|1@1+ (1,0) [0|0] "" TOOL
 SG_ S02_BP_A_ACT_SUP m112 : 33|1@1+ (1,0) [0|0] "" TOOL
 SG_ S02_BP_A_SUP m112 : 34|1@1+ (1,0) [0|0] "" TOOL
 SG_ S02_BP_B_CMD_SUP m112 : 35|1@1+ (1,0) [0|0] "" TOOL
 SG_ S02_BP_B_ACT_SUP m112 : 36|1@1+ (1,0) [0|0] "" TOOL
 SG_ S02_BP_B_SUP m112 : 37|1@1+ (1,0) [0|0] "" TOOL
 SG_ S02_BP_A_CMD m112 : 47|16@0+ (0.03125,0) [0|0] "kPa" TOOL
 SG_ S02_BP_A_ACT m112 : 63|16@0+ (0.03125,0) [0|0] "kPa" TOOL
 SG_ S02_BP_B_CMD m112 : 79|16@0+ (0.03125,0) [0|0] "kPa" TOOL
 SG_ S02_BP_B_ACT m112 : 95|16@0+ (0.03125,0) [0|0] "kPa" TOOL
 SG_ S02_BP_A m112 : 104|2@1+ (1,0) [0|0] "" TOOL
 SG_ S02_BP_B m112 : 106|2@1+ (1,0) [0|0] "" TOOL
 SG_ S02_VGT_A_CMD_SUP m113 : 32|1@1+ (1,0) [0|0] "" TOOL
 SG_ S02_VGT_A_ACT_SUP m113 : 33|1@1+ (1,0) [0|0] "" TOOL
 SG_ S02_VGT_A_SUP m113 : 34|1@1+ (1,0) [0|0] "" TOOL
 SG_ S02_VGT_B_CMD_SUP m113 : 35|1@1+ (1,0) [0|0] "" TOOL
 SG_ S02_VGT_B_ACT_SUP m113 : 36|1@1+ (1,0) [0|0] "" TOOL
 SG_ S02_VGT_B_SUP m113 : 37|1@1+ (1,0) [0|0] "" TOOL
 SG_ S02_VGT_A_CMD m113 : 40|8@1+ (0.392156862745098,0) [0|0] "%" TOOL
 SG_ S02_VGT_A_ACT m113 : 48|8@1+ (0.392156862745098,0) [0|0] "%" TOOL
 SG_ S02_VGT_B_CMD m113 : 56|8@1+ (0.392156862745098,0) [0|0] "%" TOOL
 SG_ S02_VGT_B_ACT m113 : 64|8@1+ (0.392156862745098,0) [0|0] "%" TOOL
 SG_ S02_VGT_A m113 : 72|2@1+ (1,0) [0|0] "" TOOL
 SG_ S02_VGT_B m113 : 74|2@1+ (1,0) [0|0] "" TOOL
 SG_ S02_WG_A_CMD_SUP m114 : 32|1@1+ (1,0) [0|0] "" TOOL
 SG_ S02_WG_A_ACT_SUP m114 : 33|1@1+ (1,0) [0|0] "" TOOL
 SG_ S02_WG_B_CMD_SUP m114 : 34|1@1+ (1,0) [0|0] "" TOOL
 SG_ S02_WG_B_ACT_SUP m114 : 35|1@1+ (1,0) [0|0] "" TOOL
 SG_ S02_WG_A_CMD m114 : 40|8@1+ (0.392156862745098,0) [0|0] "%" TOOL
 SG_ S02_WG_A_ACT m114 : 48|8@1+ (0.392156862745098,0) [0|0] "%" TOOL
 SG_ S02_WG_B_CMD m114 : 56|8@1+ (0.392156862745098,0) [0|0] "%" TOOL
 SG_ S02_WG_B_ACT m114 : 64|8@1+ (0.392156862745098,0) [0|0] "%" TOOL
 SG_ S02_EP_11_SUP m115 : 32|1@1+ (1,0) [0|0] "" TOOL
 SG_ S02_EP_21_SUP m115 : 33|1@1+ (1,0) [0|0] "" TOOL
 SG_ S02_EP_11 m115 : 47|16@0+ (0.01,0) [0|0] "kPa" TOOL
 SG_ S02_EP_21 m115 : 63|16@0+ (0.01,0) [0|0] "kPa" TOOL
 SG_ S02_TCA_RPM_SUP m116 : 32|1@1+ (1,0) [0|0] "" TOOL
 SG_ S02_TCB_RPM_SUP m116 : 33|1@1+ (1,0) [0|0] "" TOOL
 SG_ S02_TCA_RPM m116 : 47|16@0+ (10,0) [0|0] "rpm" TOOL
 SG_ S02_TCB_RPM m116 : 63|16@0+ (10,0) [0|0] "rpm" TOOL
 SG_ S02_TCA_CINT_SUP m117 : 32|1@1+ (1,0) [0|0] "" TOOL
 SG_ S02_TCA_COUTT_SUP m117 : 33|1@1+ (1,0) [0|0] "" TOOL
 SG_ S02_TCA_TINT_SUP m117 : 34|1@1+ (1,0) [0|0] "" TOOL
 SG_ S02_TCA_TOUTT_SUP m117 : 35|1@1+ (1,0) [0|0] "" TOOL
 SG_ S02_TCA_CINT m117 : 40|8@1+ (1,-40) [0|0] "°C " TOOL
 SG_ S02_TCA_COUTT m117 : 48|8@1+ (1,-40) [0|0] "°C " TOOL
 SG_ S02_TCA_TINT m117 : 63|16@0+ (0.1,-40) [0|0] "°C " TOOL
 SG_ S02_TCA_TOUTT m117 : 79|16@0+ (0.1,-40) [0|0] "°C " TOOL
 SG_ S02_CACT_11_SUP m119 : 32|1@1+ (1,0) [0|0] "" TOOL
 SG_ S02_CACT_12_SUP m119 : 33|1@1+ (1,0) [0|0] "" TOOL
 SG_ S02_CACT_21_SUP m119 : 34|1@1+ (1,0) [0|0] "" TOOL
 SG_ S02_CACT_22_SUP m119 : 35|1@1+ (1,0) [0|0] "" TOOL
 SG_ S02_CACT_11 m119 : 40|8@1+ (1,0) [0|0] "" TOOL
 SG_ S02_CACT_12 m119 : 48|8@1+ (1,0) [0|0] "" TOOL
 SG_ S02_CACT_21 m119 : 56|8@1+ (1,0) [0|0] "" TOOL
 SG_ S02_CACT_22 m119 : 64|8@1+ (1,0) [0|0] "" TOOL
 SG_ S02_EGT11_SUP m120 : 32|1@1+ (1,0) [0|0] "" TOOL
 SG_ S02_EGT12_SUP m120 : 33|1@1+ (1,0) [0|0] "" TOOL
 SG_ S02_EGT13_SUP m120 : 34|1@1+ (1,0) [0|0] "" TOOL
 SG_ S02_EGT14_SUP m120 : 35|1@1+ (1,0) [0|0] "" TOOL
 SG_ S02_EGT11 m120 : 47|16@0+ (0.1,-40) [0|0] "°C " TOOL
 SG_ S02_EGT12 m120 : 63|16@0+ (0.1,-40) [0|0] "°C " TOOL
 SG_ S02_EGT13 m120 : 79|16@0+ (0.1,-40) [0|0] "°C " TOOL
 SG_ S02_EGT14 m120 : 95|16@0+ (0.1,-40) [0|0] "°C " TOOL
 SG_ S02_EGT21_SUP m121 : 32|1@1+ (1,0) [0|0] "" TOOL
 SG_ S02_EGT22_SUP m121 : 33|1@1+ (1,0) [0|0] "" TOOL
 SG_ S02_EGT23_SUP m121 : 34|1@1+ (1,0) [0|0] "" TOOL
 SG_ S02_EGT24_SUP m121 : 35|1@1+ (1,0) [0|0] "" TOOL
 SG_ S02_EGT21 m121 : 47|16@0+ (0.1,-40) [0|0] "°C " TOOL
 SG_ S02_EGT22 m121 : 63|16@0+ (0.1,-40) [0|0] "°C " TOOL
 SG_ S02_EGT23 m121 : 79|16@0+ (0.1,-40) [0|0] "°C " TOOL
 SG_ S02_EGT24 m121 : 95|16@0+ (0.1,-40) [0|0] "°C " TOOL
 SG_ S02_PF1_DP_SUP m122 : 32|1@1+ (1,0) [0|0] "" TOOL
 SG_ S02_PF1_INP_SUP m122 : 33|1@1+ (1,0) [0|0] "" TOOL
 SG_ S02_PF1_OUTP_SUP m122 : 34|1@1+ (1,0) [0|0] "" TOOL
 SG_ S02_PF1_DP m122 : 47|16@0- (0.01,0) [0|0] "kPa" TOOL
 SG_ S02_PF1_INP m122 : 63|16@0+ (0.01,0) [0|0] "kPa" TOOL
 SG_ S02_PF1_OUTP m122 : 79|16@0+ (0.01,0) [0|0] "kPa" TOOL
 SG_ S02_PF2_DP_SUP m123 : 32|1@1+ (1,0) [0|0] "" TOOL
 SG_ S02_PF2_INP_SUP m123 : 33|1@1+ (1,0) [0|0] "" TOOL
 SG_ S02_PF2_OUTP_SUP m123 : 34|1@1+ (1,0) [0|0] "" TOOL
 SG_ S02_PF2_DP m123 : 47|16@0- (0.01,0) [0|0] "kPa" TOOL
 SG_ S02_PF2_INP m123 : 63|16@0+ (0.01,0) [0|0] "kPa" TOOL
 SG_ S02_PF2_OUTP m123 : 79|16@0+ (0.01,0) [0|0] "kPa" TOOL
 SG_ S02_PF1_INT_SUP m124 : 32|1@1+ (1,0) [0|0] "" TOOL
 SG_ S02_PF1_OUTT_SUP m124 : 33|1@1+ (1,0) [0|0] "" TOOL
 SG_ S02_PF2_INT_SUP m124 : 34|1@1+ (1,0) [0|0] "" TOOL
 SG_ S02_PF2_OUTT_SUP m124 : 35|1@1+ (1,0) [0|0] "" TOOL
 SG_ S02_PF1_INT m124 : 47|16@0+ (0.1,-40) [0|0] "°C " TOOL
 SG_ S02_PF1_OUTT m124 : 63|16@0+ (0.1,-40) [0|0] "°C " TOOL
 SG_ S02_PF2_INT m124 : 79|16@0+ (0.1,-40) [0|0] "°C " TOOL
 SG_ S02_PF2_OUTT m124 : 95|16@0+ (0.1,-40) [0|0] "°C " TOOL
 SG_ S02_NNTE_IN m125 : 32|1@1+ (1,0) [0|0] "" TOOL
 SG_ S02_NNTE_OUT m125 : 33|1@1+ (1,0) [0|0] "" TOOL
 SG_ S02_NNTE_CAA m125 : 34|1@1+ (1,0) [0|0] "" TOOL
 SG_ S02_NNTE_DEF m125 : 35|1@1+ (1,0) [0|0] "" TOOL
 SG_ S02_PNTE_IN m126 : 32|1@1+ (1,0) [0|0] "" TOOL
 SG_ S02_PNTE_OUT m126 : 33|1@1+ (1,0) [0|0] "" TOOL
 SG_ S02_PNTE_CAA m126 : 34|1@1+ (1,0) [0|0] "" TOOL
 SG_ S02_PNTE_DEF m126 : 35|1@1+ (1,0) [0|0] "" TOOL
 SG_ S02_RUN_TIME_SUP m127 : 32|1@1+ (1,0) [0|0] "" TOOL
 SG_ S02_IDLE_TIME_SUP m127 : 33|1@1+ (1,0) [0|0] "" TOOL
 SG_ S02_PTO_TIME_SUP m127 : 34|1@1+ (1,0) [0|0] "" TOOL
 SG_ S02_RUN_TIME m127 : 47|32@0+ (1,0) [0|0] "sec" TOOL
 SG_ S02_IDLE_TIME m127 : 79|32@0+ (1,0) [0|0] "sec" TOOL
 SG_ S02_PTO_TIME m127 : 111|32@0+ (1,0) [0|0] "sec" TOOL
 SG_ S02_AECD1_TIME_SUP m129 : 32|1@1+ (1,0) [0|0] "" TOOL
 SG_ S02_AECD2_TIME_SUP m129 : 33|1@1+ (1,0) [0|0] "" TOOL
 SG_ S02_AECD3_TIME_SUP m129 : 34|1@1+ (1,0) [0|0] "" TOOL
 SG_ S02_AECD4_TIME_SUP m129 : 35|1@1+ (1,0) [0|0] "" TOOL
 SG_ S02_AECD5_TIME_SUP m129 : 36|1@1+ (1,0) [0|0] "" TOOL
 SG_ S02_AECD1_TIME1 m129 : 47|32@0+ (1,0) [0|0] "sec" TOOL
 SG_ S02_AECD1_TIME2 m129 : 79|32@0+ (1,0) [0|0] "sec" TOOL
 SG_ S02_AECD2_TIME1 m129 : 111|32@0+ (1,0) [0|0] "sec" TOOL
 SG_ S02_AECD2_TIME2 m129 : 143|32@0+ (1,0) [0|0] "sec" TOOL
 SG_ S02_AECD3_TIME1 m129 : 175|32@0+ (1,0) [0|0] "sec" TOOL
 SG_ S02_AECD3_TIME2 m129 : 207|32@0+ (1,0) [0|0] "sec" TOOL
 SG_ S02_AECD4_TIME1 m129 : 239|32@0+ (1,0) [0|0] "sec" TOOL
 SG_ S02_AECD4_TIME2 m129 : 271|32@0+ (1,0) [0|0] "sec" TOOL
 SG_ S02_AECD5_TIME1 m129 : 303|32@0+ (1,0) [0|0] "sec" TOOL
 SG_ S02_AECD5_TIME2 m129 : 335|32@0+ (1,0) [0|0] "sec" TOOL
 SG_ S02_AECD6_TIME_SUP m130 : 32|1@1+ (1,0) [0|0] "" TOOL
 SG_ S02_AECD7_TIME_SUP m130 : 33|1@1+ (1,0) [0|0] "" TOOL
 SG_ S02_AECD8_TIME_SUP m130 : 34|1@1+ (1,0) [0|0] "" TOOL
 SG_ S02_AECD9_TIME_SUP m130 : 35|1@1+ (1,0) [0|0] "" TOOL
 SG_ S02_AECD10_TIME_SUP m130 : 36|1@1+ (1,0) [0|0] "" TOOL
 SG_ S02_AECD6_TIME1 m130 : 47|32@0+ (1,0) [0|0] "sec" TOOL
 SG_ S02_AECD6_TIME2 m130 : 79|32@0+ (1,0) [0|0] "sec" TOOL
 SG_ S02_AECD7_TIME1 m130 : 111|32@0+ (1,0) [0|0] "sec" TOOL
 SG_ S02_AECD7_TIME2 m130 : 143|32@0+ (1,0) [0|0] "sec" TOOL
 SG_ S02_AECD8_TIME1 m130 : 175|32@0+ (1,0) [0|0] "sec" TOOL
 SG_ S02_AECD8_TIME2 m130 : 207|32@0+ (1,0) [0|0] "sec" TOOL
 SG_ S02_AECD9_TIME1 m130 : 239|32@0+ (1,0) [0|0] "sec" TOOL
 SG_ S02_AECD9_TIME2 m130 : 271|32@0+ (1,0) [0|0] "sec" TOOL
 SG_ S02_AECD10_TIME1 m130 : 303|32@0+ (1,0) [0|0] "sec" TOOL
 SG_ S02_AECD10_TIME2 m130 : 335|32@0+ (1,0) [0|0] "sec" TOOL
 SG_ S02_NOX11_SUP m131 : 32|1@1+ (1,0) [0|0] "" TOOL
 SG_ S02_NOX12_SUP m131 : 33|1@1+ (1,0) [0|0] "" TOOL
 SG_ S02_NOX21_SUP m131 : 34|1@1+ (1,0) [0|0] "" TOOL
 SG_ S02_NOX22_SUP m131 : 35|1@1+ (1,0) [0|0] "" TOOL
 SG_ S02_NOX11_RDY m131 : 36|1@1+ (1,0) [0|0] "" TOOL
 SG_ S02_NOX12_RDY m131 : 37|1@1+ (1,0) [0|0] "" TOOL
 SG_ S02_NOX21_RDY m131 : 38|1@1+ (1,0) [0|0] "" TOOL
 SG_ S02_NOX22_RDY m131 : 39|1@1+ (1,0) [0|0] "" TOOL
 SG_ S02_NOX11 m131 : 47|16@0+ (1,0) [0|0] "ppm" TOOL
 SG_ S02_NOX12 m131 : 63|16@0+ (1,0) [0|0] "ppm" TOOL
 SG_ S02_NOX21 m131 : 79|16@0+ (1,0) [0|0] "ppm" TOOL
 SG_ S02_NOX22 m131 : 95|16@0+ (1,0) [0|0] "ppm" TOOL
 SG_ S02_MST m132 : 32|8@1+ (1,-40) [0|0] "°C " TOOL
 SG_ S02_REAG_RATE_SUP m133 : 32|1@1+ (1,0) [0|0] "" TOOL
 SG_ S02_REAG_DEMD_SUP m133 : 33|1@1+ (1,0) [0|0] "" TOOL
 SG_ S02_REAG_LVL_SUP m133 : 34|1@1+ (1,0) [0|0] "" TOOL
 SG_ S02_NWI_TIME_SUP m133 : 35|1@1+ (1,0) [0|0] "" TOOL
 SG_ S02_REAG_RATE m133 : 47|16@0+ (0.005,0) [0|0] "L/h" TOOL
 SG_ S02_REAG_DEMD m133 : 63|16@0+ (0.005,0) [0|0] "L/h" TOOL
 SG_ S02_REAG_LVL m133 : 72|8@1+ (0.392156862745098,0) [0|0] "%" TOOL
 SG_ S02_NWI_TIME m133 : 87|32@0+ (1,0) [0|0] "sec" TOOL
 SG_ S02_PM11_SUP m134 : 32|1@1+ (1,0) [0|0] "" TOOL
 SG_ S02_PM21_SUP m134 : 33|1@1+ (1,0) [0|0] "" TOOL
 SG_ S02_PM11 m134 : 47|16@0+ (0.0125,0) [0|0] "mg/m3" TOOL
 SG_ S02_PM21 m134 : 63|16@0+ (0.0125,0) [0|0] "mg/m3" TOOL
 SG_ S02_MAP_A_SUP m135 : 32|1@1+ (1,0) [0|0] "" TOOL
 SG_ S02_MAP_B_SUP m135 : 33|1@1+ (1,0) [0|0] "" TOOL
 SG_ S02_MAP_A m135 : 47|16@0+ (0.03125,0) [0|0] "kPa" TOOL
 SG_ S02_MAP_B m135 : 63|16@0+ (0.03125,0) [0|0] "kPa" TOOL
 SG_ S02_SCR_IND_SYS_LEVEL_LOW m136 : 32|1@1+ (1,0) [0|0] "" TOOL
 SG_ S02_SCR_IND_SYS_INCORR_REAG m136 : 33|1@1+ (1,0) [0|0] "" TOOL
 SG_ S02_SCR_IND_SYS_CONSUMP_DEVIATION m136 : 34|1@1+ (1,0) [0|0] "" TOOL
 SG_ S02_SCR_IND_SYS_NOx_LEVEL m136 : 35|1@1+ (1,0) [0|0] "" TOOL
 SG_ S02_SCR_IND_SYS_ACTIVE m136 : 39|1@1+ (1,0) [0|0] "" TOOL
 SG_ S02_SCR_IND_SYS_HIST1_LEVEL_LOW m136 : 40|1@1+ (1,0) [0|0] "" TOOL
 SG_ S02_SCR_IND_SYS_HIST1_INCORR_REAG m136 : 41|1@1+ (1,0) [0|0] "" TOOL
 SG_ S02_SCR_IND_SYS_HIST1_CONSUMP_DEVIATION m136 : 42|1@1+ (1,0) [0|0] "" TOOL
 SG_ S02_SCR_IND_SYS_HIST1_NOx_LEVEL m136 : 43|1@1+ (1,0) [0|0] "" TOOL
 SG_ S02_SCR_IND_SYS_HIST2_LEVEL_LOW m136 : 44|1@1+ (1,0) [0|0] "" TOOL
 SG_ S02_SCR_IND_SYS_HIST2_INCORR_REAG m136 : 45|1@1+ (1,0) [0|0] "" TOOL
 SG_ S02_SCR_IND_SYS_HIST2_CONSUMP_DEVIATION m136 : 46|1@1+ (1,0) [0|0] "" TOOL
 SG_ S02_SCR_IND_SYS_HIST2_NOx_LEVEL m136 : 47|1@1+ (1,0) [0|0] "" TOOL
 SG_ S02_SCR_IND_SYS_HIST3_LEVEL_LOW m136 : 48|1@1+ (1,0) [0|0] "" TOOL
 SG_ S02_SCR_IND_SYS_HIST3_INCORR_REAG m136 : 49|1@1+ (1,0) [0|0] "" TOOL
 SG_ S02_SCR_IND_SYS_HIST3_CONSUMP_DEVIATION m136 : 50|1@1+ (1,0) [0|0] "" TOOL
 SG_ S02_SCR_IND_SYS_HIST3_NOx_LEVEL m136 : 51|1@1+ (1,0) [0|0] "" TOOL
 SG_ S02_SCR_IND_SYS_HIST4_LEVEL_LOW m136 : 52|1@1+ (1,0) [0|0] "" TOOL
 SG_ S02_SCR_IND_SYS_HIST4_INCORR_REAG m136 : 53|1@1+ (1,0) [0|0] "" TOOL
 SG_ S02_SCR_IND_SYS_HIST4_CONSUMP_DEVIATION m136 : 54|1@1+ (1,0) [0|0] "" TOOL
 SG_ S02_SCR_IND_SYS_HIST4_NOx_LEVEL m136 : 55|1@1+ (1,0) [0|0] "" TOOL
 SG_ S02_SCR_IND_DIST_1N m136 : 63|16@0+ (1,0) [0|0] "km" TOOL
 SG_ S02_SCR_IND_DIST_1D m136 : 79|16@0+ (1,0) [0|0] "km" TOOL
 SG_ S02_SCR_IND_DIST_2N m136 : 95|16@0+ (1,0) [0|0] "km" TOOL
 SG_ S02_SCR_IND_DIST_3N m136 : 111|16@0+ (1,0) [0|0] "km" TOOL
 SG_ S02_SCR_IND_DIST_4N m136 : 127|16@0+ (1,0) [0|0] "km" TOOL
 SG_ S02_AECD11_TIME_SUP m137 : 32|1@1+ (1,0) [0|0] "" TOOL
 SG_ S02_AECD12_TIME_SUP m137 : 33|1@1+ (1,0) [0|0] "" TOOL
 SG_ S02_AECD13_TIME_SUP m137 : 34|1@1+ (1,0) [0|0] "" TOOL
 SG_ S02_AECD14_TIME_SUP m137 : 35|1@1+ (1,0) [0|0] "" TOOL
 SG_ S02_AECD15_TIME_SUP m137 : 36|1@1+ (1,0) [0|0] "" TOOL
 SG_ S02_AECD11_TIME1 m137 : 47|32@0+ (1,0) [0|0] "sec" TOOL
 SG_ S02_AECD11_TIME2 m137 : 79|32@0+ (1,0) [0|0] "sec" TOOL
 SG_ S02_AECD12_TIME1 m137 : 111|32@0+ (1,0) [0|0] "sec" TOOL
 SG_ S02_AECD12_TIME2 m137 : 143|32@0+ (1,0) [0|0] "sec" TOOL
 SG_ S02_AECD13_TIME1 m137 : 175|32@0+ (1,0) [0|0] "sec" TOOL
 SG_ S02_AECD13_TIME2 m137 : 207|32@0+ (1,0) [0|0] "sec" TOOL
 SG_ S02_AECD14_TIME1 m137 : 239|32@0+ (1,0) [0|0] "sec" TOOL
 SG_ S02_AECD14_TIME2 m137 : 271|32@0+ (1,0) [0|0] "sec" TOOL
 SG_ S02_AECD15_TIME1 m137 : 303|32@0+ (1,0) [0|0] "sec" TOOL
 SG_ S02_AECD15_TIME2 m137 : 335|32@0+ (1,0) [0|0] "sec" TOOL
 SG_ S02_AECD16_TIME_SUP m138 : 32|1@1+ (1,0) [0|0] "" TOOL
 SG_ S02_AECD17_TIME_SUP m138 : 33|1@1+ (1,0) [0|0] "" TOOL
 SG_ S02_AECD18_TIME_SUP m138 : 34|1@1+ (1,0) [0|0] "" TOOL
 SG_ S02_AECD19_TIME_SUP m138 : 35|1@1+ (1,0) [0|0] "" TOOL
 SG_ S02_AECD20_TIME_SUP m138 : 36|1@1+ (1,0) [0|0] "" TOOL
 SG_ S02_AECD16_TIME1 m138 : 47|32@0+ (1,0) [0|0] "sec" TOOL
 SG_ S02_AECD16_TIME2 m138 : 79|32@0+ (1,0) [0|0] "sec" TOOL
 SG_ S02_AECD17_TIME1 m138 : 111|32@0+ (1,0) [0|0] "sec" TOOL
 SG_ S02_AECD17_TIME2 m138 : 143|32@0+ (1,0) [0|0] "sec" TOOL
 SG_ S02_AECD18_TIME1 m138 : 175|32@0+ (1,0) [0|0] "sec" TOOL
 SG_ S02_AECD18_TIME2 m138 : 207|32@0+ (1,0) [0|0] "sec" TOOL
 SG_ S02_AECD19_TIME1 m138 : 239|32@0+ (1,0) [0|0] "sec" TOOL
 SG_ S02_AECD19_TIME2 m138 : 271|32@0+ (1,0) [0|0] "sec" TOOL
 SG_ S02_AECD20_TIME1 m138 : 303|32@0+ (1,0) [0|0] "sec" TOOL
 SG_ S02_AECD20_TIME2 m138 : 335|32@0+ (1,0) [0|0] "sec" TOOL
 SG_ S02_PF_REGEN_STAT_SUP m139 : 32|1@1+ (1,0) [0|0] "" TOOL
 SG_ S02_PF_REGEN_TYPE_SUP m139 : 33|1@1+ (1,0) [0|0] "" TOOL
 SG_ S02_NOX_ADS_REGEN_SUP m139 : 34|1@1+ (1,0) [0|0] "" TOOL
 SG_ S02_NOX_ADS_DESULF_SUP m139 : 35|1@1+ (1,0) [0|0] "" TOOL
 SG_ S02_PF_REGEN_PCT_SUP m139 : 36|1@1+ (1,0) [0|0] "" TOOL
 SG_ S02_PF_REGEN_AVGT_SUP m139 : 37|1@1+ (1,0) [0|0] "" TOOL
 SG_ S02_PF_REGEN_AVGD_SUP m139 : 38|1@1+ (1,0) [0|0] "" TOOL
 SG_ S02_PF_REGEN_STAT m139 : 40|1@1+ (1,0) [0|0] "" TOOL
 SG_ S02_PF_REGEN_TYPE m139 : 41|1@1+ (1,0) [0|0] "" TOOL
 SG_ S02_NOX_ADS_REGEN m139 : 42|1@1+ (1,0) [0|0] "" TOOL
 SG_ S02_NOX_ADS_DESULF m139 : 43|1@1+ (1,0) [0|0] "" TOOL
 SG_ S02_PF_REGEN_PCT m139 : 48|8@1+ (0.392156862745098,0) [0|0] "%" TOOL
 SG_ S02_PF_REGEN_AVGT m139 : 63|16@0+ (1,0) [0|0] "min" TOOL
 SG_ S02_PF_REGEN_AVGD m139 : 79|16@0+ (1,0) [0|0] "km" TOOL
 SG_ S02_O2S11_PCT_SUP m140 : 32|1@1+ (1,0) [0|0] "" TOOL
 SG_ S02_O2S12_PCT_SUP m140 : 33|1@1+ (1,0) [0|0] "" TOOL
 SG_ S02_O2S21_PCT_SUP m140 : 34|1@1+ (1,0) [0|0] "" TOOL
 SG_ S02_O2S22_PCT_SUP m140 : 35|1@1+ (1,0) [0|0] "" TOOL
 SG_ S02_O2S11_PCT_LAMBDA_SUP m140 : 36|1@1+ (1,0) [0|0] "" TOOL
 SG_ S02_O2S12_PCT_LAMBDA_SUP m140 : 37|1@1+ (1,0) [0|0] "" TOOL
 SG_ S02_O2S21_PCT_LAMBDA_SUP m140 : 38|1@1+ (1,0) [0|0] "" TOOL
 SG_ S02_O2S22_PCT_LAMBDA_SUP m140 : 39|1@1+ (1,0) [0|0] "" TOOL
 SG_ S02_O2S11_PCT m140 : 47|16@0+ (0.001526,0) [0|0] "%" TOOL
 SG_ S02_O2S12_PCT m140 : 63|16@0+ (0.001526,0) [0|0] "%" TOOL
 SG_ S02_O2S21_PCT m140 : 79|16@0+ (0.001526,0) [0|0] "%" TOOL
 SG_ S02_O2S22_PCT m140 : 95|16@0+ (0.001526,0) [0|0] "%" TOOL
 SG_ S02_O2S11_PCT_LAMBDA m140 : 111|16@0+ (0.000122,0) [0|0] "lambda" TOOL
 SG_ S02_O2S12_PCT_LAMBDA m140 : 127|16@0+ (0.000122,0) [0|0] "lambda" TOOL
 SG_ S02_O2S21_PCT_LAMBDA m140 : 143|16@0+ (0.000122,0) [0|0] "lambda" TOOL
 SG_ S02_O2S22_PCT_LAMBDA m140 : 159|16@0+ (0.000122,0) [0|0] "lambda" TOOL
 SG_ S02_TP_G m141 : 32|8@1+ (0.392156862745098,0) [0|0] "%" TOOL
 SG_ S02_TQ_FR m142 : 32|8@1+ (0.1,-125) [0|0] "%" TOOL
 SG_ S02_PM11_STA_SUP m143 : 32|1@1+ (1,0) [0|0] "" TOOL
 SG_ S02_PM11_SIGNAL_SUP m143 : 33|1@1+ (1,0) [0|0] "" TOOL
 SG_ S02_PM21_STA_SUP m143 : 34|1@1+ (1,0) [0|0] "" TOOL
 SG_ S02_PM21_SIGNAL_SUP m143 : 35|1@1+ (1,0) [0|0] "" TOOL
 SG_ S02_PM11_ACTIVE m143 : 40|1@1+ (1,0) [0|0] "" TOOL
 SG_ S02_PM11_REGEN m143 : 41|1@1+ (1,0) [0|0] "" TOOL
 SG_ S02_PM11_NOV m143 : 55|16@0- (0.01,0) [0|0] "%" TOOL
 SG_ S02_PM21_ACTIVE m143 : 64|1@1+ (1,0) [0|0] "" TOOL
 SG_ S02_PM21_REGEN m143 : 65|1@1+ (1,0) [0|0] "" TOOL
 SG_ S02_PM21_NOV m143 : 79|16@0- (0.01,0) [0|0] "%" TOOL
 SG_ S02_MI_DISP_VOBD m144 : 32|2@1+ (1,0) [0|0] "" TOOL
 SG_ S02_MI_MODE_VOBD m144 : 34|4@1+ (1,0) [0|0] "" TOOL
 SG_ S02_VOBD_RDY m144 : 38|1@1+ (1,0) [0|0] "" TOOL
 SG_ S02_VOBD_MI_TIME m144 : 47|16@0+ (1,0) [0|0] "h" TOOL
 SG_ S02_MI_MODE_ECU m145 : 32|4@1+ (1,0) [0|0] "" TOOL
 SG_ S02_OBD_MI_TIME m145 : 47|16@0+ (1,0) [0|0] "h" TOOL
 SG_ S02_OBD_B1_TIME m145 : 63|16@0+ (1,0) [0|0] "h" TOOL
 SG_ S02_FP1_CL_SUP m146 : 32|1@1+ (1,0) [0|0] "" TOOL
 SG_ S02_FIQ1_CL_SUP m146 : 33|1@1+ (1,0) [0|0] "" TOOL
 SG_ S02_FIT1_CL_SUP m146 : 34|1@1+ (1,0) [0|0] "" TOOL
 SG_ S02_IFB1_CL_SUP m146 : 35|1@1+ (1,0) [0|0] "" TOOL
 SG_ S02_FP2_CL_SUP m146 : 36|1@1+ (1,0) [0|0] "" TOOL
 SG_ S02_FIQ2_CL_SUP m146 : 37|1@1+ (1,0) [0|0] "" TOOL
 SG_ S02_FIT2_CL_SUP m146 : 38|1@1+ (1,0) [0|0] "" TOOL
 SG_ S02_IFB2_CL_SUP m146 : 39|1@1+ (1,0) [0|0] "" TOOL
 SG_ S02_FP1_CL m146 : 40|1@1+ (1,0) [0|0] "" TOOL
 SG_ S02_FIQ1_CL m146 : 41|1@1+ (1,0) [0|0] "" TOOL
 SG_ S02_FIT1_CL m146 : 42|1@1+ (1,0) [0|0] "" TOOL
 SG_ S02_IFB1_CL m146 : 43|1@1+ (1,0) [0|0] "" TOOL
 SG_ S02_FP2_CL m146 : 44|1@1+ (1,0) [0|0] "" TOOL
 SG_ S02_FIQ2_CL m146 : 45|1@1+ (1,0) [0|0] "" TOOL
 SG_ S02_FIT2_CL m146 : 46|1@1+ (1,0) [0|0] "" TOOL
 SG_ S02_IFB2_CL m146 : 47|1@1+ (1,0) [0|0] "" TOOL
 SG_ S02_MI_TIME_CUM_SUP m147 : 32|1@1+ (1,0) [0|0] "" TOOL
 SG_ S02_MI_TIME_CUM m147 : 47|16@0+ (1,0) [0|0] "h" TOOL
 SG_ S02_NOX_WARN_ACT_SUP m148 : 32|1@1+ (1,0) [0|0] "" TOOL
 SG_ S02_REAG_QUAL_TIME_SUP m148 : 33|1@1+ (1,0) [0|0] "" TOOL
 SG_ S02_REAG_CON_TIME_SUP m148 : 34|1@1+ (1,0) [0|0] "" TOOL
 SG_ S02_REAG_DOSE_TIME_SUP m148 : 35|1@1+ (1,0) [0|0] "" TOOL
 SG_ S02_EGR_TIME_SUP m148 : 36|1@1+ (1,0) [0|0] "" TOOL
 SG_ S02_NOX_DTC_TIME_SUP m148 : 37|1@1+ (1,0) [0|0] "" TOOL
 SG_ S02_NOX_WARN_ACT m148 : 40|1@1+ (1,0) [0|0] "" TOOL
 SG_ S02_INDUC_L1 m148 : 41|2@1+ (1,0) [0|0] "" TOOL
 SG_ S02_INDUC_L2 m148 : 43|2@1+ (1,0) [0|0] "" TOOL
 SG_ S02_INDUC_L3 m148 : 45|2@1+ (1,0) [0|0] "" TOOL
 SG_ S02_REAG_QUAL_TIME m148 : 55|16@0+ (1,0) [0|0] "h" TOOL
 SG_ S02_REAG_CON_TIME m148 : 71|16@0+ (1,0) [0|0] "h" TOOL
 SG_ S02_REAG_DOSE_TIME m148 : 87|16@0+ (1,0) [0|0] "h" TOOL
 SG_ S02_EGR_TIME m148 : 103|16@0+ (1,0) [0|0] "h" TOOL
 SG_ S02_NOX_DTC_TIME m148 : 119|16@0+ (1,0) [0|0] "h" TOOL
 SG_ S02_SCR_NH3_TGT_A_SUP m149 : 32|1@1+ (1,0) [0|0] "" TOOL
 SG_ S02_SCR_NH3_ACT_A_SUP m149 : 33|1@1+ (1,0) [0|0] "" TOOL
 SG_ S02_SCR_NH3_TGT_B_SUP m149 : 34|1@1+ (1,0) [0|0] "" TOOL
 SG_ S02_SCR_NH3_ACT_B_SUP m149 : 35|1@1+ (1,0) [0|0] "" TOOL
 SG_ S02_SCR_NH3_TGT_A m149 : 47|16@0+ (1,0) [0|0] "g/l" TOOL
 SG_ S02_SCR_NH3_ACT_A m149 : 63|16@0+ (1,0) [0|0] "g/l" TOOL
 SG_ S02_SCR_NH3_TGT_B m149 : 79|16@0+ (1,0) [0|0] "g/l" TOOL
 SG_ S02_SCR_NH3_ACT_B m149 : 95|16@0+ (1,0) [0|0] "g/l" TOOL
 SG_ S02_HC_INJ_FL_SUP m150 : 32|1@1+ (1,0) [0|0] "" TOOL
 SG_ S02_HC_INJ_DC_SUP m150 : 33|1@1+ (1,0) [0|0] "" TOOL
 SG_ S02_AFT_FP_SUP m150 : 34|1@1+ (1,0) [0|0] "" TOOL
 SG_ S02_HC_INJ_FL m150 : 47|16@0+ (0.05,0) [0|0] "g/min" TOOL
 SG_ S02_HC_INJ_DC m150 : 56|8@1+ (0.392156862745098,0) [0|0] "%" TOOL
 SG_ S02_AFT_FP m150 : 71|16@0+ (0.1,0) [0|0] "kPa" TOOL
 SG_ S02_NOx_EO_SUP m151 : 32|1@1+ (1,0) [0|0] "" TOOL
 SG_ S02_NOx_TP_SUP m151 : 33|1@1+ (1,0) [0|0] "" TOOL
 SG_ S02_NOx_EO m151 : 47|16@0+ (1,0) [0|0] "" TOOL
 SG_ S02_NOx_TP m151 : 63|16@0+ (1,0) [0|0] "" TOOL
 SG_ S02_EGT15_SUP m152 : 32|1@1+ (1,0) [0|0] "" TOOL
 SG_ S02_EGT16_SUP m152 : 33|1@1+ (1,0) [0|0] "" TOOL
 SG_ S02_EGT17_SUP m152 : 34|1@1+ (1,0) [0|0] "" TOOL
 SG_ S02_EGT18_SUP m152 : 35|1@1+ (1,0) [0|0] "" TOOL
 SG_ S02_EGT15 m152 : 47|16@0+ (0.1,-40) [0|0] "°C " TOOL
 SG_ S02_EGT16 m152 : 63|16@0+ (0.1,-40) [0|0] "°C " TOOL
 SG_ S02_EGT17 m152 : 79|16@0+ (0.1,-40) [0|0] "°C " TOOL
 SG_ S02_EGT18 m152 : 95|16@0+ (0.1,-40) [0|0] "°C " TOOL
 SG_ S02_EGT25_SUP m153 : 32|1@1+ (1,0) [0|0] "" TOOL
 SG_ S02_EGT26_SUP m153 : 33|1@1+ (1,0) [0|0] "" TOOL
 SG_ S02_EGT27_SUP m153 : 34|1@1+ (1,0) [0|0] "" TOOL
 SG_ S02_EGT28_SUP m153 : 35|1@1+ (1,0) [0|0] "" TOOL
 SG_ S02_EGT25 m153 : 47|16@0+ (0.1,-40) [0|0] "°C " TOOL
 SG_ S02_EGT26 m153 : 63|16@0+ (0.1,-40) [0|0] "°C " TOOL
 SG_ S02_EGT27 m153 : 79|16@0+ (0.1,-40) [0|0] "°C " TOOL
 SG_ S02_EGT28 m153 : 95|16@0+ (0.1,-40) [0|0] "°C " TOOL
 SG_ S02_HEV_CHRG_STA_SUP m154 : 32|1@1+ (1,0) [0|0] "" TOOL
 SG_ S02_HEV_BATT_V_SUP m154 : 33|1@1+ (1,0) [0|0] "" TOOL
 SG_ S02_HEV_BATT_A_SUP m154 : 34|1@1+ (1,0) [0|0] "" TOOL
 SG_ S02_EHEV_CHRG_STA_SUP m154 : 35|1@1+ (1,0) [0|0] "" TOOL
 SG_ S02_HEV_CHRG_STA m154 : 40|1@1+ (1,0) [0|0] "" TOOL
 SG_ S02_EHEV_CHRG_STA m154 : 41|2@1+ (1,0) [0|0] "" TOOL
 SG_ S02_HEV_BATT_V m154 : 55|16@0+ (0.015625,0) [0|0] "V" TOOL
 SG_ S02_HEV_BATT_A m154 : 71|16@0+ (0.1,0) [0|0] "A" TOOL
 SG_ S02_DEF_TYPE_SUP m155 : 32|1@1+ (1,0) [0|0] "" TOOL
 SG_ S02_DEF_CON_SUP m155 : 33|1@1+ (1,0) [0|0] "" TOOL
 SG_ S02_DEF_T_SUP m155 : 34|1@1+ (1,0) [0|0] "" TOOL
 SG_ S02_DEF_LVL_SUP m155 : 35|1@1+ (1,0) [0|0] "" TOOL
 SG_ S02_DEF_TYPE m155 : 36|4@1+ (1,0) [0|0] "" TOOL
 SG_ S02_DEF_CON m155 : 40|8@1+ (0.25,0) [0|0] "%" TOOL
 SG_ S02_DEF_T m155 : 48|8@1+ (1,-40) [0|0] "°C " TOOL
 SG_ S02_DEF_LVL m155 : 56|8@1+ (0.392156862745098,0) [0|0] "%" TOOL
 SG_ S02_O2S13_PCT_SUP m156 : 32|1@1+ (1,0) [0|0] "" TOOL
 SG_ S02_O2S14_PCT_SUP m156 : 33|1@1+ (1,0) [0|0] "" TOOL
 SG_ S02_O2S23_PCT_SUP m156 : 34|1@1+ (1,0) [0|0] "" TOOL
 SG_ S02_O2S24_PCT_SUP m156 : 35|1@1+ (1,0) [0|0] "" TOOL
 SG_ S02_O2S13_PCT_LAMBDA_SUP m156 : 36|1@1+ (1,0) [0|0] "" TOOL
 SG_ S02_O2S14_PCT_LAMBDA_SUP m156 : 37|1@1+ (1,0) [0|0] "" TOOL
 SG_ S02_O2S23_PCT_LAMBDA_SUP m156 : 38|1@1+ (1,0) [0|0] "" TOOL
 SG_ S02_O2S24_PCT_LAMBDA_SUP m156 : 39|1@1+ (1,0) [0|0] "" TOOL
 SG_ S02_O2S13_PCT m156 : 47|16@0+ (0.001526,0) [0|0] "%" TOOL
 SG_ S02_O2S14_PCT m156 : 63|16@0+ (0.001526,0) [0|0] "%" TOOL
 SG_ S02_O2S23_PCT m156 : 79|16@0+ (0.001526,0) [0|0] "%" TOOL
 SG_ S02_O2S24_PCT m156 : 95|16@0+ (0.001526,0) [0|0] "%" TOOL
 SG_ S02_O2S13_PCT_LAMBDA m156 : 111|16@0+ (0.000122,0) [0|0] "lambda" TOOL
 SG_ S02_O2S14_PCT_LAMBDA m156 : 127|16@0+ (0.000122,0) [0|0] "lambda" TOOL
 SG_ S02_O2S23_PCT_LAMBDA m156 : 143|16@0+ (0.000122,0) [0|0] "lambda" TOOL
 SG_ S02_O2S24_PCT_LAMBDA m156 : 159|16@0+ (0.000122,0) [0|0] "lambda" TOOL
 SG_ S02_FUEL_RATE_GS m157 : 39|16@0+ (0.02,0) [0|0] "g/s" TOOL
 SG_ S02_VFUEL_RATE m157 : 55|16@0+ (0.02,0) [0|0] "g/s" TOOL
 SG_ S02_EXH_RATE m158 : 39|16@0+ (0.2,0) [0|0] "kg/h " TOOL
 SG_ S02_FUELSYSA_B1_SUP m159 : 32|1@1+ (1,0) [0|0] "" TOOL
 SG_ S02_FUELSYSB_B1_SUP m159 : 33|1@1+ (1,0) [0|0] "" TOOL
 SG_ S02_FUELSYSA_B2_SUP m159 : 34|1@1+ (1,0) [0|0] "" TOOL
 SG_ S02_FUELSYSB_B2_SUP m159 : 35|1@1+ (1,0) [0|0] "" TOOL
 SG_ S02_FUELSYSA_B3_SUP m159 : 36|1@1+ (1,0) [0|0] "" TOOL
 SG_ S02_FUELSYSB_B3_SUP m159 : 37|1@1+ (1,0) [0|0] "" TOOL
 SG_ S02_FUELSYSA_B4_SUP m159 : 38|1@1+ (1,0) [0|0] "" TOOL
 SG_ S02_FUELSYSB_B4_SUP m159 : 39|1@1+ (1,0) [0|0] "" TOOL
 SG_ S02_FUELSYSA_B1 m159 : 40|8@1+ (0.392156862745098,0) [0|0] "%" TOOL
 SG_ S02_FUELSYSB_B1 m159 : 48|8@1+ (0.392156862745098,0) [0|0] "%" TOOL
 SG_ S02_FUELSYSA_B2 m159 : 56|8@1+ (0.392156862745098,0) [0|0] "%" TOOL
 SG_ S02_FUELSYSB_B2 m159 : 64|8@1+ (0.392156862745098,0) [0|0] "%" TOOL
 SG_ S02_FUELSYSA_B3 m159 : 72|8@1+ (0.392156862745098,0) [0|0] "%" TOOL
 SG_ S02_FUELSYSB_B3 m159 : 80|8@1+ (0.392156862745098,0) [0|0] "%" TOOL
 SG_ S02_FUELSYSA_B4 m159 : 88|8@1+ (0.392156862745098,0) [0|0] "%" TOOL
 SG_ S02_FUELSYSB_B4 m159 : 96|8@1+ (0.392156862745098,0) [0|0] "%" TOOL
 SG_ S02_NOXC11_SUP m161 : 32|1@1+ (1,0) [0|0] "" TOOL
 SG_ S02_NOXC12_SUP m161 : 33|1@1+ (1,0) [0|0] "" TOOL
 SG_ S02_NOXC21_SUP m161 : 34|1@1+ (1,0) [0|0] "" TOOL
 SG_ S02_NOXC22_SUP m161 : 35|1@1+ (1,0) [0|0] "" TOOL
 SG_ S02_NOXC11_RDY m161 : 36|1@1+ (1,0) [0|0] "" TOOL
 SG_ S02_NOXC12_RDY m161 : 37|1@1+ (1,0) [0|0] "" TOOL
 SG_ S02_NOXC21_RDY m161 : 38|1@1+ (1,0) [0|0] "" TOOL
 SG_ S02_NOXC22_RDY m161 : 39|1@1+ (1,0) [0|0] "" TOOL
 SG_ S02_NOXC11 m161 : 47|16@0+ (1,0) [0|0] "ppm" TOOL
 SG_ S02_NOXC12 m161 : 63|16@0+ (1,0) [0|0] "ppm" TOOL
 SG_ S02_NOXC21 m161 : 79|16@0+ (1,0) [0|0] "ppm" TOOL
 SG_ S02_NOXC22 m161 : 95|16@0+ (1,0) [0|0] "ppm" TOOL
 SG_ S02_CYL_RATE m162 : 39|16@0+ (0.03125,0) [0|0] "mg/stoke" TOOL
 SG_ S02_EVAP_A_VP_SUP m163 : 32|1@1+ (1,0) [0|0] "" TOOL
 SG_ S02_EVAP_A_VP_WR_SUP m163 : 33|1@1+ (1,0) [0|0] "" TOOL
 SG_ S02_EVAP_B_VP_SUP m163 : 34|1@1+ (1,0) [0|0] "" TOOL
 SG_ S02_EVAP_B_VP_WR_SUP m163 : 35|1@1+ (1,0) [0|0] "" TOOL
 SG_ S02_EVAP_SEAL_SUP m163 : 36|1@1+ (1,0) [0|0] "" TOOL
 SG_ S02_EVAP_SEAL m163 : 37|1@1+ (1,0) [0|0] "" TOOL
 SG_ S02_EVAP_A_VP m163 : 47|16@0- (0.25,0) [0|0] "Pa" TOOL
 SG_ S02_EVAP_A_VP_WR m163 : 63|16@0- (2,0) [0|0] "Pa" TOOL
 SG_ S02_EVAP_B_VP m163 : 79|16@0- (0.25,0) [0|0] "Pa" TOOL
 SG_ S02_EVAP_B_VP_WR m163 : 95|16@0- (2,0) [0|0] "Pa" TOOL
 SG_ S02_GEAR_ACT_SUP m164 : 32|1@1+ (1,0) [0|0] "" TOOL
 SG_ S02_GEAR_RAT_SUP m164 : 33|1@1+ (1,0) [0|0] "" TOOL
 SG_ S02_GEAR_ACT m164 : 44|4@1+ (1,0) [0|0] "" TOOL
 SG_ S02_GEAR_RAT m164 : 55|16@0+ (0.001,0) [0|0] "" TOOL
 SG_ S02_DEF_CMD_SUP m165 : 32|1@1+ (1,0) [0|0] "" TOOL
 SG_ S02_DEF_UCDC_SUP m165 : 33|1@1+ (1,0) [0|0] "" TOOL
 SG_ S02_DEF_CMD m165 : 40|8@1+ (0.5,0) [0|0] "%" TOOL
 SG_ S02_DEF_UCDC m165 : 55|16@0+ (0.0005,0) [0|0] "L" TOOL
 SG_ S02_ODO m166 : 39|32@0+ (0.1,0) [0|0] "km" TOOL
 SG_ S02_NOX13_SUP m167 : 32|1@1+ (1,0) [0|0] "" TOOL
 SG_ S02_NOX14_SUP m167 : 33|1@1+ (1,0) [0|0] "" TOOL
 SG_ S02_NOX23_SUP m167 : 34|1@1+ (1,0) [0|0] "" TOOL
 SG_ S02_NOX24_SUP m167 : 35|1@1+ (1,0) [0|0] "" TOOL
 SG_ S02_NOX13_RDY m167 : 36|1@1+ (1,0) [0|0] "" TOOL
 SG_ S02_NOX14_RDY m167 : 37|1@1+ (1,0) [0|0] "" TOOL
 SG_ S02_NOX23_RDY m167 : 38|1@1+ (1,0) [0|0] "" TOOL
 SG_ S02_NOX24_RDY m167 : 39|1@1+ (1,0) [0|0] "" TOOL
 SG_ S02_NOX13 m167 : 47|16@0+ (1,0) [0|0] "ppm" TOOL
 SG_ S02_NOX14 m167 : 63|16@0+ (1,0) [0|0] "ppm" TOOL
 SG_ S02_NOX23 m167 : 79|16@0+ (1,0) [0|0] "ppm" TOOL
 SG_ S02_NOX24 m167 : 95|16@0+ (1,0) [0|0] "ppm" TOOL
 SG_ S02_NOXC13_SUP m168 : 32|1@1+ (1,0) [0|0] "" TOOL
 SG_ S02_NOXC14_SUP m168 : 33|1@1+ (1,0) [0|0] "" TOOL
 SG_ S02_NOXC23_SUP m168 : 34|1@1+ (1,0) [0|0] "" TOOL
 SG_ S02_NOXC24_SUP m168 : 35|1@1+ (1,0) [0|0] "" TOOL
 SG_ S02_NOXC13_RDY m168 : 36|1@1+ (1,0) [0|0] "" TOOL
 SG_ S02_NOXC14_RDY m168 : 37|1@1+ (1,0) [0|0] "" TOOL
 SG_ S02_NOXC23_RDY m168 : 38|1@1+ (1,0) [0|0] "" TOOL
 SG_ S02_NOXC24_RDY m168 : 39|1@1+ (1,0) [0|0] "" TOOL
 SG_ S02_NOXC13 m168 : 47|16@0+ (1,0) [0|0] "ppm" TOOL
 SG_ S02_NOXC14 m168 : 63|16@0+ (1,0) [0|0] "ppm" TOOL
 SG_ S02_NOXC23 m168 : 79|16@0+ (1,0) [0|0] "ppm" TOOL
 SG_ S02_NOXC24 m168 : 95|16@0+ (1,0) [0|0] "ppm" TOOL
 SG_ S02_ABS_DISABLED_SUP m169 : 32|1@1+ (1,0) [0|0] "" TOOL
 SG_ S02_ABS_DISABLED m169 : 40|1@1+ (1,0) [0|0] "" TOOL
 SG_ S02_V_SET m170 : 32|8@1+ (1,0) [0|0] "km/h" TOOL
 SG_ S02_FRP_AF_SUP m171 : 32|1@1+ (1,0) [0|0] "" TOOL
 SG_ S02_FRT_AF_SUP m171 : 33|1@1+ (1,0) [0|0] "" TOOL
 SG_ S02_FTP_AF_SUP m171 : 34|1@1+ (1,0) [0|0] "" TOOL
 SG_ S02_FTPW_AF_SUP m171 : 35|1@1+ (1,0) [0|0] "" TOOL
 SG_ S02_FTT_AF_SUP m171 : 36|1@1+ (1,0) [0|0] "" TOOL
 SG_ S02_FRP_AF m171 : 47|16@0+ (0.03125,0) [0|0] "kPa" TOOL
 SG_ S02_FRT_AF m171 : 56|8@1+ (1,-40) [0|0] "°C " TOOL
 SG_ S02_FTP_AF m171 : 71|16@0+ (0.125,0) [0|0] "kPa" TOOL
 SG_ S02_FTPW_AF m171 : 87|16@0+ (1,0) [0|0] "kPa" TOOL
 SG_ S02_FTT_AF m171 : 96|8@1+ (2,-256) [0|0] "°C " TOOL
 SG_ S02_CKC_P_SUP m173 : 32|1@1+ (1,0) [0|0] "" TOOL
 SG_ S02_CKC_OSEP_RPM_SUP m173 : 33|1@1+ (1,0) [0|0] "" TOOL
 SG_ S02_CKC_P m173 : 47|16@0- (0.25,0) [0|0] "Pa" TOOL
 SG_ S02_CKC_OSEP_RPM m173 : 63|16@0+ (1,0) [0|0] "rpm" TOOL
 SG_ S02_EVAP_PP_SUP m174 : 32|1@1+ (1,0) [0|0] "" TOOL
 SG_ S02_EVAP_PP_WR_SUP m174 : 33|1@1+ (1,0) [0|0] "" TOOL
 SG_ S02_EVAP_PP m174 : 47|16@0- (0.25,0) [0|0] "Pa" TOOL
 SG_ S02_EVAP_PP_WR m174 : 63|16@0- (2,0) [0|0] "Pa" TOOL
 SG_ S02_AIR_FL_TGT m175 : 39|16@0+ (0.05,0) [0|0] "kg/hr " TOOL
 SG_ S02_EGR_M_FL_A_SUP m176 : 32|1@1+ (1,0) [0|0] "" TOOL
 SG_ S02_EGR_M_FL_B_SUP m176 : 33|1@1+ (1,0) [0|0] "" TOOL
 SG_ S02_EGR_M_FL_A m176 : 47|16@0+ (0.05,0) [0|0] "kg/hr " TOOL
 SG_ S02_EGR_M_FL_B m176 : 63|16@0+ (0.05,0) [0|0] "kg/hr " TOOL
 SG_ S02_CIFSI1_SUP m177 : 32|1@1+ (1,0) [0|0] "" TOOL
 SG_ S02_CIFSI2_SUP m177 : 33|1@1+ (1,0) [0|0] "" TOOL
 SG_ S02_CIFSI1_SHRTFT_SUP m177 : 34|1@1+ (1,0) [0|0] "" TOOL
 SG_ S02_CIFSI1_LONGFT_SUP m177 : 35|1@1+ (1,0) [0|0] "" TOOL
 SG_ S02_CIFSI2_SHRTFT_SUP m177 : 36|1@1+ (1,0) [0|0] "" TOOL
 SG_ S02_CIFSI2_LONGFT_SUP m177 : 37|1@1+ (1,0) [0|0] "" TOOL
 SG_ S02_CIFSI1_OL m177 : 40|1@1+ (1,0) [0|0] "" TOOL
 SG_ S02_CIFSI1_CL m177 : 41|1@1+ (1,0) [0|0] "" TOOL
 SG_ S02_CIFSI1_OL_Fault m177 : 42|1@1+ (1,0) [0|0] "" TOOL
 SG_ S02_CIFSI2_OL m177 : 44|1@1+ (1,0) [0|0] "" TOOL
 SG_ S02_CIFSI2_CL m177 : 45|1@1+ (1,0) [0|0] "" TOOL
 SG_ S02_CIFSI2_OL_Fault m177 : 46|1@1+ (1,0) [0|0] "" TOOL
 SG_ S02_CIFSI1_SHRTFT m177 : 48|8@1- (0.78125,0) [0|0] "%" TOOL
 SG_ S02_CIFSI1_LONGFT m177 : 56|8@1- (0.78125,0) [0|0] "%" TOOL
 SG_ S02_CIFSI2_SHRTFT m177 : 64|8@1- (0.78125,0) [0|0] "%" TOOL
 SG_ S02_CIFSI2_LONGFT m177 : 72|8@1+ (1,0) [0|0] "" TOOL
 SG_ S02_BAT_RET m178 : 32|8@1+ (0.392156862745098,0) [0|0] "%" TOOL
 SG_ S02_HVESPA_ACR_SUP m179 : 32|1@1+ (1,0) [0|0] "" TOOL
 SG_ S02_HVESPB_ACR_SUP m179 : 33|1@1+ (1,0) [0|0] "" TOOL
 SG_ S02_HVESPC_ACR_SUP m179 : 34|1@1+ (1,0) [0|0] "" TOOL
 SG_ S02_HVESPD_ACR_SUP m179 : 35|1@1+ (1,0) [0|0] "" TOOL
 SG_ S02_HVESPE_ACR_SUP m179 : 36|1@1+ (1,0) [0|0] "" TOOL
 SG_ S02_HVESPF_ACR_SUP m179 : 37|1@1+ (1,0) [0|0] "" TOOL
 SG_ S02_HVESPG_ACR_SUP m179 : 38|1@1+ (1,0) [0|0] "" TOOL
 SG_ S02_HVESPH_ACR_SUP m179 : 39|1@1+ (1,0) [0|0] "" TOOL
 SG_ S02_HVESS_ACR m179 : 47|16@0+ (0.05,0) [0|0] "kW" TOOL
 SG_ S02_HVESPA_ACR m179 : 63|16@0+ (0.05,0) [0|0] "kW" TOOL
 SG_ S02_HVESPB_ACR m179 : 79|16@0+ (0.05,0) [0|0] "kW" TOOL
 SG_ S02_HVESPC_ACR m179 : 95|16@0+ (0.05,0) [0|0] "kW" TOOL
 SG_ S02_HVESPD_ACR m179 : 111|16@0+ (0.05,0) [0|0] "kW" TOOL
 SG_ S02_HVESPE_ACR m179 : 127|16@0+ (0.05,0) [0|0] "kW" TOOL
 SG_ S02_HVESPF_ACR m179 : 143|16@0+ (0.05,0) [0|0] "kW" TOOL
 SG_ S02_HVESPG_ACR m179 : 159|16@0+ (0.05,0) [0|0] "kW" TOOL
 SG_ S02_HVESPH_ACR m179 : 175|16@0+ (0.05,0) [0|0] "kW" TOOL
 SG_ S02_HVESPA_Temp_SUP m180 : 32|1@1+ (1,0) [0|0] "" TOOL
 SG_ S02_HVESPB_Temp_SUP m180 : 33|1@1+ (1,0) [0|0] "" TOOL
 SG_ S02_HVESPC_Temp_SUP m180 : 34|1@1+ (1,0) [0|0] "" TOOL
 SG_ S02_HVESPD_Temp_SUP m180 : 35|1@1+ (1,0) [0|0] "" TOOL
 SG_ S02_HVESPE_Temp_SUP m180 : 36|1@1+ (1,0) [0|0] "" TOOL
 SG_ S02_HVESPF_Temp_SUP m180 : 37|1@1+ (1,0) [0|0] "" TOOL
 SG_ S02_HVESPG_Temp_SUP m180 : 38|1@1+ (1,0) [0|0] "" TOOL
 SG_ S02_HVESPH_Temp_SUP m180 : 39|1@1+ (1,0) [0|0] "" TOOL
 SG_ S02_HVESS_Temp m180 : 40|8@1+ (1,-40) [0|0] "°C " TOOL
 SG_ S02_HVESPA_Temp m180 : 48|8@1+ (1,-40) [0|0] "°C " TOOL
 SG_ S02_HVESPB_Temp m180 : 56|8@1+ (1,-40) [0|0] "°C " TOOL
 SG_ S02_HVESPC_Temp m180 : 64|8@1+ (1,-40) [0|0] "°C " TOOL
 SG_ S02_HVESPD_Temp m180 : 72|8@1+ (1,-40) [0|0] "°C " TOOL
 SG_ S02_HVESPE_Temp m180 : 80|8@1+ (1,-40) [0|0] "°C " TOOL
 SG_ S02_HVESPF_Temp m180 : 88|8@1+ (1,-40) [0|0] "°C " TOOL
 SG_ S02_HVESPG_Temp m180 : 96|8@1+ (1,-40) [0|0] "°C " TOOL
 SG_ S02_HVESPH_Temp m180 : 104|8@1+ (1,-40) [0|0] "°C " TOOL
 SG_ S02_HVESPA_Cur_SUP m181 : 32|1@1+ (1,0) [0|0] "" TOOL
 SG_ S02_HVESPB_Cur_SUP m181 : 33|1@1+ (1,0) [0|0] "" TOOL
 SG_ S02_HVESPC_Cur_SUP m181 : 34|1@1+ (1,0) [0|0] "" TOOL
 SG_ S02_HVESPD_Cur_SUP m181 : 35|1@1+ (1,0) [0|0] "" TOOL
 SG_ S02_HVESPE_Cur_SUP m181 : 36|1@1+ (1,0) [0|0] "" TOOL
 SG_ S02_HVESPF_Cur_SUP m181 : 37|1@1+ (1,0) [0|0] "" TOOL
 SG_ S02_HVESPG_Cur_SUP m181 : 38|1@1+ (1,0) [0|0] "" TOOL
 SG_ S02_HVESPH_Cur_SUP m181 : 39|1@1+ (1,0) [0|0] "" TOOL
 SG_ S02_HVESS_Cur m181 : 47|16@0+ (0.05,0) [0|0] "A" TOOL
 SG_ S02_HVESPA_Cur m181 : 63|16@0+ (0.05,0) [0|0] "A" TOOL
 SG_ S02_HVESPB_Cur m181 : 79|16@0+ (0.05,0) [0|0] "A" TOOL
 SG_ S02_HVESPC_Cur m181 : 95|16@0+ (0.05,0) [0|0] "A" TOOL
 SG_ S02_HVESPD_Cur m181 : 111|16@0+ (0.05,0) [0|0] "A" TOOL
 SG_ S02_HVESPE_Cur m181 : 127|16@0+ (0.05,0) [0|0] "A" TOOL
 SG_ S02_HVESPF_Cur m181 : 143|16@0+ (0.05,0) [0|0] "A" TOOL
 SG_ S02_HVESPG_Cur m181 : 159|16@0+ (0.05,0) [0|0] "A" TOOL
 SG_ S02_HVESPH_Cur m181 : 175|16@0+ (0.05,0) [0|0] "A" TOOL
 SG_ S02_HVESPA_Volt_SUP m182 : 32|1@1+ (1,0) [0|0] "" TOOL
 SG_ S02_HVESPB_Volt_SUP m182 : 33|1@1+ (1,0) [0|0] "" TOOL
 SG_ S02_HVESPC_Volt_SUP m182 : 34|1@1+ (1,0) [0|0] "" TOOL
 SG_ S02_HVESPD_Volt_SUP m182 : 35|1@1+ (1,0) [0|0] "" TOOL
 SG_ S02_HVESPE_Volt_SUP m182 : 36|1@1+ (1,0) [0|0] "" TOOL
 SG_ S02_HVESPF_Volt_SUP m182 : 37|1@1+ (1,0) [0|0] "" TOOL
 SG_ S02_HVESPG_Volt_SUP m182 : 38|1@1+ (1,0) [0|0] "" TOOL
 SG_ S02_HVESPH_Volt_SUP m182 : 39|1@1+ (1,0) [0|0] "" TOOL
 SG_ S02_HVESS_Volt m182 : 47|16@0+ (0.05,0) [0|0] "V" TOOL
 SG_ S02_HVESPA_Volt m182 : 63|16@0+ (0.05,0) [0|0] "V" TOOL
 SG_ S02_HVESPB_Volt m182 : 79|16@0+ (0.05,0) [0|0] "V" TOOL
 SG_ S02_HVESPC_Volt m182 : 95|16@0+ (0.05,0) [0|0] "V" TOOL
 SG_ S02_HVESPD_Volt m182 : 111|16@0+ (0.05,0) [0|0] "V" TOOL
 SG_ S02_HVESPE_Volt m182 : 127|16@0+ (0.05,0) [0|0] "V" TOOL
 SG_ S02_HVESPF_Volt m182 : 143|16@0+ (0.05,0) [0|0] "V" TOOL
 SG_ S02_HVESPG_Volt m182 : 159|16@0+ (0.05,0) [0|0] "V" TOOL
 SG_ S02_HVESPH_Volt m182 : 175|16@0+ (0.05,0) [0|0] "V" TOOL
 SG_ S02_HEV_Batt_Min_Cell_Temp_SUP m183 : 32|1@1+ (1,0) [0|0] "" TOOL
 SG_ S02_HEV_Batt_Max_Cell_Temp_SUP m183 : 33|1@1+ (1,0) [0|0] "" TOOL
 SG_ S02_HEV_Batt_Ave_Cell_Temp_SUP m183 : 34|1@1+ (1,0) [0|0] "" TOOL
 SG_ S02_HEV_Batt_Bus_Bar_Temp_SUP m183 : 35|1@1+ (1,0) [0|0] "" TOOL
 SG_ S02_HEV_Batt_Coolant_Temp_SUP m183 : 36|1@1+ (1,0) [0|0] "" TOOL
 SG_ S02_HEV_Batt_Therm_Mode_SUP m183 : 37|1@1+ (1,0) [0|0] "" TOOL
 SG_ S02_HEV_Batt_Min_Cell_Temp m183 : 40|8@1+ (1,-40) [0|0] "°C " TOOL
 SG_ S02_HEV_Batt_Max_Cell_Temp m183 : 48|8@1+ (1,-40) [0|0] "°C " TOOL
 SG_ S02_HEV_Batt_Ave_Cell_Temp m183 : 56|8@1+ (1,-40) [0|0] "°C " TOOL
 SG_ S02_HEV_Batt_Bus_Bar_Temp m183 : 64|8@1+ (1,-40) [0|0] "°C " TOOL
 SG_ S02_HEV_Batt_Coolant_Temp m183 : 72|8@1+ (1,-40) [0|0] "°C " TOOL
 SG_ S02_HEV_Batt_Therm_Mode m183 : 80|8@1+ (1,0) [0|0] "" TOOL
 SG_ S02_HEV_Batt_Time_Since_Last_Balance m184 : 39|16@0+ (1,0) [0|0] "min" TOOL
 SG_ S02_HEV_Batt_Min_Cell_Voltage m185 : 39|16@0+ (0.001,0) [0|0] "V" TOOL
 SG_ S02_HEV_Batt_Max_Cell_Voltage m185 : 55|16@0+ (0.001,0) [0|0] "V" TOOL
 SG_ S02_HEV_Batt_PWR_Available m186 : 32|8@1+ (0.392156862745098,0) [0|0] "%" TOOL
 SG_ S02_HEV_Batt_Charge_Current_Limit m186 : 47|16@0- (0.1,0) [0|0] "A" TOOL
 SG_ S02_HEV_Batt_Discharge_Current_Limit m186 : 63|16@0- (0.1,0) [0|0] "A" TOOL
 SG_ S02_HVESPA_Enrg_In_SUP m187 : 32|1@1+ (1,0) [0|0] "" TOOL
 SG_ S02_HVESPB_Enrg_In_SUP m187 : 33|1@1+ (1,0) [0|0] "" TOOL
 SG_ S02_HVESPC_Enrg_In_SUP m187 : 34|1@1+ (1,0) [0|0] "" TOOL
 SG_ S02_HVESPD_Enrg_In_SUP m187 : 35|1@1+ (1,0) [0|0] "" TOOL
 SG_ S02_HVESPE_Enrg_In_SUP m187 : 36|1@1+ (1,0) [0|0] "" TOOL
 SG_ S02_HVESPF_Enrg_In_SUP m187 : 37|1@1+ (1,0) [0|0] "" TOOL
 SG_ S02_HVESPG_Enrg_In_SUP m187 : 38|1@1+ (1,0) [0|0] "" TOOL
 SG_ S02_HVESPH_Enrg_In_SUP m187 : 39|1@1+ (1,0) [0|0] "" TOOL
 SG_ S02_HVESS_Enrg_In m187 : 47|32@0+ (1,0) [0|0] "kWh" TOOL
 SG_ S02_HVESPA_Enrg_In m187 : 79|32@0+ (1,0) [0|0] "kWh" TOOL
 SG_ S02_HVESPB_Enrg_In m187 : 111|32@0+ (1,0) [0|0] "kWh" TOOL
 SG_ S02_HVESPC_Enrg_In m187 : 143|32@0+ (1,0) [0|0] "kWh" TOOL
 SG_ S02_HVESPD_Enrg_In m187 : 175|32@0+ (1,0) [0|0] "kWh" TOOL
 SG_ S02_HVESPE_Enrg_In m187 : 207|32@0+ (1,0) [0|0] "kWh" TOOL
 SG_ S02_HVESPF_Enrg_In m187 : 239|32@0+ (1,0) [0|0] "kWh" TOOL
 SG_ S02_HVESPG_Enrg_In m187 : 271|32@0+ (1,0) [0|0] "kWh" TOOL
 SG_ S02_HVESPH_Enrg_In m187 : 303|32@0+ (1,0) [0|0] "kWh" TOOL
 SG_ S02_HVESPA_Enrg_Out_SUP m188 : 32|1@1+ (1,0) [0|0] "" TOOL
 SG_ S02_HVESPB_Enrg_Out_SUP m188 : 33|1@1+ (1,0) [0|0] "" TOOL
 SG_ S02_HVESPC_Enrg_Out_SUP m188 : 34|1@1+ (1,0) [0|0] "" TOOL
 SG_ S02_HVESPD_Enrg_Out_SUP m188 : 35|1@1+ (1,0) [0|0] "" TOOL
 SG_ S02_HVESPE_Enrg_Out_SUP m188 : 36|1@1+ (1,0) [0|0] "" TOOL
 SG_ S02_HVESPF_Enrg_Out_SUP m188 : 37|1@1+ (1,0) [0|0] "" TOOL
 SG_ S02_HVESPG_Enrg_Out_SUP m188 : 38|1@1+ (1,0) [0|0] "" TOOL
 SG_ S02_HVESPH_Enrg_Out_SUP m188 : 39|1@1+ (1,0) [0|0] "" TOOL
 SG_ S02_HVESS_Enrg_Out m188 : 47|32@0+ (1,0) [0|0] "kWh" TOOL
 SG_ S02_HVESPA_Enrg_Out m188 : 79|32@0+ (1,0) [0|0] "kWh" TOOL
 SG_ S02_HVESPB_Enrg_Out m188 : 111|32@0+ (1,0) [0|0] "kWh" TOOL
 SG_ S02_HVESPC_Enrg_Out m188 : 143|32@0+ (1,0) [0|0] "kWh" TOOL
 SG_ S02_HVESPD_Enrg_Out m188 : 175|32@0+ (1,0) [0|0] "kWh" TOOL
 SG_ S02_HVESPE_Enrg_Out m188 : 207|32@0+ (1,0) [0|0] "kWh" TOOL
 SG_ S02_HVESPF_Enrg_Out m188 : 239|32@0+ (1,0) [0|0] "kWh" TOOL
 SG_ S02_HVESPG_Enrg_Out m188 : 271|32@0+ (1,0) [0|0] "kWh" TOOL
 SG_ S02_HVESPH_Enrg_Out m188 : 303|32@0+ (1,0) [0|0] "kWh" TOOL
 SG_ S02_HVESPA_Enrg_Tput_SUP m189 : 32|1@1+ (1,0) [0|0] "" TOOL
 SG_ S02_HVESPB_Enrg_Tput_SUP m189 : 33|1@1+ (1,0) [0|0] "" TOOL
 SG_ S02_HVESPC_Enrg_Tput_SUP m189 : 34|1@1+ (1,0) [0|0] "" TOOL
 SG_ S02_HVESPD_Enrg_Tput_SUP m189 : 35|1@1+ (1,0) [0|0] "" TOOL
 SG_ S02_HVESPE_Enrg_Tput_SUP m189 : 36|1@1+ (1,0) [0|0] "" TOOL
 SG_ S02_HVESPF_Enrg_Tput_SUP m189 : 37|1@1+ (1,0) [0|0] "" TOOL
 SG_ S02_HVESPG_Enrg_Tput_SUP m189 : 38|1@1+ (1,0) [0|0] "" TOOL
 SG_ S02_HVESPH_Enrg_Tput_SUP m189 : 39|1@1+ (1,0) [0|0] "" TOOL
 SG_ S02_HVESS_Enrg_Tput m189 : 47|32@0+ (100,0) [0|0] "Wh" TOOL
 SG_ S02_HVESPA_Enrg_Tput m189 : 79|32@0+ (100,0) [0|0] "Wh" TOOL
 SG_ S02_HVESPB_Enrg_Tput m189 : 111|32@0+ (100,0) [0|0] "Wh" TOOL
 SG_ S02_HVESPC_Enrg_Tput m189 : 143|32@0+ (100,0) [0|0] "Wh" TOOL
 SG_ S02_HVESPD_Enrg_Tput m189 : 175|32@0+ (100,0) [0|0] "Wh" TOOL
 SG_ S02_HVESPE_Enrg_Tput m189 : 207|32@0+ (100,0) [0|0] "Wh" TOOL
 SG_ S02_HVESPF_Enrg_Tput m189 : 239|32@0+ (100,0) [0|0] "Wh" TOOL
 SG_ S02_HVESPG_Enrg_Tput m189 : 271|32@0+ (100,0) [0|0] "Wh" TOOL
 SG_ S02_HVESPH_Enrg_Tput m189 : 303|32@0+ (100,0) [0|0] "Wh" TOOL
 SG_ S02_HVESPA_SOH_SUP m190 : 32|1@1+ (1,0) [0|0] "" TOOL
 SG_ S02_HVESPB_SOH_SUP m190 : 33|1@1+ (1,0) [0|0] "" TOOL
 SG_ S02_HVESPC_SOH_SUP m190 : 34|1@1+ (1,0) [0|0] "" TOOL
 SG_ S02_HVESPD_SOH_SUP m190 : 35|1@1+ (1,0) [0|0] "" TOOL
 SG_ S02_HVESPE_SOH_SUP m190 : 36|1@1+ (1,0) [0|0] "" TOOL
 SG_ S02_HVESPF_SOH_SUP m190 : 37|1@1+ (1,0) [0|0] "" TOOL
 SG_ S02_HVESPG_SOH_SUP m190 : 38|1@1+ (1,0) [0|0] "" TOOL
 SG_ S02_HVESPH_SOH_SUP m190 : 39|1@1+ (1,0) [0|0] "" TOOL
 SG_ S02_HVESS_SOH m190 : 40|8@1+ (0.4,0) [0|0] "%" TOOL
 SG_ S02_HVESPA_SOH m190 : 48|8@1+ (0.4,0) [0|0] "%" TOOL
 SG_ S02_HVESPB_SOH m190 : 56|8@1+ (0.4,0) [0|0] "%" TOOL
 SG_ S02_HVESPC_SOH m190 : 64|8@1+ (0.4,0) [0|0] "%" TOOL
 SG_ S02_HVESPD_SOH m190 : 72|8@1+ (0.4,0) [0|0] "%" TOOL
 SG_ S02_HVESPE_SOH m190 : 80|8@1+ (0.4,0) [0|0] "%" TOOL
 SG_ S02_HVESPF_SOH m190 : 88|8@1+ (0.4,0) [0|0] "%" TOOL
 SG_ S02_HVESPG_SOH m190 : 96|8@1+ (0.4,0) [0|0] "%" TOOL
 SG_ S02_HVESPH_SOH m190 : 104|8@1+ (0.4,0) [0|0] "%" TOOL
 SG_ S02_HVESPA_MIN_SOC_SUP m191 : 32|1@1+ (1,0) [0|0] "" TOOL
 SG_ S02_HVESPB_MIN_SOC_SUP m191 : 33|1@1+ (1,0) [0|0] "" TOOL
 SG_ S02_HVESPC_MIN_SOC_SUP m191 : 34|1@1+ (1,0) [0|0] "" TOOL
 SG_ S02_HVESPD_MIN_SOC_SUP m191 : 35|1@1+ (1,0) [0|0] "" TOOL
 SG_ S02_HVESPE_MIN_SOC_SUP m191 : 36|1@1+ (1,0) [0|0] "" TOOL
 SG_ S02_HVESPF_MIN_SOC_SUP m191 : 37|1@1+ (1,0) [0|0] "" TOOL
 SG_ S02_HVESPG_MIN_SOC_SUP m191 : 38|1@1+ (1,0) [0|0] "" TOOL
 SG_ S02_HVESPH_MIN_SOC_SUP m191 : 39|1@1+ (1,0) [0|0] "" TOOL
 SG_ S02_HVESS_MIN_SOC m191 : 47|16@0+ (0.0015625,0) [0|0] "%" TOOL
 SG_ S02_HVESPA_MIN_SOC m191 : 63|16@0+ (0.0015625,0) [0|0] "%" TOOL
 SG_ S02_HVESPB_MIN_SOC m191 : 79|16@0+ (0.0015625,0) [0|0] "%" TOOL
 SG_ S02_HVESPC_MIN_SOC m191 : 95|16@0+ (0.0015625,0) [0|0] "%" TOOL
 SG_ S02_HVESPD_MIN_SOC m191 : 111|16@0+ (0.0015625,0) [0|0] "%" TOOL
 SG_ S02_HVESPE_MIN_SOC m191 : 127|16@0+ (0.0015625,0) [0|0] "%" TOOL
 SG_ S02_HVESPF_MIN_SOC m191 : 143|16@0+ (0.0015625,0) [0|0] "%" TOOL
 SG_ S02_HVESPG_MIN_SOC m191 : 159|16@0+ (0.0015625,0) [0|0] "%" TOOL
 SG_ S02_HVESPH_MIN_SOC m191 : 175|16@0+ (0.0015625,0) [0|0] "%" TOOL
 SG_ S02_HVESPA_MAX_SOC_SUP m193 : 32|1@1+ (1,0) [0|0] "" TOOL
 SG_ S02_HVESPB_MAX_SOC_SUP m193 : 33|1@1+ (1,0) [0|0] "" TOOL
 SG_ S02_HVESPC_MAX_SOC_SUP m193 : 34|1@1+ (1,0) [0|0] "" TOOL
 SG_ S02_HVESPD_MAX_SOC_SUP m193 : 35|1@1+ (1,0) [0|0] "" TOOL
 SG_ S02_HVESPE_MAX_SOC_SUP m193 : 36|1@1+ (1,0) [0|0] "" TOOL
 SG_ S02_HVESPF_MAX_SOC_SUP m193 : 37|1@1+ (1,0) [0|0] "" TOOL
 SG_ S02_HVESPG_MAX_SOC_SUP m193 : 38|1@1+ (1,0) [0|0] "" TOOL
 SG_ S02_HVESPH_MAX_SOC_SUP m193 : 39|1@1+ (1,0) [0|0] "" TOOL
 SG_ S02_HVESS_MAX_SOC m193 : 47|16@0+ (0.0015625,0) [0|0] "%" TOOL
 SG_ S02_HVESPA_MAX_SOC m193 : 63|16@0+ (0.0015625,0) [0|0] "%" TOOL
 SG_ S02_HVESPB_MAX_SOC m193 : 79|16@0+ (0.0015625,0) [0|0] "%" TOOL
 SG_ S02_HVESPC_MAX_SOC m193 : 95|16@0+ (0.0015625,0) [0|0] "%" TOOL
 SG_ S02_HVESPD_MAX_SOC m193 : 111|16@0+ (0.0015625,0) [0|0] "%" TOOL
 SG_ S02_HVESPE_MAX_SOC m193 : 127|16@0+ (0.0015625,0) [0|0] "%" TOOL
 SG_ S02_HVESPF_MAX_SOC m193 : 143|16@0+ (0.0015625,0) [0|0] "%" TOOL
 SG_ S02_HVESPG_MAX_SOC m193 : 159|16@0+ (0.0015625,0) [0|0] "%" TOOL
 SG_ S02_HVESPH_MAX_SOC m193 : 175|16@0+ (0.0015625,0) [0|0] "%" TOOL
 SG_ S02_HVESPA_DEnrg_CAP_SUP m194 : 32|1@1+ (1,0) [0|0] "" TOOL
 SG_ S02_HVESPB_DEnrg_CAP_SUP m194 : 33|1@1+ (1,0) [0|0] "" TOOL
 SG_ S02_HVESPC_DEnrg_CAP_SUP m194 : 34|1@1+ (1,0) [0|0] "" TOOL
 SG_ S02_HVESPD_DEnrg_CAP_SUP m194 : 35|1@1+ (1,0) [0|0] "" TOOL
 SG_ S02_HVESPE_DEnrg_CAP_SUP m194 : 36|1@1+ (1,0) [0|0] "" TOOL
 SG_ S02_HVESPF_DEnrg_CAP_SUP m194 : 37|1@1+ (1,0) [0|0] "" TOOL
 SG_ S02_HVESPG_DEnrg_CAP_SUP m194 : 38|1@1+ (1,0) [0|0] "" TOOL
 SG_ S02_HVESPH_DEnrg_CAP_SUP m194 : 39|1@1+ (1,0) [0|0] "" TOOL
 SG_ S02_HVESS_DEnrg_CAP m194 : 47|24@0+ (0.001,0) [0|0] "kWh" TOOL
 SG_ S02_HVESPA_DEnrg_CAP m194 : 71|24@0+ (0.001,0) [0|0] "kWh" TOOL
 SG_ S02_HVESPB_DEnrg_CAP m194 : 95|24@0+ (0.001,0) [0|0] "kWh" TOOL
 SG_ S02_HVESPC_DEnrg_CAP m194 : 119|24@0+ (0.001,0) [0|0] "kWh" TOOL
 SG_ S02_HVESPD_DEnrg_CAP m194 : 143|24@0+ (0.001,0) [0|0] "kWh" TOOL
 SG_ S02_HVESPE_DEnrg_CAP m194 : 167|24@0+ (0.001,0) [0|0] "kWh" TOOL
 SG_ S02_HVESPF_DEnrg_CAP m194 : 191|24@0+ (0.001,0) [0|0] "kWh" TOOL
 SG_ S02_HVESPG_DEnrg_CAP m194 : 215|24@0+ (0.001,0) [0|0] "kWh" TOOL
 SG_ S02_HVESPH_DEnrg_CAP m194 : 239|24@0+ (0.001,0) [0|0] "kWh" TOOL
 SG_ S02_FLI_A_SUP m195 : 32|1@1+ (1,0) [0|0] "" TOOL
 SG_ S02_FLI_B_SUP m195 : 33|1@1+ (1,0) [0|0] "" TOOL
 SG_ S02_FLI_A m195 : 40|8@1+ (1,0) [0|0] "" TOOL
 SG_ S02_FLI_B m195 : 48|8@1+ (1,0) [0|0] "" TOOL
 SG_ S02_EXH_PM_TIME m196 : 39|32@0+ (1,0) [0|0] "sec" TOOL
 SG_ S02_EXH_PM_OCC_CNT m196 : 71|32@0+ (1,0) [0|0] "count" TOOL
 SG_ S02_LFP_A_SUP m197 : 32|1@1+ (1,0) [0|0] "" TOOL
 SG_ S02_LFP_B_SUP m197 : 33|1@1+ (1,0) [0|0] "" TOOL
 SG_ S02_LFP_A m197 : 47|16@0+ (1,0) [0|0] "" TOOL
 SG_ S02_LFP_B m197 : 63|16@0+ (1,0) [0|0] "" TOOL
 SG_ S02_PM_WARN_ACT_SUP m198 : 32|1@1+ (1,0) [0|0] "" TOOL
 SG_ S02_DPF_REMOVAL_BLOCKED_TIME_SUP m198 : 33|1@1+ (1,0) [0|0] "" TOOL
 SG_ S02_LRIS_FAILURE_TIME_SUP m198 : 34|1@1+ (1,0) [0|0] "" TOOL
 SG_ S02_PCD_FAILURE_TIME_SUP m198 : 35|1@1+ (1,0) [0|0] "" TOOL
 SG_ S02_PM_WARN_ACT m198 : 40|1@1+ (1,0) [0|0] "" TOOL
 SG_ S02_PCL_INDUC_L1 m198 : 41|2@1+ (1,0) [0|0] "" TOOL
 SG_ S02_PCL_INDUC_L2 m198 : 43|2@1+ (1,0) [0|0] "" TOOL
 SG_ S02_PCL_INDUC_L3 m198 : 45|2@1+ (1,0) [0|0] "" TOOL
 SG_ S02_DPF_REMOVAL_BLOCKED_TIME m198 : 55|16@0+ (1,0) [0|0] "h" TOOL
 SG_ S02_LRIS_FAILURE_TIME m198 : 71|16@0+ (1,0) [0|0] "h" TOOL
 SG_ S02_PCD_FAILURE_TIME m198 : 87|16@0+ (1,0) [0|0] "h" TOOL
 SG_ S02_REFLASH_DIST m199 : 39|16@0+ (1,0) [0|0] "km" TOOL
 SG_ S02_NCD_PCD_WL m200 : 32|2@1+ (1,0) [0|0] "" TOOL
 SG_ S02_NCD_WL m200 : 34|2@1+ (1,0) [0|0] "" TOOL
 SG_ S02_PCD_WL m200 : 36|2@1+ (1,0) [0|0] "" TOOL
 SG_ S02_O2S15_PCT_SUP m201 : 32|1@1+ (1,0) [0|0] "" TOOL
 SG_ S02_O2S16_PCT_SUP m201 : 33|1@1+ (1,0) [0|0] "" TOOL
 SG_ S02_O2S25_PCT_SUP m201 : 34|1@1+ (1,0) [0|0] "" TOOL
 SG_ S02_O2S26_PCT_SUP m201 : 35|1@1+ (1,0) [0|0] "" TOOL
 SG_ S02_O2S15_PCT_LAMBDA_SUP m201 : 36|1@1+ (1,0) [0|0] "" TOOL
 SG_ S02_O2S16_PCT_LAMBDA_SUP m201 : 37|1@1+ (1,0) [0|0] "" TOOL
 SG_ S02_O2S25_PCT_LAMBDA_SUP m201 : 38|1@1+ (1,0) [0|0] "" TOOL
 SG_ S02_O2S26_PCT_LAMBDA_SUP m201 : 39|1@1+ (1,0) [0|0] "" TOOL
 SG_ S02_O2S15_PCT m201 : 47|16@0+ (0.001526,0) [0|0] "%" TOOL
 SG_ S02_O2S16_PCT m201 : 63|16@0+ (0.001526,0) [0|0] "%" TOOL
 SG_ S02_O2S25_PCT m201 : 79|16@0+ (0.001526,0) [0|0] "%" TOOL
 SG_ S02_O2S26_PCT m201 : 95|16@0+ (0.001526,0) [0|0] "%" TOOL
 SG_ S02_O2S15_PCT_LAMBDA m201 : 111|16@0+ (0.000122,0) [0|0] "lambda" TOOL
 SG_ S02_O2S16_PCT_LAMBDA m201 : 127|16@0+ (0.000122,0) [0|0] "lambda" TOOL
 SG_ S02_O2S25_PCT_LAMBDA m201 : 143|16@0+ (0.000122,0) [0|0] "lambda" TOOL
 SG_ S02_O2S26_PCT_LAMBDA m201 : 159|16@0+ (0.000122,0) [0|0] "lambda" TOOL
 SG_ S02_TIME_TO_INDUC_L1_SUP m202 : 32|1@1+ (1,0) [0|0] "" TOOL
 SG_ S02_TIME_TO_INDUC_L2_SUP m202 : 33|1@1+ (1,0) [0|0] "" TOOL
 SG_ S02_TIME_TO_INDUC_L3_SUP m202 : 34|1@1+ (1,0) [0|0] "" TOOL
 SG_ S02_TIME_TO_INDUC_L1 m202 : 47|16@0+ (1,0) [0|0] "min" TOOL
 SG_ S02_TIME_TO_INDUC_L2 m202 : 63|16@0+ (1,0) [0|0] "min" TOOL
 SG_ S02_TIME_TO_INDUC_L3 m202 : 79|16@0+ (1,0) [0|0] "min" TOOL
 SG_ S02_EP_12_SUP m203 : 32|1@1+ (1,0) [0|0] "" TOOL
 SG_ S02_EP_22_SUP m203 : 33|1@1+ (1,0) [0|0] "" TOOL
 SG_ S02_EP_12 m203 : 47|16@1+ (0.01,0) [0|0] "kPa" TOOL
 SG_ S02_EP_22 m203 : 63|16@1+ (0.01,0) [0|0] "kPa" TOOL
 SG_ S02_EM_A_RPM_SUP m204 : 32|1@1+ (1,0) [0|0] "" TOOL
 SG_ S02_EM_B_RPM_SUP m204 : 33|1@1+ (1,0) [0|0] "" TOOL
 SG_ S02_EM_C_RPM_SUP m204 : 34|1@1+ (1,0) [0|0] "" TOOL
 SG_ S02_EM_D_RPM_SUP m204 : 35|1@1+ (1,0) [0|0] "" TOOL
 SG_ S02_EM_E_RPM_SUP m204 : 36|1@1+ (1,0) [0|0] "" TOOL
 SG_ S02_EM_F_RPM_SUP m204 : 37|1@1+ (1,0) [0|0] "" TOOL
 SG_ S02_EM_G_RPM_SUP m204 : 38|1@1+ (1,0) [0|0] "" TOOL
 SG_ S02_EM_H_RPM_SUP m204 : 39|1@1+ (1,0) [0|0] "" TOOL
 SG_ S02_EM_A_RPM m204 : 47|16@0+ (1,0) [0|0] "rpm" TOOL
 SG_ S02_EM_B_RPM m204 : 63|16@0+ (1,0) [0|0] "rpm" TOOL
 SG_ S02_EM_C_RPM m204 : 79|16@0+ (1,0) [0|0] "rpm" TOOL
 SG_ S02_EM_D_RPM m204 : 95|16@0+ (1,0) [0|0] "rpm" TOOL
 SG_ S02_EM_E_RPM m204 : 111|16@0+ (1,0) [0|0] "rpm" TOOL
 SG_ S02_EM_F_RPM m204 : 127|16@0+ (1,0) [0|0] "rpm" TOOL
 SG_ S02_EM_G_RPM m204 : 143|16@0+ (1,0) [0|0] "rpm" TOOL
 SG_ S02_EM_H_RPM m204 : 159|16@0+ (1,0) [0|0] "rpm" TOOL
 SG_ S02_EM_A_TQ_SUP m205 : 32|1@1+ (1,0) [0|0] "" TOOL
 SG_ S02_EM_B_TQ_SUP m205 : 33|1@1+ (1,0) [0|0] "" TOOL
 SG_ S02_EM_C_TQ_SUP m205 : 34|1@1+ (1,0) [0|0] "" TOOL
 SG_ S02_EM_D_TQ_SUP m205 : 35|1@1+ (1,0) [0|0] "" TOOL
 SG_ S02_EM_E_TQ_SUP m205 : 36|1@1+ (1,0) [0|0] "" TOOL
 SG_ S02_EM_F_TQ_SUP m205 : 37|1@1+ (1,0) [0|0] "" TOOL
 SG_ S02_EM_G_TQ_SUP m205 : 38|1@1+ (1,0) [0|0] "" TOOL
 SG_ S02_EM_H_TQ_SUP m205 : 39|1@1+ (1,0) [0|0] "" TOOL
 SG_ S02_EM_A_TQ m205 : 47|16@0+ (1,0) [0|0] "Nm" TOOL
 SG_ S02_EM_B_TQ m205 : 63|16@0+ (1,0) [0|0] "Nm" TOOL
 SG_ S02_EM_C_TQ m205 : 79|16@0+ (1,0) [0|0] "Nm" TOOL
 SG_ S02_EM_D_TQ m205 : 95|16@0+ (1,0) [0|0] "Nm" TOOL
 SG_ S02_EM_E_TQ m205 : 111|16@0+ (1,0) [0|0] "Nm" TOOL
 SG_ S02_EM_F_TQ m205 : 127|16@0+ (1,0) [0|0] "Nm" TOOL
 SG_ S02_EM_G_TQ m205 : 143|16@0+ (1,0) [0|0] "Nm" TOOL
 SG_ S02_EM_H_TQ m205 : 159|16@0+ (1,0) [0|0] "Nm" TOOL
 SG_ DTCNUM m3 : 16|8@1+ (1,0) [0|0] "" TOOL
 SG_ DTC0_TYPE m3 : 31|2@0+ (1,0) [0|0] "" TOOL
 SG_ DTC0_VAL m3 : 29|14@0+ (1,0) [0|0] "" TOOL
 SG_ DTC1_TYPE m3 : 47|2@0+ (1,0) [0|0] "" TOOL
 SG_ DTC1_VAL m3 : 45|14@0+ (1,0) [0|0] "" TOOL
 SG_ DTC2_TYPE m3 : 63|2@0+ (1,0) [0|0] "" TOOL
 SG_ DTC2_VAL m3 : 61|14@0+ (1,0) [0|0] "" TOOL
 SG_ DTC3_TYPE m3 : 79|2@0+ (1,0) [0|0] "" TOOL
 SG_ DTC3_VAL m3 : 77|14@0+ (1,0) [0|0] "" TOOL
 SG_ DTC4_TYPE m3 : 95|2@0+ (1,0) [0|0] "" TOOL
 SG_ DTC4_VAL m3 : 93|14@0+ (1,0) [0|0] "" TOOL
 SG_ DTC5_TYPE m3 : 111|2@0+ (1,0) [0|0] "" TOOL
 SG_ DTC5_VAL m3 : 109|14@0+ (1,0) [0|0] "" TOOL
 SG_ DTC6_TYPE m3 : 127|2@0+ (1,0) [0|0] "" TOOL
 SG_ DTC6_VAL m3 : 125|14@0+ (1,0) [0|0] "" TOOL
 SG_ DTC7_TYPE m3 : 143|2@0+ (1,0) [0|0] "" TOOL
 SG_ DTC7_VAL m3 : 141|14@0+ (1,0) [0|0] "" TOOL
 SG_ DTC8_TYPE m3 : 159|2@0+ (1,0) [0|0] "" TOOL
 SG_ DTC8_VAL m3 : 157|14@0+ (1,0) [0|0] "" TOOL
 SG_ DTC9_TYPE m3 : 175|2@0+ (1,0) [0|0] "" TOOL
 SG_ DTC9_VAL m3 : 173|14@0+ (1,0) [0|0] "" TOOL
 SG_ DTC10_TYPE m3 : 191|2@0+ (1,0) [0|0] "" TOOL
 SG_ DTC10_VAL m3 : 189|14@0+ (1,0) [0|0] "" TOOL
 SG_ DTC11_TYPE m3 : 207|2@0+ (1,0) [0|0] "" TOOL
 SG_ DTC11_VAL m3 : 205|14@0+ (1,0) [0|0] "" TOOL
 SG_ DTC12_TYPE m3 : 223|2@0+ (1,0) [0|0] "" TOOL
 SG_ DTC12_VAL m3 : 221|14@0+ (1,0) [0|0] "" TOOL
 SG_ DTC13_TYPE m3 : 239|2@0+ (1,0) [0|0] "" TOOL
 SG_ DTC13_VAL m3 : 237|14@0+ (1,0) [0|0] "" TOOL
 SG_ DTC14_TYPE m3 : 255|2@0+ (1,0) [0|0] "" TOOL
 SG_ DTC14_VAL m3 : 253|14@0+ (1,0) [0|0] "" TOOL
 SG_ DTC15_TYPE m3 : 271|2@0+ (1,0) [0|0] "" TOOL
 SG_ DTC15_VAL m3 : 269|14@0+ (1,0) [0|0] "" TOOL
 SG_ DTC16_TYPE m3 : 287|2@0+ (1,0) [0|0] "" TOOL
 SG_ DTC16_VAL m3 : 285|14@0+ (1,0) [0|0] "" TOOL
 SG_ DTC17_TYPE m3 : 303|2@0+ (1,0) [0|0] "" TOOL
 SG_ DTC17_VAL m3 : 301|14@0+ (1,0) [0|0] "" TOOL
 SG_ DTC18_TYPE m3 : 319|2@0+ (1,0) [0|0] "" TOOL
 SG_ DTC18_VAL m3 : 317|14@0+ (1,0) [0|0] "" TOOL
 SG_ DTC19_TYPE m3 : 335|2@0+ (1,0) [0|0] "" TOOL
 SG_ DTC19_VAL m3 : 333|14@0+ (1,0) [0|0] "" TOOL
 SG_ DTC20_TYPE m3 : 351|2@0+ (1,0) [0|0] "" TOOL
 SG_ DTC20_VAL m3 : 349|14@0+ (1,0) [0|0] "" TOOL
 SG_ DTC21_TYPE m3 : 367|2@0+ (1,0) [0|0] "" TOOL
 SG_ DTC21_VAL m3 : 365|14@0+ (1,0) [0|0] "" TOOL
 SG_ DTC22_TYPE m3 : 383|2@0+ (1,0) [0|0] "" TOOL
 SG_ DTC22_VAL m3 : 381|14@0+ (1,0) [0|0] "" TOOL
 SG_ DTC23_TYPE m3 : 399|2@0+ (1,0) [0|0] "" TOOL
 SG_ DTC23_VAL m3 : 397|14@0+ (1,0) [0|0] "" TOOL
 SG_ DTC24_TYPE m3 : 415|2@0+ (1,0) [0|0] "" TOOL
 SG_ DTC24_VAL m3 : 413|14@0+ (1,0) [0|0] "" TOOL
 SG_ DTC25_TYPE m3 : 431|2@0+ (1,0) [0|0] "" TOOL
 SG_ DTC25_VAL m3 : 429|14@0+ (1,0) [0|0] "" TOOL
 SG_ DTC26_TYPE m3 : 447|2@0+ (1,0) [0|0] "" TOOL
 SG_ DTC26_VAL m3 : 445|14@0+ (1,0) [0|0] "" TOOL
 SG_ DTC27_TYPE m3 : 463|2@0+ (1,0) [0|0] "" TOOL
 SG_ DTC27_VAL m3 : 461|14@0+ (1,0) [0|0] "" TOOL
 SG_ DTC28_TYPE m3 : 479|2@0+ (1,0) [0|0] "" TOOL
 SG_ DTC28_VAL m3 : 477|14@0+ (1,0) [0|0] "" TOOL
 SG_ DTC29_TYPE m3 : 495|2@0+ (1,0) [0|0] "" TOOL
 SG_ DTC29_VAL m3 : 493|14@0+ (1,0) [0|0] "" TOOL
 SG_ MC_VIN m1 : 32|8@1+ (1,0) [0|0] "" TOOL
 SG_ VIN m2 : 32|136@1+ (1,0) [0|0] "" TOOL
 SG_ MC_CALID m3 : 32|8@1+ (1,0) [0|0] "" TOOL
 SG_ CALID m4 : 32|128@1+ (1,0) [0|0] "" TOOL
 SG_ MC_CVN m5 : 32|8@1+ (1,0) [0|0] "" TOOL
 SG_ CVN m6 : 32|32@1+ (1,0) [0|0] "" TOOL
 SG_ MC_IPT m7 : 32|8@1+ (1,0) [0|0] "" TOOL
 SG_ IPT_OBDCOND m8 : 39|16@0+ (1,0) [0|0] "" TOOL
 SG_ IPT_IGNCNTR m8 : 55|16@0+ (1,0) [0|0] "" TOOL
 SG_ IPT_CATCOMP1 m8 : 71|16@0+ (1,0) [0|0] "" TOOL
 SG_ IPT_CATCOND1 m8 : 87|16@0+ (1,0) [0|0] "" TOOL
 SG_ IPT_CATCOMP2 m8 : 103|16@0+ (1,0) [0|0] "" TOOL
 SG_ IPT_CATCOND2 m8 : 119|16@0+ (1,0) [0|0] "" TOOL
 SG_ IPT_O2SCOMP1 m8 : 135|16@0+ (1,0) [0|0] "" TOOL
 SG_ IPT_O2SCOND1 m8 : 151|16@0+ (1,0) [0|0] "" TOOL
 SG_ IPT_O2SCOMP2 m8 : 167|16@0+ (1,0) [0|0] "" TOOL
 SG_ IPT_O2SCOND2 m8 : 183|16@0+ (1,0) [0|0] "" TOOL
 SG_ IPT_EGRCOMP m8 : 199|16@0+ (1,0) [0|0] "" TOOL
 SG_ IPT_EGRCOND m8 : 215|16@0+ (1,0) [0|0] "" TOOL
 SG_ IPT_AIRCOMP m8 : 231|16@0+ (1,0) [0|0] "" TOOL
 SG_ IPT_AIRCOND m8 : 247|16@0+ (1,0) [0|0] "" TOOL
 SG_ IPT_EVAPCOMP m8 : 263|16@0+ (1,0) [0|0] "" TOOL
 SG_ IPT_EVAPCOND m8 : 279|16@0+ (1,0) [0|0] "" TOOL
 SG_ IPT_SO2SCOMP1 m8 : 295|16@0+ (1,0) [0|0] "" TOOL
 SG_ IPT_SO2SCOND1 m8 : 311|16@0+ (1,0) [0|0] "" TOOL
 SG_ IPT_SO2SCOMP2 m8 : 327|16@0+ (1,0) [0|0] "" TOOL
 SG_ IPT_SO2SCOND2 m8 : 343|16@0+ (1,0) [0|0] "" TOOL
 SG_ IPT_AFRICOMP1 m8 : 359|16@0+ (1,0) [0|0] "" TOOL
 SG_ IPT_AFRICOND1 m8 : 375|16@0+ (1,0) [0|0] "" TOOL
 SG_ IPT_AFRICOMP2 m8 : 391|16@0+ (1,0) [0|0] "" TOOL
 SG_ IPT_AFRICOND2 m8 : 407|16@0+ (1,0) [0|0] "" TOOL
 SG_ IPT_PFCOMP1 m8 : 423|16@0+ (1,0) [0|0] "" TOOL
 SG_ IPT_PFCOND1 m8 : 439|16@0+ (1,0) [0|0] "" TOOL
 SG_ IPT_PFCOMP2 m8 : 455|16@0+ (1,0) [0|0] "" TOOL
 SG_ IPT_PFCOND2 m8 : 471|16@0+ (1,0) [0|0] "" TOOL

SG_MUL_VAL_ 2024 S02_LONGFT3 S02_PID 7-7;
SG_MUL_VAL_ 2024 S02_SHRTFT2 S02_PID 8-8;
SG_MUL_VAL_ 2024 S02_SHRTFT4 S02_PID 8-8;
SG_MUL_VAL_ 2024 S02_LONGFT2 S02_PID 9-9;
SG_MUL_VAL_ 2024 S02_LONGFT4 S02_PID 9-9;
SG_MUL_VAL_ 2024 S02_FPGAUGE S02_PID 10-10;
SG_MUL_VAL_ 2024 S02_MAP S02_PID 11-11;
SG_MUL_VAL_ 2024 S02_RPM S02_PID 12-12;
SG_MUL_VAL_ 2024 S02_VSS S02_PID 13-13;
SG_MUL_VAL_ 2024 S02_SPARKADV S02_PID 14-14;
SG_MUL_VAL_ 2024 S02_IAT S02_PID 15-15;
SG_MUL_VAL_ 2024 S02_MAF S02_PID 16-16;
SG_MUL_VAL_ 2024 S02_TP S02_PID 17-17;
SG_MUL_VAL_ 2024 S02_AIR_STAT_UPS S02_PID 18-18;
SG_MUL_VAL_ 2024 S02_AIR_STAT_DNS S02_PID 18-18;
SG_MUL_VAL_ 2024 S02_AIR_STAT_OFF S02_PID 18-18;
SG_MUL_VAL_ 2024 S02_AIR_STAT_DIAG S02_PID 18-18;
SG_MUL_VAL_ 2024 S02_O2SLOC_A1 S02_PID 19-19;
SG_MUL_VAL_ 2024 S02_O2SLOC_A2 S02_PID 19-19;
SG_MUL_VAL_ 2024 S02_O2SLOC_A3 S02_PID 19-19;
SG_MUL_VAL_ 2024 S02_O2SLOC_A4 S02_PID 19-19;
SG_MUL_VAL_ 2024 S02_O2SLOC_A5 S02_PID 19-19;
SG_MUL_VAL_ 2024 S02_O2SLOC_A6 S02_PID 19-19;
SG_MUL_VAL_ 2024 S02_O2SLOC_A7 S02_PID 19-19;
SG_MUL_VAL_ 2024 S02_O2SLOC_A8 S02_PID 19-19;
SG_MUL_VAL_ 2024 S02_O2S1 S02_PID 20-20;
SG_MUL_VAL_ 2024 S02_SHRTFT11 S02_PID 20-20;
SG_MUL_VAL_ 2024 S02_O2S2 S02_PID 21-21;
SG_MUL_VAL_ 2024 S02_SHRTFT12 S02_PID 21-21;
SG_MUL_VAL_ 2024 S02_O2S3 S02_PID 22-22;
SG_MUL_VAL_ 2024 S02_SHRTFT13 S02_PID 22-22;
SG_MUL_VAL_ 2024 S02_O2S4 S02_PID 23-23;
SG_MUL_VAL_ 2024 S02_SHRTFT14 S02_PID 23-23;
SG_MUL_VAL_ 2024 S02_O2S5 S02_PID 24-24;
SG_MUL_VAL_ 2024 S02_SHRTFT15 S02_PID 24-24;
SG_MUL_VAL_ 2024 S02_O2S6 S02_PID 25-25;
SG_MUL_VAL_ 2024 S02_SHRTFT16 S02_PID 25-25;
SG_MUL_VAL_ 2024 S02_O2S7 S02_PID 26-26;
SG_MUL_VAL_ 2024 S02_SHRTFT17 S02_PID 26-26;
SG_MUL_VAL_ 2024 S02_O2S8 S02_PID 27-27;
SG_MUL_VAL_ 2024 S02_SHRTFT8 S02_PID 27-27;
SG_MUL_VAL_ 2024 S02_OBDSUP S02_PID 28-28;
SG_MUL_VAL_ 2024 S02_O2SLOC_B1 S02_PID 29-29;
SG_MUL_VAL_ 2024 S02_O2SLOC_B2 S02_PID 29-29;
SG_MUL_VAL_ 2024 S02_O2SLOC_B3 S02_PID 29-29;
SG_MUL_VAL_ 2024 S02_O2SLOC_B4 S02_PID 29-29;
SG_MUL_VAL_ 2024 S02_O2SLOC_B5 S02_PID 29-29;
SG_MUL_VAL_ 2024 S02_O2SLOC_B6 S02_PID 29-29;
SG_MUL_VAL_ 2024 S02_O2SLOC_B7 S02_PID 29-29;
SG_MUL_VAL_ 2024 S02_O2SLOC_B8 S02_PID 29-29;
SG_MUL_VAL_ 2024 S02_PTO_STAT S02_PID 30-30;
SG_MUL_VAL_ 2024 S02_RUNTM S02_PID 31-31;
SG_MUL_VAL_ 2024 S02_MIL_DIST S02_PID 33-33;
SG_MUL_VAL_ 2024 S02_FP S02_PID 34-34;
SG_MUL_VAL_ 2024 S02_FRP S02_PID 35-35;
SG_MUL_VAL_ 2024 S02_LAMBDA_WRV1 S02_PID 36-36;
SG_MUL_VAL_ 2024 S02_O2S_WRV1 S02_PID 36-36;
SG_MUL_VAL_ 2024 S02_LAMBDA_WRV2 S02_PID 37-37;
SG_MUL_VAL_ 2024 S02_O2S_WRV2 S02_PID 37-37;
SG_MUL_VAL_ 2024 S02_LAMBDA_WRV3 S02_PID 38-38;
SG_MUL_VAL_ 2024 S02_O2S_WRV3 S02_PID 38-38;
SG_MUL_VAL_ 2024 S02_LAMBDA_WRV4 S02_PID 39-39;
SG_MUL_VAL_ 2024 S02_O2S_WRV4 S02_PID 39-39;
SG_MUL_VAL_ 2024 S02_LAMBDA_WRV5 S02_PID 40-40;
SG_MUL_VAL_ 2024 S02_O2S_WRV5 S02_PID 40-40;
SG_MUL_VAL_ 2024 S02_LAMBDA_WRV6 S02_PID 41-41;
SG_MUL_VAL_ 2024 S02_O2S_WRV6 S02_PID 41-41;
SG_MUL_VAL_ 2024 S02_LAMBDA_WRV7 S02_PID 42-42;
SG_MUL_VAL_ 2024 S02_O2S_WRV7 S02_PID 42-42;
SG_MUL_VAL_ 2024 S02_LAMBDA_WRV8 S02_PID 43-43;
SG_MUL_VAL_ 2024 S02_O2S_WRV8 S02_PID 43-43;
SG_MUL_VAL_ 2024 S02_EGR_PCT S02_PID 44-44;
SG_MUL_VAL_ 2024 S02_EGR_ERR S02_PID 45-45;
SG_MUL_VAL_ 2024 S02_EVAP_PCT S02_PID 46-46;
SG_MUL_VAL_ 2024 S02_FLI S02_PID 47-47;
SG_MUL_VAL_ 2024 S02_WARM_UPS S02_PID 48-48;
SG_MUL_VAL_ 2024 S02_CLR_DIST S02_PID 49-49;
SG_MUL_VAL_ 2024 S02_EVAP_VP S02_PID 50-50;
SG_MUL_VAL_ 2024 S02_BARO S02_PID 51-51;
SG_MUL_VAL_ 2024 S02_LAMBDA_WRC1 S02_PID 52-52;
SG_MUL_VAL_ 2024 S02_O2S_WRC1 S02_PID 52-52;
SG_MUL_VAL_ 2024 S02_LAMBDA_WRC2 S02_PID 53-53;
SG_MUL_VAL_ 2024 S02_O2S_WRC2 S02_PID 53-53;
SG_MUL_VAL_ 2024 S02_LAMBDA_WRC3 S02_PID 54-54;
SG_MUL_VAL_ 2024 S02_O2S_WRC3 S02_PID 54-54;
SG_MUL_VAL_ 2024 S02_LAMBDA_WRC4 S02_PID 55-55;
SG_MUL_VAL_ 2024 S02_O2S_WRC4 S02_PID 55-55;
SG_MUL_VAL_ 2024 S02_LAMBDA_WRC5 S02_PID 56-56;
SG_MUL_VAL_ 2024 S02_O2S_WRC5 S02_PID 56-56;
SG_MUL_VAL_ 2024 S02_LAMBDA_WRC6 S02_PID 57-57;
SG_MUL_VAL_ 2024 S02_O2S_WRC6 S02_PID 57-57;
SG_MUL_VAL_ 2024 S02_LAMBDA_WRC7 S02_PID 58-58;
SG_MUL_VAL_ 2024 S02_O2S_WRC7 S02_PID 58-58;
SG_MUL_VAL_ 2024 S02_LAMBDA_WRC8 S02_PID 59-59;
SG_MUL_VAL_ 2024 S02_O2S_WRC8 S02_PID 59-59;
SG_MUL_VAL_ 2024 S02_CATEMP11 S02_PID 60-60;
SG_MUL_VAL_ 2024 S02_CATEMP21 S02_PID 61-61;
SG_MUL_VAL_ 2024 S02_CATEMP12 S02_PID 62-62;
SG_MUL_VAL_ 2024 S02_CATEMP22 S02_PID 63-63;
SG_MUL_VAL_ 2024 S02_MIS_ENA S02_PID 65-65;
SG_MUL_VAL_ 2024 S02_FUEL_ENA S02_PID 65-65;
SG_MUL_VAL_ 2024 S02_CCM_ENA S02_PID 65-65;
SG_MUL_VAL_ 2024 S02_PID41_CIM_SUP S02_PID 65-65;
SG_MUL_VAL_ 2024 S02_MIS_CMPL S02_PID 65-65;
SG_MUL_VAL_ 2024 S02_FUELCMPL S02_PID 65-65;
SG_MUL_VAL_ 2024 S02_CCM_CMPL S02_PID 65-65;
SG_MUL_VAL_ 2024 S02_CAT_ENA S02_PID41_CIM_SUP 0-0;
SG_MUL_VAL_ 2024 S02_HCAT_ENA S02_PID41_CIM_SUP 0-0;
SG_MUL_VAL_ 2024 S02_EVAP_ENA S02_PID41_CIM_SUP 0-0;
SG_MUL_VAL_ 2024 S02_AIR_ENA S02_PID41_CIM_SUP 0-0;
SG_MUL_VAL_ 2024 S02_GPF_ENA S02_PID41_CIM_SUP 0-0;
SG_MUL_VAL_ 2024 S02_O2S_ENA S02_PID41_CIM_SUP 0-0;
SG_MUL_VAL_ 2024 S02_HTR_ENA S02_PID41_CIM_SUP 0-0;
SG_MUL_VAL_ 2024 S02_EGR_ENA S02_PID41_CIM_SUP 0-0;
SG_MUL_VAL_ 2024 S02_CAT_CMPL S02_PID41_CIM_SUP 0-0;
SG_MUL_VAL_ 2024 S02_HCATCMPL S02_PID41_CIM_SUP 0-0;
SG_MUL_VAL_ 2024 S02_EVAPCMPL S02_PID41_CIM_SUP 0-0;
SG_MUL_VAL_ 2024 S02_AIR_CMPL S02_PID41_CIM_SUP 0-0;
SG_MUL_VAL_ 2024 S02_GPF_CMPL S02_PID41_CIM_SUP 0-0;
SG_MUL_VAL_ 2024 S02_O2S_CMPL S02_PID41_CIM_SUP 0-0;
SG_MUL_VAL_ 2024 S02_HTR_CMPL S02_PID41_CIM_SUP 0-0;
SG_MUL_VAL_ 2024 S02_EGR_CMPL S02_PID41_CIM_SUP 0-0;
SG_MUL_VAL_ 2024 S02_HCCATENA S02_PID41_CIM_SUP 1-1;
SG_MUL_VAL_ 2024 S02_NCAT_ENA S02_PID41_CIM_SUP 1-1;
SG_MUL_VAL_ 2024 S02_BP_ENA S02_PID41_CIM_SUP 1-1;
SG_MUL_VAL_ 2024 S02_EGS_ENA S02_PID41_CIM_SUP 1-1;
SG_MUL_VAL_ 2024 S02_PM_ENA S02_PID41_CIM_SUP 1-1;
SG_MUL_VAL_ 2024 S02_HCCATCMP S02_PID41_CIM_SUP 1-1;
SG_MUL_VAL_ 2024 S02_NCATCMPL S02_PID41_CIM_SUP 1-1;
SG_MUL_VAL_ 2024 S02_BP_CMPL S02_PID41_CIM_SUP 1-1;
SG_MUL_VAL_ 2024 S02_EGS_CMPL S02_PID41_CIM_SUP 1-1;
SG_MUL_VAL_ 2024 S02_PM_CMPL S02_PID41_CIM_SUP 1-1;
SG_MUL_VAL_ 2024 S02_VPWR S02_PID 66-66;
SG_MUL_VAL_ 2024 S02_LOAD_ABS S02_PID 67-67;
SG_MUL_VAL_ 2024 S02_EQ_RAT S02_PID 68-68;
SG_MUL_VAL_ 2024 S02_TP_R S02_PID 69-69;
SG_MUL_VAL_ 2024 S02_AAT S02_PID 70-70;
SG_MUL_VAL_ 2024 S02_TP_B S02_PID 71-71;
SG_MUL_VAL_ 2024 S02_TP_C S02_PID 72-72;
SG_MUL_VAL_ 2024 S02_APP_D S02_PID 73-73;
SG_MUL_VAL_ 2024 S02_APP_E S02_PID 74-74;
SG_MUL_VAL_ 2024 S02_APP_F S02_PID 75-75;
SG_MUL_VAL_ 2024 S02_TAC_PCT S02_PID 76-76;
SG_MUL_VAL_ 2024 S02_MIL_TIME S02_PID 77-77;
SG_MUL_VAL_ 2024 S02_CLR_TIME S02_PID 78-78;
SG_MUL_VAL_ 2024 S02_ER_MAX S02_PID 79-79;
SG_MUL_VAL_ 2024 S02_O2SV_MAX S02_PID 79-79;
SG_MUL_VAL_ 2024 S02_O2SC_MAX S02_PID 79-79;
SG_MUL_VAL_ 2024 S02_IMAP_MAX S02_PID 79-79;
SG_MUL_VAL_ 2024 S02_AFR_MAX S02_PID 80-80;
SG_MUL_VAL_ 2024 S02_FUEL_TYP S02_PID 81-81;
SG_MUL_VAL_ 2024 S02_ALCH_PCT S02_PID 82-82;
SG_MUL_VAL_ 2024 S02_EVAP_VPA S02_PID 83-83;
SG_MUL_VAL_ 2024 S02_EVAP_VP2 S02_PID 84-84;
SG_MUL_VAL_ 2024 S02_STSO2FT1 S02_PID 85-85;
SG_MUL_VAL_ 2024 S02_STSO2FT3 S02_PID 85-85;
SG_MUL_VAL_ 2024 S02_LGSO2FT1 S02_PID 86-86;
SG_MUL_VAL_ 2024 S02_LGSO2FT3 S02_PID 86-86;
SG_MUL_VAL_ 2024 S02_STSO2FT2 S02_PID 87-87;
SG_MUL_VAL_ 2024 S02_STSO2FT4 S02_PID 87-87;
SG_MUL_VAL_ 2024 S02_LGSO2FT2 S02_PID 88-88;
SG_MUL_VAL_ 2024 S02_LGSO2FT4 S02_PID 88-88;
SG_MUL_VAL_ 2024 S02_FRP2 S02_PID 89-89;
SG_MUL_VAL_ 2024 S02_APP_R S02_PID 90-90;
SG_MUL_VAL_ 2024 S02_BAT_PWR S02_PID 91-91;
SG_MUL_VAL_ 2024 S02_EOT S02_PID 92-92;
SG_MUL_VAL_ 2024 S02_FUEL_TIMING S02_PID 93-93;
SG_MUL_VAL_ 2024 S02_FUEL_RATE S02_PID 94-94;
SG_MUL_VAL_ 2024 S02_EMIS_SUP S02_PID 95-95;
SG_MUL_VAL_ 2024 S02_TQ_DD S02_PID 97-97;
SG_MUL_VAL_ 2024 S02_TQ_ACT S02_PID 98-98;
SG_MUL_VAL_ 2024 S02_TQ_REF S02_PID 99-99;
SG_MUL_VAL_ 2024 S02_TQ_MAX1 S02_PID 100-100;
SG_MUL_VAL_ 2024 S02_TQ_MAX2 S02_PID 100-100;
SG_MUL_VAL_ 2024 S02_TQ_MAX3 S02_PID 100-100;
SG_MUL_VAL_ 2024 S02_TQ_MAX4 S02_PID 100-100;
SG_MUL_VAL_ 2024 S02_TQ_MAX5 S02_PID 100-100;
SG_MUL_VAL_ 2024 S02_PTO_STAT_SUP S02_PID 101-101;
SG_MUL_VAL_ 2024 S02_ND_STAT_SUP S02_PID 101-101;
SG_MUL_VAL_ 2024 S02_NG_STAT_SUP S02_PID 101-101;
SG_MUL_VAL_ 2024 S02_GPL_STAT_SUP S02_PID 101-101;
SG_MUL_VAL_ 2024 S02_GEAR_RCMD_SUP S02_PID 101-101;
SG_MUL_VAL_ 2024 S02_PTO_STAT2 S02_PID 101-101;
SG_MUL_VAL_ 2024 S02_ND_STAT S02_PID 101-101;
SG_MUL_VAL_ 2024 S02_NG_STAT S02_PID 101-101;
SG_MUL_VAL_ 2024 S02_GPL_STAT S02_PID 101-101;
SG_MUL_VAL_ 2024 S02_GEAR_RCMD S02_PID 101-101;
SG_MUL_VAL_ 2024 S02_MAFA_SUP S02_PID 102-102;
SG_MUL_VAL_ 2024 S02_MAFB_SUP S02_PID 102-102;
SG_MUL_VAL_ 2024 S02_MAFA S02_PID 102-102;
SG_MUL_VAL_ 2024 S02_MAFB S02_PID 102-102;
SG_MUL_VAL_ 2024 S02_ECT1_SUP S02_PID 103-103;
SG_MUL_VAL_ 2024 S02_ECT2_SUP S02_PID 103-103;
SG_MUL_VAL_ 2024 S02_ECT1 S02_PID 103-103;
SG_MUL_VAL_ 2024 S02_ECT2 S02_PID 103-103;
SG_MUL_VAL_ 2024 S02_IAT11_SUP S02_PID 104-104;
SG_MUL_VAL_ 2024 S02_IAT12_SUP S02_PID 104-104;
SG_MUL_VAL_ 2024 S02_IAT13_SUP S02_PID 104-104;
SG_MUL_VAL_ 2024 S02_IAT21_SUP S02_PID 104-104;
SG_MUL_VAL_ 2024 S02_IAT22_SUP S02_PID 104-104;
SG_MUL_VAL_ 2024 S02_IAT23_SUP S02_PID 104-104;
SG_MUL_VAL_ 2024 S02_IAT11 S02_PID 104-104;
SG_MUL_VAL_ 2024 S02_IAT12 S02_PID 104-104;
SG_MUL_VAL_ 2024 S02_IAT13 S02_PID 104-104;
SG_MUL_VAL_ 2024 S02_IAT21 S02_PID 104-104;
SG_MUL_VAL_ 2024 S02_IAT22 S02_PID 104-104;
SG_MUL_VAL_ 2024 S02_IAT23 S02_PID 104-104;
SG_MUL_VAL_ 2024 S02_EGR_A_CMD_SUP S02_PID 105-105;
SG_MUL_VAL_ 2024 S02_EGR_A_ACT_SUP S02_PID 105-105;
SG_MUL_VAL_ 2024 S02_EGR_A_ERR_SUP S02_PID 105-105;
SG_MUL_VAL_ 2024 S02_EGR_B_CMD_SUP S02_PID 105-105;
SG_MUL_VAL_ 2024 S02_EGR_B_ACT_SUP S02_PID 105-105;
SG_MUL_VAL_ 2024 S02_EGR_B_ERR_SUP S02_PID 105-105;
SG_MUL_VAL_ 2024 S02_EGR_A_CMD S02_PID 105-105;
SG_MUL_VAL_ 2024 S02_EGR_A_ACT S02_PID 105-105;
SG_MUL_VAL_ 2024 S02_EGR_A_ERR S02_PID 105-105;
SG_MUL_VAL_ 2024 S02_EGR_B_CMD S02_PID 105-105;
SG_MUL_VAL_ 2024 S02_EGR_B_ACT S02_PID 105-105;
SG_MUL_VAL_ 2024 S02_EGR_B_ERR S02_PID 105-105;
SG_MUL_VAL_ 2024 S02_IAF_A_CMD_SUP S02_PID 106-106;
SG_MUL_VAL_ 2024 S02_IAF_A_REL_SUP S02_PID 106-106;
SG_MUL_VAL_ 2024 S02_IAF_B_CMD_SUP S02_PID 106-106;
SG_MUL_VAL_ 2024 S02_IAF_B_REL_SUP S02_PID 106-106;
SG_MUL_VAL_ 2024 S02_IAF_A_CMD S02_PID 106-106;
SG_MUL_VAL_ 2024 S02_IAF_A_REL S02_PID 106-106;
SG_MUL_VAL_ 2024 S02_IAF_B_CMD S02_PID 106-106;
SG_MUL_VAL_ 2024 S02_IAF_B_REL S02_PID 106-106;
SG_MUL_VAL_ 2024 S02_EGRTA_SUP S02_PID 107-107;
SG_MUL_VAL_ 2024 S02_EGRTC_SUP S02_PID 107-107;
SG_MUL_VAL_ 2024 S02_EGRTB_SUP S02_PID 107-107;
SG_MUL_VAL_ 2024 S02_EGRTD_SUP S02_PID 107-107;
SG_MUL_VAL_ 2024 S02_EGRTA_WR_SUP S02_PID 107-107;
SG_MUL_VAL_ 2024 S02_EGRTC_WR_SUP S02_PID 107-107;
SG_MUL_VAL_ 2024 S02_EGRTB_WR_SUP S02_PID 107-107;
SG_MUL_VAL_ 2024 S02_EGRTD_WR_SUP S02_PID 107-107;
SG_MUL_VAL_ 2024 S02_EGRTA S02_EGRTA_SUP 1-1;
SG_MUL_VAL_ 2024 S02_EGRTC S02_EGRTC_SUP 1-1;
SG_MUL_VAL_ 2024 S02_EGRTB S02_EGRTB_SUP 1-1;
SG_MUL_VAL_ 2024 S02_EGRTD S02_EGRTD_SUP 1-1;
SG_MUL_VAL_ 2024 S02_EGRTA_WR S02_EGRTA_SUP 0-0;
SG_MUL_VAL_ 2024 S02_EGRTC_WR S02_EGRTC_SUP 0-0;
SG_MUL_VAL_ 2024 S02_EGRTB_WR S02_EGRTB_SUP 0-0;
SG_MUL_VAL_ 2024 S02_EGRTD_WR S02_EGRTD_SUP 0-0;
SG_MUL_VAL_ 2024 S02_TAC_A_CMD_SUP S02_PID 108-108;
SG_MUL_VAL_ 2024 S02_TP_A_REL_SUP S02_PID 108-108;
SG_MUL_VAL_ 2024 S02_TAC_B_CMD_SUP S02_PID 108-108;
SG_MUL_VAL_ 2024 S02_TP_B_REL_SUP S02_PID 108-108;
SG_MUL_VAL_ 2024 S02_TAC_A_CMD S02_PID 108-108;
SG_MUL_VAL_ 2024 S02_TP_A_REL S02_PID 108-108;
SG_MUL_VAL_ 2024 S02_TAC_B_CMD S02_PID 108-108;
SG_MUL_VAL_ 2024 S02_TP_B_REL S02_PID 108-108;
SG_MUL_VAL_ 2024 S02_FRP_A_CMD_SUP S02_PID 109-109;
SG_MUL_VAL_ 2024 S02_FRP_A_SUP S02_PID 109-109;
SG_MUL_VAL_ 2024 S02_FRT_A_SUP S02_PID 109-109;
SG_MUL_VAL_ 2024 S02_FRP_B_CMD_SUP S02_PID 109-109;
SG_MUL_VAL_ 2024 S02_FRP_B_SUP S02_PID 109-109;
SG_MUL_VAL_ 2024 S02_FRT_B_SUP S02_PID 109-109;
SG_MUL_VAL_ 2024 S02_FRP_A_CMD S02_PID 109-109;
SG_MUL_VAL_ 2024 S02_FRP_A S02_PID 109-109;
SG_MUL_VAL_ 2024 S02_FRT_A  S02_PID 109-109;
SG_MUL_VAL_ 2024 S02_FRP_B_CMD S02_PID 109-109;
SG_MUL_VAL_ 2024 S02_FRP_B S02_PID 109-109;
SG_MUL_VAL_ 2024 S02_FRT_B S02_PID 109-109;
SG_MUL_VAL_ 2024 S02_ICP_A_CMD_SUP S02_PID 110-110;
SG_MUL_VAL_ 2024 S02_ICP_A_SUP S02_PID 110-110;
SG_MUL_VAL_ 2024 S02_ICP_B_CMD_SUP S02_PID 110-110;
SG_MUL_VAL_ 2024 S02_ICP_B_SUP S02_PID 110-110;
SG_MUL_VAL_ 2024 S02_ICP_A_CMD S02_PID 110-110;
SG_MUL_VAL_ 2024 S02_ICP_A S02_PID 110-110;
SG_MUL_VAL_ 2024 S02_ICP_B_CMD S02_PID 110-110;
SG_MUL_VAL_ 2024 S02_ICP_B S02_PID 110-110;
SG_MUL_VAL_ 2024 S02_TCA_CINP_SUP S02_PID 111-111;
SG_MUL_VAL_ 2024 S02_TCB_CINP_SUP S02_PID 111-111;
SG_MUL_VAL_ 2024 S02_TCA_CINP_WR_SUP S02_PID 111-111;
SG_MUL_VAL_ 2024 S02_TCB_CINP_WR_SUP S02_PID 111-111;
SG_MUL_VAL_ 2024 S02_TCA_CINP S02_TCA_CINP_SUP 1-1;
SG_MUL_VAL_ 2024 S02_TCB_CINP S02_TCB_CINP_SUP 1-1;
SG_MUL_VAL_ 2024 S02_TCA_CINP_WR S02_TCA_CINP_SUP 0-0;
SG_MUL_VAL_ 2024 S02_TCB_CINP_WR S02_TCB_CINP_SUP 0-0;
SG_MUL_VAL_ 2024 S02_BP_A_CMD_SUP S02_PID 112-112;
SG_MUL_VAL_ 2024 S02_BP_A_ACT_SUP S02_PID 112-112;
SG_MUL_VAL_ 2024 S02_BP_A_SUP S02_PID 112-112;
SG_MUL_VAL_ 2024 S02_BP_B_CMD_SUP S02_PID 112-112;
SG_MUL_VAL_ 2024 S02_BP_B_ACT_SUP S02_PID 112-112;
SG_MUL_VAL_ 2024 S02_BP_B_SUP S02_PID 112-112;
SG_MUL_VAL_ 2024 S02_BP_A_CMD S02_PID 112-112;
SG_MUL_VAL_ 2024 S02_BP_A_ACT S02_PID 112-112;
SG_MUL_VAL_ 2024 S02_BP_B_CMD S02_PID 112-112;
SG_MUL_VAL_ 2024 S02_BP_B_ACT S02_PID 112-112;
SG_MUL_VAL_ 2024 S02_BP_A S02_PID 112-112;
SG_MUL_VAL_ 2024 S02_BP_B S02_PID 112-112;
SG_MUL_VAL_ 2024 S02_VGT_A_CMD_SUP S02_PID 113-113;
SG_MUL_VAL_ 2024 S02_VGT_A_ACT_SUP S02_PID 113-113;
SG_MUL_VAL_ 2024 S02_VGT_A_SUP S02_PID 113-113;
SG_MUL_VAL_ 2024 S02_VGT_B_CMD_SUP S02_PID 113-113;
SG_MUL_VAL_ 2024 S02_VGT_B_ACT_SUP S02_PID 113-113;
SG_MUL_VAL_ 2024 S02_VGT_B_SUP S02_PID 113-113;
SG_MUL_VAL_ 2024 S02_VGT_A_CMD S02_PID 113-113;
SG_MUL_VAL_ 2024 S02_VGT_A_ACT S02_PID 113-113;
SG_MUL_VAL_ 2024 S02_VGT_B_CMD S02_PID 113-113;
SG_MUL_VAL_ 2024 S02_VGT_B_ACT S02_PID 113-113;
SG_MUL_VAL_ 2024 S02_VGT_A S02_PID 113-113;
SG_MUL_VAL_ 2024 S02_VGT_B S02_PID 113-113;
SG_MUL_VAL_ 2024 S02_WG_A_CMD_SUP S02_PID 114-114;
SG_MUL_VAL_ 2024 S02_WG_A_ACT_SUP S02_PID 114-114;
SG_MUL_VAL_ 2024 S02_WG_B_CMD_SUP S02_PID 114-114;
SG_MUL_VAL_ 2024 S02_WG_B_ACT_SUP S02_PID 114-114;
SG_MUL_VAL_ 2024 S02_WG_A_CMD S02_PID 114-114;
SG_MUL_VAL_ 2024 S02_WG_A_ACT S02_PID 114-114;
SG_MUL_VAL_ 2024 S02_WG_B_CMD S02_PID 114-114;
SG_MUL_VAL_ 2024 S02_WG_B_ACT S02_PID 114-114;
SG_MUL_VAL_ 2024 S02_EP_11_SUP S02_PID 115-115;
SG_MUL_VAL_ 2024 S02_EP_21_SUP S02_PID 115-115;
SG_MUL_VAL_ 2024 S02_EP_11 S02_PID 115-115;
SG_MUL_VAL_ 2024 S02_EP_21 S02_PID 115-115;
SG_MUL_VAL_ 2024 S02_TCA_RPM_SUP S02_PID 116-116;
SG_MUL_VAL_ 2024 S02_TCB_RPM_SUP S02_PID 116-116;
SG_MUL_VAL_ 2024 S02_TCA_RPM S02_PID 116-116;
SG_MUL_VAL_ 2024 S02_TCB_RPM S02_PID 116-116;
SG_MUL_VAL_ 2024 S02_TCA_CINT_SUP S02_PID 117-117;
SG_MUL_VAL_ 2024 S02_TCA_COUTT_SUP S02_PID 117-117;
SG_MUL_VAL_ 2024 S02_TCA_TINT_SUP S02_PID 117-117;
SG_MUL_VAL_ 2024 S02_TCA_TOUTT_SUP S02_PID 117-117;
SG_MUL_VAL_ 2024 S02_TCA_CINT S02_PID 117-117;
SG_MUL_VAL_ 2024 S02_TCA_COUTT S02_PID 117-117;
SG_MUL_VAL_ 2024 S02_TCA_TINT S02_PID 117-117;
SG_MUL_VAL_ 2024 S02_TCA_TOUTT S02_PID 117-117;
SG_MUL_VAL_ 2024 S02_CACT_11_SUP S02_PID 119-119;
SG_MUL_VAL_ 2024 S02_CACT_12_SUP S02_PID 119-119;
SG_MUL_VAL_ 2024 S02_CACT_21_SUP S02_PID 119-119;
SG_MUL_VAL_ 2024 S02_CACT_22_SUP S02_PID 119-119;
SG_MUL_VAL_ 2024 S02_CACT_11 S02_PID 119-119;
SG_MUL_VAL_ 2024 S02_CACT_12 S02_PID 119-119;
SG_MUL_VAL_ 2024 S02_CACT_21 S02_PID 119-119;
SG_MUL_VAL_ 2024 S02_CACT_22 S02_PID 119-119;
SG_MUL_VAL_ 2024 S02_EGT11_SUP S02_PID 120-120;
SG_MUL_VAL_ 2024 S02_EGT12_SUP S02_PID 120-120;
SG_MUL_VAL_ 2024 S02_EGT13_SUP S02_PID 120-120;
SG_MUL_VAL_ 2024 S02_EGT14_SUP S02_PID 120-120;
SG_MUL_VAL_ 2024 S02_EGT11 S02_PID 120-120;
SG_MUL_VAL_ 2024 S02_EGT12 S02_PID 120-120;
SG_MUL_VAL_ 2024 S02_EGT13 S02_PID 120-120;
SG_MUL_VAL_ 2024 S02_EGT14 S02_PID 120-120;
SG_MUL_VAL_ 2024 S02_EGT21_SUP S02_PID 121-121;
SG_MUL_VAL_ 2024 S02_EGT22_SUP S02_PID 121-121;
SG_MUL_VAL_ 2024 S02_EGT23_SUP S02_PID 121-121;
SG_MUL_VAL_ 2024 S02_EGT24_SUP S02_PID 121-121;
SG_MUL_VAL_ 2024 S02_EGT21 S02_PID 121-121;
SG_MUL_VAL_ 2024 S02_EGT22 S02_PID 121-121;
SG_MUL_VAL_ 2024 S02_EGT23 S02_PID 121-121;
SG_MUL_VAL_ 2024 S02_EGT24 S02_PID 121-121;
SG_MUL_VAL_ 2024 S02_PF1_DP_SUP S02_PID 122-122;
SG_MUL_VAL_ 2024 S02_PF1_INP_SUP S02_PID 122-122;
SG_MUL_VAL_ 2024 S02_PF1_OUTP_SUP S02_PID 122-122;
SG_MUL_VAL_ 2024 S02_PF1_DP S02_PID 122-122;
SG_MUL_VAL_ 2024 S02_PF1_INP S02_PID 122-122;
SG_MUL_VAL_ 2024 S02_PF1_OUTP S02_PID 122-122;
SG_MUL_VAL_ 2024 S02_PF2_DP_SUP S02_PID 123-123;
SG_MUL_VAL_ 2024 S02_PF2_INP_SUP S02_PID 123-123;
SG_MUL_VAL_ 2024 S02_PF2_OUTP_SUP S02_PID 123-123;
SG_MUL_VAL_ 2024 S02_PF2_DP S02_PID 123-123;
SG_MUL_VAL_ 2024 S02_PF2_INP S02_PID 123-123;
SG_MUL_VAL_ 2024 S02_PF2_OUTP S02_PID 123-123;
SG_MUL_VAL_ 2024 S02_PF1_INT_SUP S02_PID 124-124;
SG_MUL_VAL_ 2024 S02_PF1_OUTT_SUP S02_PID 124-124;
SG_MUL_VAL_ 2024 S02_PF2_INT_SUP S02_PID 124-124;
SG_MUL_VAL_ 2024 S02_PF2_OUTT_SUP S02_PID 124-124;
SG_MUL_VAL_ 2024 S02_PF1_INT S02_PID 124-124;
SG_MUL_VAL_ 2024 S02_PF1_OUTT S02_PID 124-124;
SG_MUL_VAL_ 2024 S02_PF2_INT S02_PID 124-124;
SG_MUL_VAL_ 2024 S02_PF2_OUTT S02_PID 124-124;
SG_MUL_VAL_ 2024 S02_NNTE_IN S02_PID 125-125;
SG_MUL_VAL_ 2024 S02_NNTE_OUT S02_PID 125-125;
SG_MUL_VAL_ 2024 S02_NNTE_CAA S02_PID 125-125;
SG_MUL_VAL_ 2024 S02_NNTE_DEF S02_PID 125-125;
SG_MUL_VAL_ 2024 S02_PNTE_IN S02_PID 126-126;
SG_MUL_VAL_ 2024 S02_PNTE_OUT S02_PID 126-126;
SG_MUL_VAL_ 2024 S02_PNTE_CAA S02_PID 126-126;
SG_MUL_VAL_ 2024 S02_PNTE_DEF S02_PID 126-126;
SG_MUL_VAL_ 2024 S02_RUN_TIME_SUP S02_PID 127-127;
SG_MUL_VAL_ 2024 S02_IDLE_TIME_SUP S02_PID 127-127;
SG_MUL_VAL_ 2024 S02_PTO_TIME_SUP S02_PID 127-127;
SG_MUL_VAL_ 2024 S02_RUN_TIME S02_PID 127-127;
SG_MUL_VAL_ 2024 S02_IDLE_TIME S02_PID 127-127;
SG_MUL_VAL_ 2024 S02_PTO_TIME S02_PID 127-127;
SG_MUL_VAL_ 2024 S02_AECD1_TIME_SUP S02_PID 129-129;
SG_MUL_VAL_ 2024 S02_AECD2_TIME_SUP S02_PID 129-129;
SG_MUL_VAL_ 2024 S02_AECD3_TIME_SUP S02_PID 129-129;
SG_MUL_VAL_ 2024 S02_AECD4_TIME_SUP S02_PID 129-129;
SG_MUL_VAL_ 2024 S02_AECD5_TIME_SUP S02_PID 129-129;
SG_MUL_VAL_ 2024 S02_AECD1_TIME1 S02_PID 129-129;
SG_MUL_VAL_ 2024 S02_AECD1_TIME2 S02_PID 129-129;
SG_MUL_VAL_ 2024 S02_AECD2_TIME1 S02_PID 129-129;
SG_MUL_VAL_ 2024 S02_AECD2_TIME2 S02_PID 129-129;
SG_MUL_VAL_ 2024 S02_AECD3_TIME1 S02_PID 129-129;
SG_MUL_VAL_ 2024 S02_AECD3_TIME2 S02_PID 129-129;
SG_MUL_VAL_ 2024 S02_AECD4_TIME1 S02_PID 129-129;
SG_MUL_VAL_ 2024 S02_AECD4_TIME2 S02_PID 129-129;
SG_MUL_VAL_ 2024 S02_AECD5_TIME1 S02_PID 129-129;
SG_MUL_VAL_ 2024 S02_AECD5_TIME2 S02_PID 129-129;
SG_MUL_VAL_ 2024 S02_AECD6_TIME_SUP S02_PID 130-130;
SG_MUL_VAL_ 2024 S02_AECD7_TIME_SUP S02_PID 130-130;
SG_MUL_VAL_ 2024 S02_AECD8_TIME_SUP S02_PID 130-130;
SG_MUL_VAL_ 2024 S02_AECD9_TIME_SUP S02_PID 130-130;
SG_MUL_VAL_ 2024 S02_AECD10_TIME_SUP S02_PID 130-130;
SG_MUL_VAL_ 2024 S02_AECD6_TIME1 S02_PID 130-130;
SG_MUL_VAL_ 2024 S02_AECD6_TIME2 S02_PID 130-130;
SG_MUL_VAL_ 2024 S02_AECD7_TIME1 S02_PID 130-130;
SG_MUL_VAL_ 2024 S02_AECD7_TIME2 S02_PID 130-130;
SG_MUL_VAL_ 2024 S02_AECD8_TIME1 S02_PID 130-130;
SG_MUL_VAL_ 2024 S02_AECD8_TIME2 S02_PID 130-130;
SG_MUL_VAL_ 2024 S02_AECD9_TIME1 S02_PID 130-130;
SG_MUL_VAL_ 2024 S02_AECD9_TIME2 S02_PID 130-130;
SG_MUL_VAL_ 2024 S02_AECD10_TIME1 S02_PID 130-130;
SG_MUL_VAL_ 2024 S02_AECD10_TIME2 S02_PID 130-130;
SG_MUL_VAL_ 2024 S02_NOX11_SUP S02_PID 131-131;
SG_MUL_VAL_ 2024 S02_NOX12_SUP S02_PID 131-131;
SG_MUL_VAL_ 2024 S02_NOX21_SUP S02_PID 131-131;
SG_MUL_VAL_ 2024 S02_NOX22_SUP S02_PID 131-131;
SG_MUL_VAL_ 2024 S02_NOX11_RDY S02_PID 131-131;
SG_MUL_VAL_ 2024 S02_NOX12_RDY S02_PID 131-131;
SG_MUL_VAL_ 2024 S02_NOX21_RDY S02_PID 131-131;
SG_MUL_VAL_ 2024 S02_NOX22_RDY S02_PID 131-131;
SG_MUL_VAL_ 2024 S02_NOX11 S02_PID 131-131;
SG_MUL_VAL_ 2024 S02_NOX12 S02_PID 131-131;
SG_MUL_VAL_ 2024 S02_NOX21 S02_PID 131-131;
SG_MUL_VAL_ 2024 S02_NOX22 S02_PID 131-131;
SG_MUL_VAL_ 2024 S02_MST S02_PID 132-132;
SG_MUL_VAL_ 2024 S02_REAG_RATE_SUP S02_PID 133-133;
SG_MUL_VAL_ 2024 S02_REAG_DEMD_SUP S02_PID 133-133;
SG_MUL_VAL_ 2024 S02_REAG_LVL_SUP S02_PID 133-133;
SG_MUL_VAL_ 2024 S02_NWI_TIME_SUP S02_PID 133-133;
SG_MUL_VAL_ 2024 S02_REAG_RATE S02_PID 133-133;
SG_MUL_VAL_ 2024 S02_REAG_DEMD S02_PID 133-133;
SG_MUL_VAL_ 2024 S02_REAG_LVL S02_PID 133-133;
SG_MUL_VAL_ 2024 S02_NWI_TIME S02_PID 133-133;
SG_MUL_VAL_ 2024 S02_PM11_SUP S02_PID 134-134;
SG_MUL_VAL_ 2024 S02_PM21_SUP S02_PID 134-134;
SG_MUL_VAL_ 2024 S02_PM11 S02_PID 134-134;
SG_MUL_VAL_ 2024 S02_PM21 S02_PID 134-134;
SG_MUL_VAL_ 2024 S02_MAP_A_SUP S02_PID 135-135;
SG_MUL_VAL_ 2024 S02_MAP_B_SUP S02_PID 135-135;
SG_MUL_VAL_ 2024 S02_MAP_A S02_PID 135-135;
SG_MUL_VAL_ 2024 S02_MAP_B S02_PID 135-135;
SG_MUL_VAL_ 2024 S02_SCR_IND_SYS_LEVEL_LOW S02_PID 136-136;
SG_MUL_VAL_ 2024 S02_SCR_IND_SYS_INCORR_REAG S02_PID 136-136;
SG_MUL_VAL_ 2024 S02_SCR_IND_SYS_CONSUMP_DEVIATION S02_PID 136-136;
SG_MUL_VAL_ 2024 S02_SCR_IND_SYS_NOx_LEVEL S02_PID 136-136;
SG_MUL_VAL_ 2024 S02_SCR_IND_SYS_ACTIVE S02_PID 136-136;
SG_MUL_VAL_ 2024 S02_SCR_IND_SYS_HIST1_LEVEL_LOW S02_PID 136-136;
SG_MUL_VAL_ 2024 S02_SCR_IND_SYS_HIST1_INCORR_REAG S02_PID 136-136;
SG_MUL_VAL_ 2024 S02_SCR_IND_SYS_HIST1_CONSUMP_DEVIATION S02_PID 136-136;
SG_MUL_VAL_ 2024 S02_SCR_IND_SYS_HIST1_NOx_LEVEL S02_PID 136-136;
SG_MUL_VAL_ 2024 S02_SCR_IND_SYS_HIST2_LEVEL_LOW S02_PID 136-136;
SG_MUL_VAL_ 2024 S02_SCR_IND_SYS_HIST2_INCORR_REAG S02_PID 136-136;
SG_MUL_VAL_ 2024 S02_SCR_IND_SYS_HIST2_CONSUMP_DEVIATION S02_PID 136-136;
SG_MUL_VAL_ 2024 S02_SCR_IND_SYS_HIST2_NOx_LEVEL S02_PID 136-136;
SG_MUL_VAL_ 2024 S02_SCR_IND_SYS_HIST3_LEVEL_LOW S02_PID 136-136;
SG_MUL_VAL_ 2024 S02_SCR_IND_SYS_HIST3_INCORR_REAG S02_PID 136-136;
SG_MUL_VAL_ 2024 S02_SCR_IND_SYS_HIST3_CONSUMP_DEVIATION S02_PID 136-136;
SG_MUL_VAL_ 2024 S02_SCR_IND_SYS_HIST3_NOx_LEVEL S02_PID 136-136;
SG_MUL_VAL_ 2024 S02_SCR_IND_SYS_HIST4_LEVEL_LOW S02_PID 136-136;
SG_MUL_VAL_ 2024 S02_SCR_IND_SYS_HIST4_INCORR_REAG S02_PID 136-136;
SG_MUL_VAL_ 2024 S02_SCR_IND_SYS_HIST4_CONSUMP_DEVIATION S02_PID 136-136;
SG_MUL_VAL_ 2024 S02_SCR_IND_SYS_HIST4_NOx_LEVEL S02_PID 136-136;
SG_MUL_VAL_ 2024 S02_SCR_IND_DIST_1N S02_PID 136-136;
SG_MUL_VAL_ 2024 S02_SCR_IND_DIST_1D S02_PID 136-136;
SG_MUL_VAL_ 2024 S02_SCR_IND_DIST_2N S02_PID 136-136;
SG_MUL_VAL_ 2024 S02_SCR_IND_DIST_3N S02_PID 136-136;
SG_MUL_VAL_ 2024 S02_SCR_IND_DIST_4N S02_PID 136-136;
SG_MUL_VAL_ 2024 S02_AECD11_TIME_SUP S02_PID 137-137;
SG_MUL_VAL_ 2024 S02_AECD12_TIME_SUP S02_PID 137-137;
SG_MUL_VAL_ 2024 S02_AECD13_TIME_SUP S02_PID 137-137;
SG_MUL_VAL_ 2024 S02_AECD14_TIME_SUP S02_PID 137-137;
SG_MUL_VAL_ 2024 S02_AECD15_TIME_SUP S02_PID 137-137;
SG_MUL_VAL_ 2024 S02_AECD11_TIME1 S02_PID 137-137;
SG_MUL_VAL_ 2024 S02_AECD11_TIME2 S02_PID 137-137;
SG_MUL_VAL_ 2024 S02_AECD12_TIME1 S02_PID 137-137;
SG_MUL_VAL_ 2024 S02_AECD12_TIME2 S02_PID 137-137;
SG_MUL_VAL_ 2024 S02_AECD13_TIME1 S02_PID 137-137;
SG_MUL_VAL_ 2024 S02_AECD13_TIME2 S02_PID 137-137;
SG_MUL_VAL_ 2024 S02_AECD14_TIME1 S02_PID 137-137;
SG_MUL_VAL_ 2024 S02_AECD14_TIME2 S02_PID 137-137;
SG_MUL_VAL_ 2024 S02_AECD15_TIME1 S02_PID 137-137;
SG_MUL_VAL_ 2024 S02_AECD15_TIME2 S02_PID 137-137;
SG_MUL_VAL_ 2024 S02_AECD16_TIME_SUP S02_PID 138-138;
SG_MUL_VAL_ 2024 S02_AECD17_TIME_SUP S02_PID 138-138;
SG_MUL_VAL_ 2024 S02_AECD18_TIME_SUP S02_PID 138-138;
SG_MUL_VAL_ 2024 S02_AECD19_TIME_SUP S02_PID 138-138;
SG_MUL_VAL_ 2024 S02_AECD20_TIME_SUP S02_PID 138-138;
SG_MUL_VAL_ 2024 S02_AECD16_TIME1 S02_PID 138-138;
SG_MUL_VAL_ 2024 S02_AECD16_TIME2 S02_PID 138-138;
SG_MUL_VAL_ 2024 S02_AECD17_TIME1 S02_PID 138-138;
SG_MUL_VAL_ 2024 S02_AECD17_TIME2 S02_PID 138-138;
SG_MUL_VAL_ 2024 S02_AECD18_TIME1 S02_PID 138-138;
SG_MUL_VAL_ 2024 S02_AECD18_TIME2 S02_PID 138-138;
SG_MUL_VAL_ 2024 S02_AECD19_TIME1 S02_PID 138-138;
SG_MUL_VAL_ 2024 S02_AECD19_TIME2 S02_PID 138-138;
SG_MUL_VAL_ 2024 S02_AECD20_TIME1 S02_PID 138-138;
SG_MUL_VAL_ 2024 S02_AECD20_TIME2 S02_PID 138-138;
SG_MUL_VAL_ 2024 S02_PF_REGEN_STAT_SUP S02_PID 139-139;
SG_MUL_VAL_ 2024 S02_PF_REGEN_TYPE_SUP S02_PID 139-139;
SG_MUL_VAL_ 2024 S02_NOX_ADS_REGEN_SUP S02_PID 139-139;
SG_MUL_VAL_ 2024 S02_NOX_ADS_DESULF_SUP S02_PID 139-139;
SG_MUL_VAL_ 2024 S02_PF_REGEN_PCT_SUP S02_PID 139-139;
SG_MUL_VAL_ 2024 S02_PF_REGEN_AVGT_SUP S02_PID 139-139;
SG_MUL_VAL_ 2024 S02_PF_REGEN_AVGD_SUP S02_PID 139-139;
SG_MUL_VAL_ 2024 S02_PF_REGEN_STAT S02_PID 139-139;
SG_MUL_VAL_ 2024 S02_PF_REGEN_TYPE S02_PID 139-139;
SG_MUL_VAL_ 2024 S02_NOX_ADS_REGEN S02_PID 139-139;
SG_MUL_VAL_ 2024 S02_NOX_ADS_DESULF S02_PID 139-139;
SG_MUL_VAL_ 2024 S02_PF_REGEN_PCT S02_PID 139-139;
SG_MUL_VAL_ 2024 S02_PF_REGEN_AVGT S02_PID 139-139;
SG_MUL_VAL_ 2024 S02_PF_REGEN_AVGD S02_PID 139-139;
SG_MUL_VAL_ 2024 S02_O2S11_PCT_SUP S02_PID 140-140;
SG_MUL_VAL_ 2024 S02_O2S12_PCT_SUP S02_PID 140-140;
SG_MUL_VAL_ 2024 S02_O2S21_PCT_SUP S02_PID 140-140;
SG_MUL_VAL_ 2024 S02_O2S22_PCT_SUP S02_PID 140-140;
SG_MUL_VAL_ 2024 S02_O2S11_PCT_LAMBDA_SUP S02_PID 140-140;
SG_MUL_VAL_ 2024 S02_O2S12_PCT_LAMBDA_SUP S02_PID 140-140;
SG_MUL_VAL_ 2024 S02_O2S21_PCT_LAMBDA_SUP S02_PID 140-140;
SG_MUL_VAL_ 2024 S02_O2S22_PCT_LAMBDA_SUP S02_PID 140-140;
SG_MUL_VAL_ 2024 S02_O2S11_PCT S02_PID 140-140;
SG_MUL_VAL_ 2024 S02_O2S12_PCT S02_PID 140-140;
SG_MUL_VAL_ 2024 S02_O2S21_PCT S02_PID 140-140;
SG_MUL_VAL_ 2024 S02_O2S22_PCT S02_PID 140-140;
SG_MUL_VAL_ 2024 S02_O2S11_PCT_LAMBDA S02_PID 140-140;
SG_MUL_VAL_ 2024 S02_O2S12_PCT_LAMBDA S02_PID 140-140;
SG_MUL_VAL_ 2024 S02_O2S21_PCT_LAMBDA S02_PID 140-140;
SG_MUL_VAL_ 2024 S02_O2S22_PCT_LAMBDA S02_PID 140-140;
SG_MUL_VAL_ 2024 S02_TP_G S02_PID 141-141;
SG_MUL_VAL_ 2024 S02_TQ_FR S02_PID 142-142;
SG_MUL_VAL_ 2024 S02_PM11_STA_SUP S02_PID 143-143;
SG_MUL_VAL_ 2024 S02_PM11_SIGNAL_SUP S02_PID 143-143;
SG_MUL_VAL_ 2024 S02_PM21_STA_SUP S02_PID 143-143;
SG_MUL_VAL_ 2024 S02_PM21_SIGNAL_SUP S02_PID 143-143;
SG_MUL_VAL_ 2024 S02_PM11_ACTIVE S02_PID 143-143;
SG_MUL_VAL_ 2024 S02_PM11_REGEN S02_PID 143-143;
SG_MUL_VAL_ 2024 S02_PM11_NOV S02_PID 143-143;
SG_MUL_VAL_ 2024 S02_PM21_ACTIVE S02_PID 143-143;
SG_MUL_VAL_ 2024 S02_PM21_REGEN S02_PID 143-143;
SG_MUL_VAL_ 2024 S02_PM21_NOV S02_PID 143-143;
SG_MUL_VAL_ 2024 S02_MI_DISP_VOBD S02_PID 144-144;
SG_MUL_VAL_ 2024 S02_MI_MODE_VOBD S02_PID 144-144;
SG_MUL_VAL_ 2024 S02_VOBD_RDY S02_PID 144-144;
SG_MUL_VAL_ 2024 S02_VOBD_MI_TIME S02_PID 144-144;
SG_MUL_VAL_ 2024 S02_MI_MODE_ECU S02_PID 145-145;
SG_MUL_VAL_ 2024 S02_OBD_MI_TIME S02_PID 145-145;
SG_MUL_VAL_ 2024 S02_OBD_B1_TIME S02_PID 145-145;
SG_MUL_VAL_ 2024 S02_FP1_CL_SUP S02_PID 146-146;
SG_MUL_VAL_ 2024 S02_FIQ1_CL_SUP S02_PID 146-146;
SG_MUL_VAL_ 2024 S02_FIT1_CL_SUP S02_PID 146-146;
SG_MUL_VAL_ 2024 S02_IFB1_CL_SUP S02_PID 146-146;
SG_MUL_VAL_ 2024 S02_FP2_CL_SUP S02_PID 146-146;
SG_MUL_VAL_ 2024 S02_FIQ2_CL_SUP S02_PID 146-146;
SG_MUL_VAL_ 2024 S02_FIT2_CL_SUP S02_PID 146-146;
SG_MUL_VAL_ 2024 S02_IFB2_CL_SUP S02_PID 146-146;
SG_MUL_VAL_ 2024 S02_FP1_CL S02_PID 146-146;
SG_MUL_VAL_ 2024 S02_FIQ1_CL S02_PID 146-146;
SG_MUL_VAL_ 2024 S02_FIT1_CL S02_PID 146-146;
SG_MUL_VAL_ 2024 S02_IFB1_CL S02_PID 146-146;
SG_MUL_VAL_ 2024 S02_FP2_CL S02_PID 146-146;
SG_MUL_VAL_ 2024 S02_FIQ2_CL S02_PID 146-146;
SG_MUL_VAL_ 2024 S02_FIT2_CL S02_PID 146-146;
SG_MUL_VAL_ 2024 S02_IFB2_CL S02_PID 146-146;
SG_MUL_VAL_ 2024 S02_MI_TIME_CUM_SUP S02_PID 147-147;
SG_MUL_VAL_ 2024 S02_MI_TIME_CUM S02_PID 147-147;
SG_MUL_VAL_ 2024 S02_NOX_WARN_ACT_SUP S02_PID 148-148;
SG_MUL_VAL_ 2024 S02_REAG_QUAL_TIME_SUP S02_PID 148-148;
SG_MUL_VAL_ 2024 S02_REAG_CON_TIME_SUP S02_PID 148-148;
SG_MUL_VAL_ 2024 S02_REAG_DOSE_TIME_SUP S02_PID 148-148;
SG_MUL_VAL_ 2024 S02_EGR_TIME_SUP S02_PID 148-148;
SG_MUL_VAL_ 2024 S02_NOX_DTC_TIME_SUP S02_PID 148-148;
SG_MUL_VAL_ 2024 S02_NOX_WARN_ACT S02_PID 148-148;
SG_MUL_VAL_ 2024 S02_INDUC_L1 S02_PID 148-148;
SG_MUL_VAL_ 2024 S02_INDUC_L2 S02_PID 148-148;
SG_MUL_VAL_ 2024 S02_INDUC_L3 S02_PID 148-148;
SG_MUL_VAL_ 2024 S02_REAG_QUAL_TIME S02_PID 148-148;
SG_MUL_VAL_ 2024 S02_REAG_CON_TIME S02_PID 148-148;
SG_MUL_VAL_ 2024 S02_REAG_DOSE_TIME S02_PID 148-148;
SG_MUL_VAL_ 2024 S02_EGR_TIME S02_PID 148-148;
SG_MUL_VAL_ 2024 S02_NOX_DTC_TIME S02_PID 148-148;
SG_MUL_VAL_ 2024 S02_SCR_NH3_TGT_A_SUP S02_PID 149-149;
SG_MUL_VAL_ 2024 S02_SCR_NH3_ACT_A_SUP S02_PID 149-149;
SG_MUL_VAL_ 2024 S02_SCR_NH3_TGT_B_SUP S02_PID 149-149;
SG_MUL_VAL_ 2024 S02_SCR_NH3_ACT_B_SUP S02_PID 149-149;
SG_MUL_VAL_ 2024 S02_SCR_NH3_TGT_A S02_PID 149-149;
SG_MUL_VAL_ 2024 S02_SCR_NH3_ACT_A S02_PID 149-149;
SG_MUL_VAL_ 2024 S02_SCR_NH3_TGT_B S02_PID 149-149;
SG_MUL_VAL_ 2024 S02_SCR_NH3_ACT_B S02_PID 149-149;
SG_MUL_VAL_ 2024 S02_HC_INJ_FL_SUP S02_PID 150-150;
SG_MUL_VAL_ 2024 S02_HC_INJ_DC_SUP S02_PID 150-150;
SG_MUL_VAL_ 2024 S02_AFT_FP_SUP S02_PID 150-150;
SG_MUL_VAL_ 2024 S02_HC_INJ_FL S02_PID 150-150;
SG_MUL_VAL_ 2024 S02_HC_INJ_DC S02_PID 150-150;
SG_MUL_VAL_ 2024 S02_AFT_FP S02_PID 150-150;
SG_MUL_VAL_ 2024 S02_NOx_EO_SUP S02_PID 151-151;
SG_MUL_VAL_ 2024 S02_NOx_TP_SUP S02_PID 151-151;
SG_MUL_VAL_ 2024 S02_NOx_EO S02_PID 151-151;
SG_MUL_VAL_ 2024 S02_NOx_TP S02_PID 151-151;
SG_MUL_VAL_ 2024 S02_EGT15_SUP S02_PID 152-152;
SG_MUL_VAL_ 2024 S02_EGT16_SUP S02_PID 152-152;
SG_MUL_VAL_ 2024 S02_EGT17_SUP S02_PID 152-152;
SG_MUL_VAL_ 2024 S02_EGT18_SUP S02_PID 152-152;
SG_MUL_VAL_ 2024 S02_EGT15 S02_PID 152-152;
SG_MUL_VAL_ 2024 S02_EGT16 S02_PID 152-152;
SG_MUL_VAL_ 2024 S02_EGT17 S02_PID 152-152;
SG_MUL_VAL_ 2024 S02_EGT18 S02_PID 152-152;
SG_MUL_VAL_ 2024 S02_EGT25_SUP S02_PID 153-153;
SG_MUL_VAL_ 2024 S02_EGT26_SUP S02_PID 153-153;
SG_MUL_VAL_ 2024 S02_EGT27_SUP S02_PID 153-153;
SG_MUL_VAL_ 2024 S02_EGT28_SUP S02_PID 153-153;
SG_MUL_VAL_ 2024 S02_EGT25 S02_PID 153-153;
SG_MUL_VAL_ 2024 S02_EGT26 S02_PID 153-153;
SG_MUL_VAL_ 2024 S02_EGT27 S02_PID 153-153;
SG_MUL_VAL_ 2024 S02_EGT28 S02_PID 153-153;
SG_MUL_VAL_ 2024 S02_HEV_CHRG_STA_SUP S02_PID 154-154;
SG_MUL_VAL_ 2024 S02_HEV_BATT_V_SUP S02_PID 154-154;
SG_MUL_VAL_ 2024 S02_HEV_BATT_A_SUP S02_PID 154-154;
SG_MUL_VAL_ 2024 S02_EHEV_CHRG_STA_SUP S02_PID 154-154;
SG_MUL_VAL_ 2024 S02_HEV_CHRG_STA S02_PID 154-154;
SG_MUL_VAL_ 2024 S02_EHEV_CHRG_STA S02_PID 154-154;
SG_MUL_VAL_ 2024 S02_HEV_BATT_V S02_PID 154-154;
SG_MUL_VAL_ 2024 S02_HEV_BATT_A S02_PID 154-154;
SG_MUL_VAL_ 2024 S02_DEF_TYPE_SUP S02_PID 155-155;
SG_MUL_VAL_ 2024 S02_DEF_CON_SUP S02_PID 155-155;
SG_MUL_VAL_ 2024 S02_DEF_T_SUP S02_PID 155-155;
SG_MUL_VAL_ 2024 S02_DEF_LVL_SUP S02_PID 155-155;
SG_MUL_VAL_ 2024 S02_DEF_TYPE S02_PID 155-155;
SG_MUL_VAL_ 2024 S02_DEF_CON S02_PID 155-155;
SG_MUL_VAL_ 2024 S02_DEF_T S02_PID 155-155;
SG_MUL_VAL_ 2024 S02_DEF_LVL S02_PID 155-155;
SG_MUL_VAL_ 2024 S02_O2S13_PCT_SUP S02_PID 156-156;
SG_MUL_VAL_ 2024 S02_O2S14_PCT_SUP S02_PID 156-156;
SG_MUL_VAL_ 2024 S02_O2S23_PCT_SUP S02_PID 156-156;
SG_MUL_VAL_ 2024 S02_O2S24_PCT_SUP S02_PID 156-156;
SG_MUL_VAL_ 2024 S02_O2S13_PCT_LAMBDA_SUP S02_PID 156-156;
SG_MUL_VAL_ 2024 S02_O2S14_PCT_LAMBDA_SUP S02_PID 156-156;
SG_MUL_VAL_ 2024 S02_O2S23_PCT_LAMBDA_SUP S02_PID 156-156;
SG_MUL_VAL_ 2024 S02_O2S24_PCT_LAMBDA_SUP S02_PID 156-156;
SG_MUL_VAL_ 2024 S02_O2S13_PCT S02_PID 156-156;
SG_MUL_VAL_ 2024 S02_O2S14_PCT S02_PID 156-156;
SG_MUL_VAL_ 2024 S02_O2S23_PCT S02_PID 156-156;
SG_MUL_VAL_ 2024 S02_O2S24_PCT S02_PID 156-156;
SG_MUL_VAL_ 2024 S02_O2S13_PCT_LAMBDA S02_PID 156-156;
SG_MUL_VAL_ 2024 S02_O2S14_PCT_LAMBDA S02_PID 156-156;
SG_MUL_VAL_ 2024 S02_O2S23_PCT_LAMBDA S02_PID 156-156;
SG_MUL_VAL_ 2024 S02_O2S24_PCT_LAMBDA S02_PID 156-156;
SG_MUL_VAL_ 2024 S02_FUEL_RATE_GS S02_PID 157-157;
SG_MUL_VAL_ 2024 S02_VFUEL_RATE S02_PID 157-157;
SG_MUL_VAL_ 2024 S02_EXH_RATE S02_PID 158-158;
SG_MUL_VAL_ 2024 S02_FUELSYSA_B1_SUP S02_PID 159-159;
SG_MUL_VAL_ 2024 S02_FUELSYSB_B1_SUP S02_PID 159-159;
SG_MUL_VAL_ 2024 S02_FUELSYSA_B2_SUP S02_PID 159-159;
SG_MUL_VAL_ 2024 S02_FUELSYSB_B2_SUP S02_PID 159-159;
SG_MUL_VAL_ 2024 S02_FUELSYSA_B3_SUP S02_PID 159-159;
SG_MUL_VAL_ 2024 S02_FUELSYSB_B3_SUP S02_PID 159-159;
SG_MUL_VAL_ 2024 S02_FUELSYSA_B4_SUP S02_PID 159-159;
SG_MUL_VAL_ 2024 S02_FUELSYSB_B4_SUP S02_PID 159-159;
SG_MUL_VAL_ 2024 S02_FUELSYSA_B1 S02_PID 159-159;
SG_MUL_VAL_ 2024 S02_FUELSYSB_B1 S02_PID 159-159;
SG_MUL_VAL_ 2024 S02_FUELSYSA_B2 S02_PID 159-159;
SG_MUL_VAL_ 2024 S02_FUELSYSB_B2 S02_PID 159-159;
SG_MUL_VAL_ 2024 S02_FUELSYSA_B3 S02_PID 159-159;
SG_MUL_VAL_ 2024 S02_FUELSYSB_B3 S02_PID 159-159;
SG_MUL_VAL_ 2024 S02_FUELSYSA_B4 S02_PID 159-159;
SG_MUL_VAL_ 2024 S02_FUELSYSB_B4 S02_PID 159-159;
SG_MUL_VAL_ 2024 S02_NOXC11_SUP S02_PID 161-161;
SG_MUL_VAL_ 2024 S02_NOXC12_SUP S02_PID 161-161;
SG_MUL_VAL_ 2024 S02_NOXC21_SUP S02_PID 161-161;
SG_MUL_VAL_ 2024 S02_NOXC22_SUP S02_PID 161-161;
SG_MUL_VAL_ 2024 S02_NOXC11_RDY S02_PID 161-161;
SG_MUL_VAL_ 2024 S02_NOXC12_RDY S02_PID 161-161;
SG_MUL_VAL_ 2024 S02_NOXC21_RDY S02_PID 161-161;
SG_MUL_VAL_ 2024 S02_NOXC22_RDY S02_PID 161-161;
SG_MUL_VAL_ 2024 S02_NOXC11 S02_PID 161-161;
SG_MUL_VAL_ 2024 S02_NOXC12 S02_PID 161-161;
SG_MUL_VAL_ 2024 S02_NOXC21 S02_PID 161-161;
SG_MUL_VAL_ 2024 S02_NOXC22 S02_PID 161-161;
SG_MUL_VAL_ 2024 S02_CYL_RATE S02_PID 162-162;
SG_MUL_VAL_ 2024 S02_EVAP_A_VP_SUP S02_PID 163-163;
SG_MUL_VAL_ 2024 S02_EVAP_A_VP_WR_SUP S02_PID 163-163;
SG_MUL_VAL_ 2024 S02_EVAP_B_VP_SUP S02_PID 163-163;
SG_MUL_VAL_ 2024 S02_EVAP_B_VP_WR_SUP S02_PID 163-163;
SG_MUL_VAL_ 2024 S02_EVAP_SEAL_SUP S02_PID 163-163;
SG_MUL_VAL_ 2024 S02_EVAP_SEAL S02_PID 163-163;
SG_MUL_VAL_ 2024 S02_EVAP_A_VP S02_PID 163-163;
SG_MUL_VAL_ 2024 S02_EVAP_A_VP_WR S02_PID 163-163;
SG_MUL_VAL_ 2024 S02_EVAP_B_VP S02_PID 163-163;
SG_MUL_VAL_ 2024 S02_EVAP_B_VP_WR S02_PID 163-163;
SG_MUL_VAL_ 2024 S02_GEAR_ACT_SUP S02_PID 164-164;
SG_MUL_VAL_ 2024 S02_GEAR_RAT_SUP S02_PID 164-164;
SG_MUL_VAL_ 2024 S02_GEAR_ACT S02_PID 164-164;
SG_MUL_VAL_ 2024 S02_GEAR_RAT S02_PID 164-164;
SG_MUL_VAL_ 2024 S02_DEF_CMD_SUP S02_PID 165-165;
SG_MUL_VAL_ 2024 S02_DEF_UCDC_SUP S02_PID 165-165;
SG_MUL_VAL_ 2024 S02_DEF_CMD S02_PID 165-165;
SG_MUL_VAL_ 2024 S02_DEF_UCDC S02_PID 165-165;
SG_MUL_VAL_ 2024 S02_ODO S02_PID 166-166;
SG_MUL_VAL_ 2024 S02_NOX13_SUP S02_PID 167-167;
SG_MUL_VAL_ 2024 S02_NOX14_SUP S02_PID 167-167;
SG_MUL_VAL_ 2024 S02_NOX23_SUP S02_PID 167-167;
SG_MUL_VAL_ 2024 S02_NOX24_SUP S02_PID 167-167;
SG_MUL_VAL_ 2024 S02_NOX13_RDY S02_PID 167-167;
SG_MUL_VAL_ 2024 S02_NOX14_RDY S02_PID 167-167;
SG_MUL_VAL_ 2024 S02_NOX23_RDY S02_PID 167-167;
SG_MUL_VAL_ 2024 S02_NOX24_RDY S02_PID 167-167;
SG_MUL_VAL_ 2024 S02_NOX13 S02_PID 167-167;
SG_MUL_VAL_ 2024 S02_NOX14 S02_PID 167-167;
SG_MUL_VAL_ 2024 S02_NOX23 S02_PID 167-167;
SG_MUL_VAL_ 2024 S02_NOX24 S02_PID 167-167;
SG_MUL_VAL_ 2024 S02_NOXC13_SUP S02_PID 168-168;
SG_MUL_VAL_ 2024 S02_NOXC14_SUP S02_PID 168-168;
SG_MUL_VAL_ 2024 S02_NOXC23_SUP S02_PID 168-168;
SG_MUL_VAL_ 2024 S02_NOXC24_SUP S02_PID 168-168;
SG_MUL_VAL_ 2024 S02_NOXC13_RDY S02_PID 168-168;
SG_MUL_VAL_ 2024 S02_NOXC14_RDY S02_PID 168-168;
SG_MUL_VAL_ 2024 S02_NOXC23_RDY S02_PID 168-168;
SG_MUL_VAL_ 2024 S02_NOXC24_RDY S02_PID 168-168;
SG_MUL_VAL_ 2024 S02_NOXC13 S02_PID 168-168;
SG_MUL_VAL_ 2024 S02_NOXC14 S02_PID 168-168;
SG_MUL_VAL_ 2024 S02_NOXC23 S02_PID 168-168;
SG_MUL_VAL_ 2024 S02_NOXC24 S02_PID 168-168;
SG_MUL_VAL_ 2024 S02_ABS_DISABLED_SUP S02_PID 169-169;
SG_MUL_VAL_ 2024 S02_ABS_DISABLED S02_PID 169-169;
SG_MUL_VAL_ 2024 S02_V_SET S02_PID 170-170;
SG_MUL_VAL_ 2024 S02_FRP_AF_SUP S02_PID 171-171;
SG_MUL_VAL_ 2024 S02_FRT_AF_SUP S02_PID 171-171;
SG_MUL_VAL_ 2024 S02_FTP_AF_SUP S02_PID 171-171;
SG_MUL_VAL_ 2024 S02_FTPW_AF_SUP S02_PID 171-171;
SG_MUL_VAL_ 2024 S02_FTT_AF_SUP S02_PID 171-171;
SG_MUL_VAL_ 2024 S02_FRP_AF S02_PID 171-171;
SG_MUL_VAL_ 2024 S02_FRT_AF S02_PID 171-171;
SG_MUL_VAL_ 2024 S02_FTP_AF S02_PID 171-171;
SG_MUL_VAL_ 2024 S02_FTPW_AF S02_PID 171-171;
SG_MUL_VAL_ 2024 S02_FTT_AF S02_PID 171-171;
SG_MUL_VAL_ 2024 S02_CKC_P_SUP S02_PID 173-173;
SG_MUL_VAL_ 2024 S02_CKC_OSEP_RPM_SUP S02_PID 173-173;
SG_MUL_VAL_ 2024 S02_CKC_P S02_PID 173-173;
SG_MUL_VAL_ 2024 S02_CKC_OSEP_RPM S02_PID 173-173;
SG_MUL_VAL_ 2024 S02_EVAP_PP_SUP S02_PID 174-174;
SG_MUL_VAL_ 2024 S02_EVAP_PP_WR_SUP S02_PID 174-174;
SG_MUL_VAL_ 2024 S02_EVAP_PP S02_PID 174-174;
SG_MUL_VAL_ 2024 S02_EVAP_PP_WR S02_PID 174-174;
SG_MUL_VAL_ 2024 S02_AIR_FL_TGT S02_PID 175-175;
SG_MUL_VAL_ 2024 S02_EGR_M_FL_A_SUP S02_PID 176-176;
SG_MUL_VAL_ 2024 S02_EGR_M_FL_B_SUP S02_PID 176-176;
SG_MUL_VAL_ 2024 S02_EGR_M_FL_A S02_PID 176-176;
SG_MUL_VAL_ 2024 S02_EGR_M_FL_B S02_PID 176-176;
SG_MUL_VAL_ 2024 S02_CIFSI1_SUP S02_PID 177-177;
SG_MUL_VAL_ 2024 S02_CIFSI2_SUP S02_PID 177-177;
SG_MUL_VAL_ 2024 S02_CIFSI1_SHRTFT_SUP S02_PID 177-177;
SG_MUL_VAL_ 2024 S02_CIFSI1_LONGFT_SUP S02_PID 177-177;
SG_MUL_VAL_ 2024 S02_CIFSI2_SHRTFT_SUP S02_PID 177-177;
SG_MUL_VAL_ 2024 S02_CIFSI2_LONGFT_SUP S02_PID 177-177;
SG_MUL_VAL_ 2024 S02_CIFSI1_OL S02_PID 177-177;
SG_MUL_VAL_ 2024 S02_CIFSI1_CL S02_PID 177-177;
SG_MUL_VAL_ 2024 S02_CIFSI1_OL_Fault S02_PID 177-177;
SG_MUL_VAL_ 2024 S02_CIFSI2_OL S02_PID 177-177;
SG_MUL_VAL_ 2024 S02_CIFSI2_CL S02_PID 177-177;
SG_MUL_VAL_ 2024 S02_CIFSI2_OL_Fault S02_PID 177-177;
SG_MUL_VAL_ 2024 S02_CIFSI1_SHRTFT S02_PID 177-177;
SG_MUL_VAL_ 2024 S02_CIFSI1_LONGFT S02_PID 177-177;
SG_MUL_VAL_ 2024 S02_CIFSI2_SHRTFT S02_PID 177-177;
SG_MUL_VAL_ 2024 S02_CIFSI2_LONGFT S02_PID 177-177;
SG_MUL_VAL_ 2024 S02_BAT_RET S02_PID 178-178;
SG_MUL_VAL_ 2024 S02_HVESPA_ACR_SUP S02_PID 179-179;
SG_MUL_VAL_ 2024 S02_HVESPB_ACR_SUP S02_PID 179-179;
SG_MUL_VAL_ 2024 S02_HVESPC_ACR_SUP S02_PID 179-179;
SG_MUL_VAL_ 2024 S02_HVESPD_ACR_SUP S02_PID 179-179;
SG_MUL_VAL_ 2024 S02_HVESPE_ACR_SUP S02_PID 179-179;
SG_MUL_VAL_ 2024 S02_HVESPF_ACR_SUP S02_PID 179-179;
SG_MUL_VAL_ 2024 S02_HVESPG_ACR_SUP S02_PID 179-179;
SG_MUL_VAL_ 2024 S02_HVESPH_ACR_SUP S02_PID 179-179;
SG_MUL_VAL_ 2024 S02_HVESS_ACR S02_PID 179-179;
SG_MUL_VAL_ 2024 S02_HVESPA_ACR S02_PID 179-179;
SG_MUL_VAL_ 2024 S02_HVESPB_ACR S02_PID 179-179;
SG_MUL_VAL_ 2024 S02_HVESPC_ACR S02_PID 179-179;
SG_MUL_VAL_ 2024 S02_HVESPD_ACR S02_PID 179-179;
SG_MUL_VAL_ 2024 S02_HVESPE_ACR S02_PID 179-179;
SG_MUL_VAL_ 2024 S02_HVESPF_ACR S02_PID 179-179;
SG_MUL_VAL_ 2024 S02_HVESPG_ACR S02_PID 179-179;
SG_MUL_VAL_ 2024 S02_HVESPH_ACR S02_PID 179-179;
SG_MUL_VAL_ 2024 S02_HVESPA_Temp_SUP S02_PID 180-180;
SG_MUL_VAL_ 2024 S02_HVESPB_Temp_SUP S02_PID 180-180;
SG_MUL_VAL_ 2024 S02_HVESPC_Temp_SUP S02_PID 180-180;
SG_MUL_VAL_ 2024 S02_HVESPD_Temp_SUP S02_PID 180-180;
SG_MUL_VAL_ 2024 S02_HVESPE_Temp_SUP S02_PID 180-180;
SG_MUL_VAL_ 2024 S02_HVESPF_Temp_SUP S02_PID 180-180;
SG_MUL_VAL_ 2024 S02_HVESPG_Temp_SUP S02_PID 180-180;
SG_MUL_VAL_ 2024 S02_HVESPH_Temp_SUP S02_PID 180-180;
SG_MUL_VAL_ 2024 S02_HVESS_Temp S02_PID 180-180;
SG_MUL_VAL_ 2024 S02_HVESPA_Temp S02_PID 180-180;
SG_MUL_VAL_ 2024 S02_HVESPB_Temp S02_PID 180-180;
SG_MUL_VAL_ 2024 S02_HVESPC_Temp S02_PID 180-180;
SG_MUL_VAL_ 2024 S02_HVESPD_Temp S02_PID 180-180;
SG_MUL_VAL_ 2024 S02_HVESPE_Temp S02_PID 180-180;
SG_MUL_VAL_ 2024 S02_HVESPF_Temp S02_PID 180-180;
SG_MUL_VAL_ 2024 S02_HVESPG_Temp S02_PID 180-180;
SG_MUL_VAL_ 2024 S02_HVESPH_Temp S02_PID 180-180;
SG_MUL_VAL_ 2024 S02_HVESPA_Cur_SUP S02_PID 181-181;
SG_MUL_VAL_ 2024 S02_HVESPB_Cur_SUP S02_PID 181-181;
SG_MUL_VAL_ 2024 S02_HVESPC_Cur_SUP S02_PID 181-181;
SG_MUL_VAL_ 2024 S02_HVESPD_Cur_SUP S02_PID 181-181;
SG_MUL_VAL_ 2024 S02_HVESPE_Cur_SUP S02_PID 181-181;
SG_MUL_VAL_ 2024 S02_HVESPF_Cur_SUP S02_PID 181-181;
SG_MUL_VAL_ 2024 S02_HVESPG_Cur_SUP S02_PID 181-181;
SG_MUL_VAL_ 2024 S02_HVESPH_Cur_SUP S02_PID 181-181;
SG_MUL_VAL_ 2024 S02_HVESS_Cur S02_PID 181-181;
SG_MUL_VAL_ 2024 S02_HVESPA_Cur S02_PID 181-181;
SG_MUL_VAL_ 2024 S02_HVESPB_Cur S02_PID 181-181;
SG_MUL_VAL_ 2024 S02_HVESPC_Cur S02_PID 181-181;
SG_MUL_VAL_ 2024 S02_HVESPD_Cur S02_PID 181-181;
SG_MUL_VAL_ 2024 S02_HVESPE_Cur S02_PID 181-181;
SG_MUL_VAL_ 2024 S02_HVESPF_Cur S02_PID 181-181;
SG_MUL_VAL_ 2024 S02_HVESPG_Cur S02_PID 181-181;
SG_MUL_VAL_ 2024 S02_HVESPH_Cur S02_PID 181-181;
SG_MUL_VAL_ 2024 S02_HVESPA_Volt_SUP S02_PID 182-182;
SG_MUL_VAL_ 2024 S02_HVESPB_Volt_SUP S02_PID 182-182;
SG_MUL_VAL_ 2024 S02_HVESPC_Volt_SUP S02_PID 182-182;
SG_MUL_VAL_ 2024 S02_HVESPD_Volt_SUP S02_PID 182-182;
SG_MUL_VAL_ 2024 S02_HVESPE_Volt_SUP S02_PID 182-182;
SG_MUL_VAL_ 2024 S02_HVESPF_Volt_SUP S02_PID 182-182;
SG_MUL_VAL_ 2024 S02_HVESPG_Volt_SUP S02_PID 182-182;
SG_MUL_VAL_ 2024 S02_HVESPH_Volt_SUP S02_PID 182-182;
SG_MUL_VAL_ 2024 S02_HVESS_Volt S02_PID 182-182;
SG_MUL_VAL_ 2024 S02_HVESPA_Volt S02_PID 182-182;
SG_MUL_VAL_ 2024 S02_HVESPB_Volt S02_PID 182-182;
SG_MUL_VAL_ 2024 S02_HVESPC_Volt S02_PID 182-182;
SG_MUL_VAL_ 2024 S02_HVESPD_Volt S02_PID 182-182;
SG_MUL_VAL_ 2024 S02_HVESPE_Volt S02_PID 182-182;
SG_MUL_VAL_ 2024 S02_HVESPF_Volt S02_PID 182-182;
SG_MUL_VAL_ 2024 S02_HVESPG_Volt S02_PID 182-182;
SG_MUL_VAL_ 2024 S02_HVESPH_Volt S02_PID 182-182;
SG_MUL_VAL_ 2024 S02_HEV_Batt_Min_Cell_Temp_SUP S02_PID 183-183;
SG_MUL_VAL_ 2024 S02_HEV_Batt_Max_Cell_Temp_SUP S02_PID 183-183;
SG_MUL_VAL_ 2024 S02_HEV_Batt_Ave_Cell_Temp_SUP S02_PID 183-183;
SG_MUL_VAL_ 2024 S02_HEV_Batt_Bus_Bar_Temp_SUP S02_PID 183-183;
SG_MUL_VAL_ 2024 S02_HEV_Batt_Coolant_Temp_SUP S02_PID 183-183;
SG_MUL_VAL_ 2024 S02_HEV_Batt_Therm_Mode_SUP S02_PID 183-183;
SG_MUL_VAL_ 2024 S02_HEV_Batt_Min_Cell_Temp S02_PID 183-183;
SG_MUL_VAL_ 2024 S02_HEV_Batt_Max_Cell_Temp S02_PID 183-183;
SG_MUL_VAL_ 2024 S02_HEV_Batt_Ave_Cell_Temp S02_PID 183-183;
SG_MUL_VAL_ 2024 S02_HEV_Batt_Bus_Bar_Temp S02_PID 183-183;
SG_MUL_VAL_ 2024 S02_HEV_Batt_Coolant_Temp S02_PID 183-183;
SG_MUL_VAL_ 2024 S02_HEV_Batt_Therm_Mode S02_PID 183-183;
SG_MUL_VAL_ 2024 S02_HEV_Batt_Time_Since_Last_Balance S02_PID 184-184;
SG_MUL_VAL_ 2024 S02_HEV_Batt_Min_Cell_Voltage S02_PID 185-185;
SG_MUL_VAL_ 2024 S02_HEV_Batt_Max_Cell_Voltage S02_PID 185-185;
SG_MUL_VAL_ 2024 S02_HEV_Batt_PWR_Available S02_PID 186-186;
SG_MUL_VAL_ 2024 S02_HEV_Batt_Charge_Current_Limit S02_PID 186-186;
SG_MUL_VAL_ 2024 S02_HEV_Batt_Discharge_Current_Limit S02_PID 186-186;
SG_MUL_VAL_ 2024 S02_HVESPA_Enrg_In_SUP S02_PID 187-187;
SG_MUL_VAL_ 2024 S02_HVESPB_Enrg_In_SUP S02_PID 187-187;
SG_MUL_VAL_ 2024 S02_HVESPC_Enrg_In_SUP S02_PID 187-187;
SG_MUL_VAL_ 2024 S02_HVESPD_Enrg_In_SUP S02_PID 187-187;
SG_MUL_VAL_ 2024 S02_HVESPE_Enrg_In_SUP S02_PID 187-187;
SG_MUL_VAL_ 2024 S02_HVESPF_Enrg_In_SUP S02_PID 187-187;
SG_MUL_VAL_ 2024 S02_HVESPG_Enrg_In_SUP S02_PID 187-187;
SG_MUL_VAL_ 2024 S02_HVESPH_Enrg_In_SUP S02_PID 187-187;
SG_MUL_VAL_ 2024 S02_HVESS_Enrg_In S02_PID 187-187;
SG_MUL_VAL_ 2024 S02_HVESPA_Enrg_In S02_PID 187-187;
SG_MUL_VAL_ 2024 S02_HVESPB_Enrg_In S02_PID 187-187;
SG_MUL_VAL_ 2024 S02_HVESPC_Enrg_In S02_PID 187-187;
SG_MUL_VAL_ 2024 S02_HVESPD_Enrg_In S02_PID 187-187;
SG_MUL_VAL_ 2024 S02_HVESPE_Enrg_In S02_PID 187-187;
SG_MUL_VAL_ 2024 S02_HVESPF_Enrg_In S02_PID 187-187;
SG_MUL_VAL_ 2024 S02_HVESPG_Enrg_In S02_PID 187-187;
SG_MUL_VAL_ 2024 S02_HVESPH_Enrg_In S02_PID 187-187;
SG_MUL_VAL_ 2024 S02_HVESPA_Enrg_Out_SUP S02_PID 188-188;
SG_MUL_VAL_ 2024 S02_HVESPB_Enrg_Out_SUP S02_PID 188-188;
SG_MUL_VAL_ 2024 S02_HVESPC_Enrg_Out_SUP S02_PID 188-188;
SG_MUL_VAL_ 2024 S02_HVESPD_Enrg_Out_SUP S02_PID 188-188;
SG_MUL_VAL_ 2024 S02_HVESPE_Enrg_Out_SUP S02_PID 188-188;
SG_MUL_VAL_ 2024 S02_HVESPF_Enrg_Out_SUP S02_PID 188-188;
SG_MUL_VAL_ 2024 S02_HVESPG_Enrg_Out_SUP S02_PID 188-188;
SG_MUL_VAL_ 2024 S02_HVESPH_Enrg_Out_SUP S02_PID 188-188;
SG_MUL_VAL_ 2024 S02_HVESS_Enrg_Out S02_PID 188-188;
SG_MUL_VAL_ 2024 S02_HVESPA_Enrg_Out S02_PID 188-188;
SG_MUL_VAL_ 2024 S02_HVESPB_Enrg_Out S02_PID 188-188;
SG_MUL_VAL_ 2024 S02_HVESPC_Enrg_Out S02_PID 188-188;
SG_MUL_VAL_ 2024 S02_HVESPD_Enrg_Out S02_PID 188-188;
SG_MUL_VAL_ 2024 S02_HVESPE_Enrg_Out S02_PID 188-188;
SG_MUL_VAL_ 2024 S02_HVESPF_Enrg_Out S02_PID 188-188;
SG_MUL_VAL_ 2024 S02_HVESPG_Enrg_Out S02_PID 188-188;
SG_MUL_VAL_ 2024 S02_HVESPH_Enrg_Out S02_PID 188-188;
SG_MUL_VAL_ 2024 S02_HVESPA_Enrg_Tput_SUP S02_PID 189-189;
SG_MUL_VAL_ 2024 S02_HVESPB_Enrg_Tput_SUP S02_PID 189-189;
SG_MUL_VAL_ 2024 S02_HVESPC_Enrg_Tput_SUP S02_PID 189-189;
SG_MUL_VAL_ 2024 S02_HVESPD_Enrg_Tput_SUP S02_PID 189-189;
SG_MUL_VAL_ 2024 S02_HVESPE_Enrg_Tput_SUP S02_PID 189-189;
SG_MUL_VAL_ 2024 S02_HVESPF_Enrg_Tput_SUP S02_PID 189-189;
SG_MUL_VAL_ 2024 S02_HVESPG_Enrg_Tput_SUP S02_PID 189-189;
SG_MUL_VAL_ 2024 S02_HVESPH_Enrg_Tput_SUP S02_PID 189-189;
SG_MUL_VAL_ 2024 S02_HVESS_Enrg_Tput S02_PID 189-189;
SG_MUL_VAL_ 2024 S02_HVESPA_Enrg_Tput S02_PID 189-189;
SG_MUL_VAL_ 2024 S02_HVESPB_Enrg_Tput S02_PID 189-189;
SG_MUL_VAL_ 2024 S02_HVESPC_Enrg_Tput S02_PID 189-189;
SG_MUL_VAL_ 2024 S02_HVESPD_Enrg_Tput S02_PID 189-189;
SG_MUL_VAL_ 2024 S02_HVESPE_Enrg_Tput S02_PID 189-189;
SG_MUL_VAL_ 2024 S02_HVESPF_Enrg_Tput S02_PID 189-189;
SG_MUL_VAL_ 2024 S02_HVESPG_Enrg_Tput S02_PID 189-189;
SG_MUL_VAL_ 2024 S02_HVESPH_Enrg_Tput S02_PID 189-189;
SG_MUL_VAL_ 2024 S02_HVESPA_SOH_SUP S02_PID 190-190;
SG_MUL_VAL_ 2024 S02_HVESPB_SOH_SUP S02_PID 190-190;
SG_MUL_VAL_ 2024 S02_HVESPC_SOH_SUP S02_PID 190-190;
SG_MUL_VAL_ 2024 S02_HVESPD_SOH_SUP S02_PID 190-190;
SG_MUL_VAL_ 2024 S02_HVESPE_SOH_SUP S02_PID 190-190;
SG_MUL_VAL_ 2024 S02_HVESPF_SOH_SUP S02_PID 190-190;
SG_MUL_VAL_ 2024 S02_HVESPG_SOH_SUP S02_PID 190-190;
SG_MUL_VAL_ 2024 S02_HVESPH_SOH_SUP S02_PID 190-190;
SG_MUL_VAL_ 2024 S02_HVESS_SOH S02_PID 190-190;
SG_MUL_VAL_ 2024 S02_HVESPA_SOH S02_PID 190-190;
SG_MUL_VAL_ 2024 S02_HVESPB_SOH S02_PID 190-190;
SG_MUL_VAL_ 2024 S02_HVESPC_SOH S02_PID 190-190;
SG_MUL_VAL_ 2024 S02_HVESPD_SOH S02_PID 190-190;
SG_MUL_VAL_ 2024 S02_HVESPE_SOH S02_PID 190-190;
SG_MUL_VAL_ 2024 S02_HVESPF_SOH S02_PID 190-190;
SG_MUL_VAL_ 2024 S02_HVESPG_SOH S02_PID 190-190;
SG_MUL_VAL_ 2024 S02_HVESPH_SOH S02_PID 190-190;
SG_MUL_VAL_ 2024 S02_HVESPA_MIN_SOC_SUP S02_PID 191-191;
SG_MUL_VAL_ 2024 S02_HVESPB_MIN_SOC_SUP S02_PID 191-191;
SG_MUL_VAL_ 2024 S02_HVESPC_MIN_SOC_SUP S02_PID 191-191;
SG_MUL_VAL_ 2024 S02_HVESPD_MIN_SOC_SUP S02_PID 191-191;
SG_MUL_VAL_ 2024 S02_HVESPE_MIN_SOC_SUP S02_PID 191-191;
SG_MUL_VAL_ 2024 S02_HVESPF_MIN_SOC_SUP S02_PID 191-191;
SG_MUL_VAL_ 2024 S02_HVESPG_MIN_SOC_SUP S02_PID 191-191;
SG_MUL_VAL_ 2024 S02_HVESPH_MIN_SOC_SUP S02_PID 191-191;
SG_MUL_VAL_ 2024 S02_HVESS_MIN_SOC S02_PID 191-191;
SG_MUL_VAL_ 2024 S02_HVESPA_MIN_SOC S02_PID 191-191;
SG_MUL_VAL_ 2024 S02_HVESPB_MIN_SOC S02_PID 191-191;
SG_MUL_VAL_ 2024 S02_HVESPC_MIN_SOC S02_PID 191-191;
SG_MUL_VAL_ 2024 S02_HVESPD_MIN_SOC S02_PID 191-191;
SG_MUL_VAL_ 2024 S02_HVESPE_MIN_SOC S02_PID 191-191;
SG_MUL_VAL_ 2024 S02_HVESPF_MIN_SOC S02_PID 191-191;
SG_MUL_VAL_ 2024 S02_HVESPG_MIN_SOC S02_PID 191-191;
SG_MUL_VAL_ 2024 S02_HVESPH_MIN_SOC S02_PID 191-191;
SG_MUL_VAL_ 2024 S02_HVESPA_MAX_SOC_SUP S02_PID 193-193;
SG_MUL_VAL_ 2024 S02_HVESPB_MAX_SOC_SUP S02_PID 193-193;
SG_MUL_VAL_ 2024 S02_HVESPC_MAX_SOC_SUP S02_PID 193-193;
SG_MUL_VAL_ 2024 S02_HVESPD_MAX_SOC_SUP S02_PID 193-193;
SG_MUL_VAL_ 2024 S02_HVESPE_MAX_SOC_SUP S02_PID 193-193;
SG_MUL_VAL_ 2024 S02_HVESPF_MAX_SOC_SUP S02_PID 193-193;
SG_MUL_VAL_ 2024 S02_HVESPG_MAX_SOC_SUP S02_PID 193-193;
SG_MUL_VAL_ 2024 S02_HVESPH_MAX_SOC_SUP S02_PID 193-193;
SG_MUL_VAL_ 2024 S02_HVESS_MAX_SOC S02_PID 193-193;
SG_MUL_VAL_ 2024 S02_HVESPA_MAX_SOC S02_PID 193-193;
SG_MUL_VAL_ 2024 S02_HVESPB_MAX_SOC S02_PID 193-193;
SG_MUL_VAL_ 2024 S02_HVESPC_MAX_SOC S02_PID 193-193;
SG_MUL_VAL_ 2024 S02_HVESPD_MAX_SOC S02_PID 193-193;
SG_MUL_VAL_ 2024 S02_HVESPE_MAX_SOC S02_PID 193-193;
SG_MUL_VAL_ 2024 S02_HVESPF_MAX_SOC S02_PID 193-193;
SG_MUL_VAL_ 2024 S02_HVESPG_MAX_SOC S02_PID 193-193;
SG_MUL_VAL_ 2024 S02_HVESPH_MAX_SOC S02_PID 193-193;
SG_MUL_VAL_ 2024 S02_HVESPA_DEnrg_CAP_SUP S02_PID 194-194;
SG_MUL_VAL_ 2024 S02_HVESPB_DEnrg_CAP_SUP S02_PID 194-194;
SG_MUL_VAL_ 2024 S02_HVESPC_DEnrg_CAP_SUP S02_PID 194-194;
SG_MUL_VAL_ 2024 S02_HVESPD_DEnrg_CAP_SUP S02_PID 194-194;
SG_MUL_VAL_ 2024 S02_HVESPE_DEnrg_CAP_SUP S02_PID 194-194;
SG_MUL_VAL_ 2024 S02_HVESPF_DEnrg_CAP_SUP S02_PID 194-194;
SG_MUL_VAL_ 2024 S02_HVESPG_DEnrg_CAP_SUP S02_PID 194-194;
SG_MUL_VAL_ 2024 S02_HVESPH_DEnrg_CAP_SUP S02_PID 194-194;
SG_MUL_VAL_ 2024 S02_HVESS_DEnrg_CAP S02_PID 194-194;
SG_MUL_VAL_ 2024 S02_HVESPA_DEnrg_CAP S02_PID 194-194;
SG_MUL_VAL_ 2024 S02_HVESPB_DEnrg_CAP S02_PID 194-194;
SG_MUL_VAL_ 2024 S02_HVESPC_DEnrg_CAP S02_PID 194-194;
SG_MUL_VAL_ 2024 S02_HVESPD_DEnrg_CAP S02_PID 194-194;
SG_MUL_VAL_ 2024 S02_HVESPE_DEnrg_CAP S02_PID 194-194;
SG_MUL_VAL_ 2024 S02_HVESPF_DEnrg_CAP S02_PID 194-194;
SG_MUL_VAL_ 2024 S02_HVESPG_DEnrg_CAP S02_PID 194-194;
SG_MUL_VAL_ 2024 S02_HVESPH_DEnrg_CAP S02_PID 194-194;
SG_MUL_VAL_ 2024 S02_FLI_A_SUP S02_PID 195-195;
SG_MUL_VAL_ 2024 S02_FLI_B_SUP S02_PID 195-195;
SG_MUL_VAL_ 2024 S02_FLI_A S02_PID 195-195;
SG_MUL_VAL_ 2024 S02_FLI_B S02_PID 195-195;
SG_MUL_VAL_ 2024 S02_EXH_PM_TIME S02_PID 196-196;
SG_MUL_VAL_ 2024 S02_EXH_PM_OCC_CNT S02_PID 196-196;
SG_MUL_VAL_ 2024 S02_LFP_A_SUP S02_PID 197-197;
SG_MUL_VAL_ 2024 S02_LFP_B_SUP S02_PID 197-197;
SG_MUL_VAL_ 2024 S02_LFP_A S02_PID 197-197;
SG_MUL_VAL_ 2024 S02_LFP_B S02_PID 197-197;
SG_MUL_VAL_ 2024 S02_PM_WARN_ACT_SUP S02_PID 198-198;
SG_MUL_VAL_ 2024 S02_DPF_REMOVAL_BLOCKED_TIME_SUP S02_PID 198-198;
SG_MUL_VAL_ 2024 S02_LRIS_FAILURE_TIME_SUP S02_PID 198-198;
SG_MUL_VAL_ 2024 S02_PCD_FAILURE_TIME_SUP S02_PID 198-198;
SG_MUL_VAL_ 2024 S02_PM_WARN_ACT S02_PID 198-198;
SG_MUL_VAL_ 2024 S02_PCL_INDUC_L1 S02_PID 198-198;
SG_MUL_VAL_ 2024 S02_PCL_INDUC_L2 S02_PID 198-198;
SG_MUL_VAL_ 2024 S02_PCL_INDUC_L3 S02_PID 198-198;
SG_MUL_VAL_ 2024 S02_DPF_REMOVAL_BLOCKED_TIME S02_PID 198-198;
SG_MUL_VAL_ 2024 S02_LRIS_FAILURE_TIME S02_PID 198-198;
SG_MUL_VAL_ 2024 S02_PCD_FAILURE_TIME S02_PID 198-198;
SG_MUL_VAL_ 2024 S02_REFLASH_DIST S02_PID 199-199;
SG_MUL_VAL_ 2024 S02_NCD_PCD_WL S02_PID 200-200;
SG_MUL_VAL_ 2024 S02_NCD_WL S02_PID 200-200;
SG_MUL_VAL_ 2024 S02_PCD_WL S02_PID 200-200;
SG_MUL_VAL_ 2024 S02_O2S15_PCT_SUP S02_PID 201-201;
SG_MUL_VAL_ 2024 S02_O2S16_PCT_SUP S02_PID 201-201;
SG_MUL_VAL_ 2024 S02_O2S25_PCT_SUP S02_PID 201-201;
SG_MUL_VAL_ 2024 S02_O2S26_PCT_SUP S02_PID 201-201;
SG_MUL_VAL_ 2024 S02_O2S15_PCT_LAMBDA_SUP S02_PID 201-201;
SG_MUL_VAL_ 2024 S02_O2S16_PCT_LAMBDA_SUP S02_PID 201-201;
SG_MUL_VAL_ 2024 S02_O2S25_PCT_LAMBDA_SUP S02_PID 201-201;
SG_MUL_VAL_ 2024 S02_O2S26_PCT_LAMBDA_SUP S02_PID 201-201;
SG_MUL_VAL_ 2024 S02_O2S15_PCT S02_PID 201-201;
SG_MUL_VAL_ 2024 S02_O2S16_PCT S02_PID 201-201;
SG_MUL_VAL_ 2024 S02_O2S25_PCT S02_PID 201-201;
SG_MUL_VAL_ 2024 S02_O2S26_PCT S02_PID 201-201;
SG_MUL_VAL_ 2024 S02_O2S15_PCT_LAMBDA S02_PID 201-201;
SG_MUL_VAL_ 2024 S02_O2S16_PCT_LAMBDA S02_PID 201-201;
SG_MUL_VAL_ 2024 S02_O2S25_PCT_LAMBDA S02_PID 201-201;
SG_MUL_VAL_ 2024 S02_O2S26_PCT_LAMBDA S02_PID 201-201;
SG_MUL_VAL_ 2024 S02_TIME_TO_INDUC_L1_SUP S02_PID 202-202;
SG_MUL_VAL_ 2024 S02_TIME_TO_INDUC_L2_SUP S02_PID 202-202;
SG_MUL_VAL_ 2024 S02_TIME_TO_INDUC_L3_SUP S02_PID 202-202;
SG_MUL_VAL_ 2024 S02_TIME_TO_INDUC_L1 S02_PID 202-202;
SG_MUL_VAL_ 2024 S02_TIME_TO_INDUC_L2 S02_PID 202-202;
SG_MUL_VAL_ 2024 S02_TIME_TO_INDUC_L3 S02_PID 202-202;
SG_MUL_VAL_ 2024 S02_EP_12_SUP S02_PID 203-203;
SG_MUL_VAL_ 2024 S02_EP_22_SUP S02_PID 203-203;
SG_MUL_VAL_ 2024 S02_EP_12 S02_PID 203-203;
SG_MUL_VAL_ 2024 S02_EP_22 S02_PID 203-203;
SG_MUL_VAL_ 2024 S02_EM_A_RPM_SUP S02_PID 204-204;
SG_MUL_VAL_ 2024 S02_EM_B_RPM_SUP S02_PID 204-204;
SG_MUL_VAL_ 2024 S02_EM_C_RPM_SUP S02_PID 204-204;
SG_MUL_VAL_ 2024 S02_EM_D_RPM_SUP S02_PID 204-204;
SG_MUL_VAL_ 2024 S02_EM_E_RPM_SUP S02_PID 204-204;
SG_MUL_VAL_ 2024 S02_EM_F_RPM_SUP S02_PID 204-204;
SG_MUL_VAL_ 2024 S02_EM_G_RPM_SUP S02_PID 204-204;
SG_MUL_VAL_ 2024 S02_EM_H_RPM_SUP S02_PID 204-204;
SG_MUL_VAL_ 2024 S02_EM_A_RPM S02_PID 204-204;
SG_MUL_VAL_ 2024 S02_EM_B_RPM S02_PID 204-204;
SG_MUL_VAL_ 2024 S02_EM_C_RPM S02_PID 204-204;
SG_MUL_VAL_ 2024 S02_EM_D_RPM S02_PID 204-204;
SG_MUL_VAL_ 2024 S02_EM_E_RPM S02_PID 204-204;
SG_MUL_VAL_ 2024 S02_EM_F_RPM S02_PID 204-204;
SG_MUL_VAL_ 2024 S02_EM_G_RPM S02_PID 204-204;
SG_MUL_VAL_ 2024 S02_EM_H_RPM S02_PID 204-204;
SG_MUL_VAL_ 2024 S02_EM_A_TQ_SUP S02_PID 205-205;
SG_MUL_VAL_ 2024 S02_EM_B_TQ_SUP S02_PID 205-205;
SG_MUL_VAL_ 2024 S02_EM_C_TQ_SUP S02_PID 205-205;
SG_MUL_VAL_ 2024 S02_EM_D_TQ_SUP S02_PID 205-205;
SG_MUL_VAL_ 2024 S02_EM_E_TQ_SUP S02_PID 205-205;
SG_MUL_VAL_ 2024 S02_EM_F_TQ_SUP S02_PID 205-205;
SG_MUL_VAL_ 2024 S02_EM_G_TQ_SUP S02_PID 205-205;
SG_MUL_VAL_ 2024 S02_EM_H_TQ_SUP S02_PID 205-205;
SG_MUL_VAL_ 2024 S02_EM_A_TQ S02_PID 205-205;
SG_MUL_VAL_ 2024 S02_EM_B_TQ S02_PID 205-205;
SG_MUL_VAL_ 2024 S02_EM_C_TQ S02_PID 205-205;
SG_MUL_VAL_ 2024 S02_EM_D_TQ S02_PID 205-205;
SG_MUL_VAL_ 2024 S02_EM_E_TQ S02_PID 205-205;
SG_MUL_VAL_ 2024 S02_EM_F_TQ S02_PID 205-205;
SG_MUL_VAL_ 2024 S02_EM_G_TQ S02_PID 205-205;
SG_MUL_VAL_ 2024 S02_EM_H_TQ S02_PID 205-205;
SG_MUL_VAL_ 2024 DTCNUM SID 3-3;
SG_MUL_VAL_ 2024 DTC0_TYPE SID 3-3;
SG_MUL_VAL_ 2024 DTC0_VAL SID 3-3;
SG_MUL_VAL_ 2024 DTC1_TYPE SID 3-3;
SG_MUL_VAL_ 2024 DTC1_VAL SID 3-3;
SG_MUL_VAL_ 2024 DTC2_TYPE SID 3-3;
SG_MUL_VAL_ 2024 DTC2_VAL SID 3-3;
SG_MUL_VAL_ 2024 DTC3_TYPE SID 3-3;
SG_MUL_VAL_ 2024 DTC3_VAL SID 3-3;
SG_MUL_VAL_ 2024 DTC4_TYPE SID 3-3;
SG_MUL_VAL_ 2024 DTC4_VAL SID 3-3;
SG_MUL_VAL_ 2024 DTC5_TYPE SID 3-3;
SG_MUL_VAL_ 2024 DTC5_VAL SID 3-3;
SG_MUL_VAL_ 2024 DTC6_TYPE SID 3-3;
SG_MUL_VAL_ 2024 DTC6_VAL SID 3-3;
SG_MUL_VAL_ 2024 DTC7_TYPE SID 3-3;
SG_MUL_VAL_ 2024 DTC7_VAL SID 3-3;
SG_MUL_VAL_ 2024 DTC8_TYPE SID 3-3;
SG_MUL_VAL_ 2024 DTC8_VAL SID 3-3;
SG_MUL_VAL_ 2024 DTC9_TYPE SID 3-3;
SG_MUL_VAL_ 2024 DTC9_VAL SID 3-3;
SG_MUL_VAL_ 2024 DTC10_TYPE SID 3-3;
SG_MUL_VAL_ 2024 DTC10_VAL SID 3-3;
SG_MUL_VAL_ 2024 DTC11_TYPE SID 3-3;
SG_MUL_VAL_ 2024 DTC11_VAL SID 3-3;
SG_MUL_VAL_ 2024 DTC12_TYPE SID 3-3;
SG_MUL_VAL_ 2024 DTC12_VAL SID 3-3;
SG_MUL_VAL_ 2024 DTC13_TYPE SID 3-3;
SG_MUL_VAL_ 2024 DTC13_VAL SID 3-3;
SG_MUL_VAL_ 2024 DTC14_TYPE SID 3-3;
SG_MUL_VAL_ 2024 DTC14_VAL SID 3-3;
SG_MUL_VAL_ 2024 DTC15_TYPE SID 3-3;
SG_MUL_VAL_ 2024 DTC15_VAL SID 3-3;
SG_MUL_VAL_ 2024 DTC16_TYPE SID 3-3;
SG_MUL_VAL_ 2024 DTC16_VAL SID 3-3;
SG_MUL_VAL_ 2024 DTC17_TYPE SID 3-3;
SG_MUL_VAL_ 2024 DTC17_VAL SID 3-3;
SG_MUL_VAL_ 2024 DTC18_TYPE SID 3-3;
SG_MUL_VAL_ 2024 DTC18_VAL SID 3-3;
SG_MUL_VAL_ 2024 DTC19_TYPE SID 3-3;
SG_MUL_VAL_ 2024 DTC19_VAL SID 3-3;
SG_MUL_VAL_ 2024 DTC20_TYPE SID 3-3;
SG_MUL_VAL_ 2024 DTC20_VAL SID 3-3;
SG_MUL_VAL_ 2024 DTC21_TYPE SID 3-3;
SG_MUL_VAL_ 2024 DTC21_VAL SID 3-3;
SG_MUL_VAL_ 2024 DTC22_TYPE SID 3-3;
SG_MUL_VAL_ 2024 DTC22_VAL SID 3-3;
SG_MUL_VAL_ 2024 DTC23_TYPE SID 3-3;
SG_MUL_VAL_ 2024 DTC23_VAL SID 3-3;
SG_MUL_VAL_ 2024 DTC24_TYPE SID 3-3;
SG_MUL_VAL_ 2024 DTC24_VAL SID 3-3;
SG_MUL_VAL_ 2024 DTC25_TYPE SID 3-3;
SG_MUL_VAL_ 2024 DTC25_VAL SID 3-3;
SG_MUL_VAL_ 2024 DTC26_TYPE SID 3-3;
SG_MUL_VAL_ 2024 DTC26_VAL SID 3-3;
SG_MUL_VAL_ 2024 DTC27_TYPE SID 3-3;
SG_MUL_VAL_ 2024 DTC27_VAL SID 3-3;
SG_MUL_VAL_ 2024 DTC28_TYPE SID 3-3;
SG_MUL_VAL_ 2024 DTC28_VAL SID 3-3;
SG_MUL_VAL_ 2024 DTC29_TYPE SID 3-3;
SG_MUL_VAL_ 2024 DTC29_VAL SID 3-3;
SG_MUL_VAL_ 2024 MC_VIN S09_PID 1-1;
SG_MUL_VAL_ 2024 VIN S09_PID 2-2;
SG_MUL_VAL_ 2024 MC_CALID S09_PID 3-3;
SG_MUL_VAL_ 2024 CALID S09_PID 4-4;
SG_MUL_VAL_ 2024 MC_CVN S09_PID 5-5;
SG_MUL_VAL_ 2024 CVN S09_PID 6-6;
SG_MUL_VAL_ 2024 MC_IPT S09_PID 7-7;
SG_MUL_VAL_ 2024 IPT_OBDCOND S09_PID 8-8;
SG_MUL_VAL_ 2024 IPT_IGNCNTR S09_PID 8-8;
SG_MUL_VAL_ 2024 IPT_CATCOMP1 S09_PID 8-8;
SG_MUL_VAL_ 2024 IPT_CATCOND1 S09_PID 8-8;
SG_MUL_VAL_ 2024 IPT_CATCOMP2 S09_PID 8-8;
SG_MUL_VAL_ 2024 IPT_CATCOND2 S09_PID 8-8;
SG_MUL_VAL_ 2024 IPT_O2SCOMP1 S09_PID 8-8;
SG_MUL_VAL_ 2024 IPT_O2SCOND1 S09_PID 8-8;
SG_MUL_VAL_ 2024 IPT_O2SCOMP2 S09_PID 8-8;
SG_MUL_VAL_ 2024 IPT_O2SCOND2 S09_PID 8-8;
SG_MUL_VAL_ 2024 IPT_EGRCOMP S09_PID 8-8;
SG_MUL_VAL_ 2024 IPT_EGRCOND S09_PID 8-8;
SG_MUL_VAL_ 2024 IPT_AIRCOMP S09_PID 8-8;
SG_MUL_VAL_ 2024 IPT_AIRCOND S09_PID 8-8;
SG_MUL_VAL_ 2024 IPT_EVAPCOMP S09_PID 8-8;
SG_MUL_VAL_ 2024 IPT_EVAPCOND S09_PID 8-8;
SG_MUL_VAL_ 2024 IPT_SO2SCOMP1 S09_PID 8-8;
SG_MUL_VAL_ 2024 IPT_SO2SCOND1 S09_PID 8-8;
SG_MUL_VAL_ 2024 IPT_SO2SCOMP2 S09_PID 8-8;
SG_MUL_VAL_ 2024 IPT_SO2SCOND2 S09_PID 8-8;
SG_MUL_VAL_ 2024 IPT_AFRICOMP1 S09_PID 8-8;
SG_MUL_VAL_ 2024 IPT_AFRICOND1 S09_PID 8-8;
SG_MUL_VAL_ 2024 IPT_AFRICOMP2 S09_PID 8-8;
SG_MUL_VAL_ 2024 IPT_AFRICOND2 S09_PID 8-8;
SG_MUL_VAL_ 2024 IPT_PFCOMP1 S09_PID 8-8;
SG_MUL_VAL_ 2024 IPT_PFCOND1 S09_PID 8-8;
SG_MUL_VAL_ 2024 IPT_PFCOMP2 S09_PID 8-8;
SG_MUL_VAL_ 2024 IPT_PFCOND2 S09_PID 8-8;

VAL_ 2024 DTC0_TYPE 0 "P" 1 "C" 2 "B" 3 "U" ;
VAL_ 2024 DTC1_TYPE 0 "P" 1 "C" 2 "B" 3 "U" ;
VAL_ 2024 DTC2_TYPE 0 "P" 1 "C" 2 "B" 3 "U" ;
VAL_ 2024 DTC3_TYPE 0 "P" 1 "C" 2 "B" 3 "U" ;
VAL_ 2024 DTC4_TYPE 0 "P" 1 "C" 2 "B" 3 "U" ;
VAL_ 2024 DTC5_TYPE 0 "P" 1 "C" 2 "B" 3 "U" ;
VAL_ 2024 DTC6_TYPE 0 "P" 1 "C" 2 "B" 3 "U" ;
VAL_ 2024 DTC7_TYPE 0 "P" 1 "C" 2 "B" 3 "U" ;
VAL_ 2024 DTC8_TYPE 0 "P" 1 "C" 2 "B" 3 "U" ;
VAL_ 2024 DTC9_TYPE 0 "P" 1 "C" 2 "B" 3 "U" ;
VAL_ 2024 DTC10_TYPE 0 "P" 1 "C" 2 "B" 3 "U" ;
VAL_ 2024 DTC11_TYPE 0 "P" 1 "C" 2 "B" 3 "U" ;
VAL_ 2024 DTC12_TYPE 0 "P" 1 "C" 2 "B" 3 "U" ;
VAL_ 2024 DTC13_TYPE 0 "P" 1 "C" 2 "B" 3 "U" ;
VAL_ 2024 DTC14_TYPE 0 "P" 1 "C" 2 "B" 3 "U" ;
VAL_ 2024 DTC15_TYPE 0 "P" 1 "C" 2 "B" 3 "U" ;
VAL_ 2024 DTC16_TYPE 0 "P" 1 "C" 2 "B" 3 "U" ;
VAL_ 2024 DTC17_TYPE 0 "P" 1 "C" 2 "B" 3 "U" ;
VAL_ 2024 DTC18_TYPE 0 "P" 1 "C" 2 "B" 3 "U" ;
VAL_ 2024 DTC19_TYPE 0 "P" 1 "C" 2 "B" 3 "U" ;
VAL_ 2024 DTC20_TYPE 0 "P" 1 "C" 2 "B" 3 "U" ;
VAL_ 2024 DTC21_TYPE 0 "P" 1 "C" 2 "B" 3 "U" ;
VAL_ 2024 DTC22_TYPE 0 "P" 1 "C" 2 "B" 3 "U" ;
VAL_ 2024 DTC23_TYPE 0 "P" 1 "C" 2 "B" 3 "U" ;
VAL_ 2024 DTC24_TYPE 0 "P" 1 "C" 2 "B" 3 "U" ;
VAL_ 2024 DTC25_TYPE 0 "P" 1 "C" 2 "B" 3 "U" ;
VAL_ 2024 DTC26_TYPE 0 "P" 1 "C" 2 "B" 3 "U" ;
VAL_ 2024 DTC27_TYPE 0 "P" 1 "C" 2 "B" 3 "U" ;
VAL_ 2024 DTC28_TYPE 0 "P" 1 "C" 2 "B" 3 "U" ;
VAL_ 2024 DTC29_TYPE 0 "P" 1 "C" 2 "B" 3 "U" ;
