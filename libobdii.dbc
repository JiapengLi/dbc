VERSION "v0.0.1"

NS_ :

BS_:

BU_:

BO_ 2024 RX: 64 ECU
 SG_ RXLEN : 0|8@1+ (1,0) [0|0] "" TOOL
 SG_ SERVICE M : 8|4@1+ (1,0) [0|0] "" TOOL
 SG_ RXACK : 12|4@1+ (1,0) [0|0] "" TOOL
 SG_ S01_PID m1M : 16|8@1+ (1,0) [0|0] "" TOOL
 SG_ S02_PID m2M : 16|8@1+ (1,0) [0|0] "" TOOL
 SG_ S03_PID m3M : 16|8@1+ (1,0) [0|0] "" TOOL
 SG_ S04_PID m4M : 16|8@1+ (1,0) [0|0] "" TOOL
 SG_ S05_PID m5M : 16|8@1+ (1,0) [0|0] "" TOOL
 SG_ S06_PID m6M : 16|8@1+ (1,0) [0|0] "" TOOL
 SG_ S07_PID m7M : 16|8@1+ (1,0) [0|0] "" TOOL
 SG_ S08_PID m8M : 16|8@1+ (1,0) [0|0] "" TOOL
 SG_ S09_PID m9M : 16|8@1+ (1,0) [0|0] "" TOOL
 SG_ S0A_PID m10M : 16|8@1+ (1,0) [0|0] "" TOOL
 SG_ S01_PID00_SupportedIDs_01_20 m0 : 24|32@1+ (1,0) [0|0] "" TOOL
 SG_ S02_PID00_SupportedIDs_01_20 m0 : 24|32@1+ (1,0) [0|0] "" TOOL
 SG_ S03_PID00_SupportedIDs_01_20 m0 : 24|32@1+ (1,0) [0|0] "" TOOL
 SG_ S04_PID00_SupportedIDs_01_20 m0 : 24|32@1+ (1,0) [0|0] "" TOOL
 SG_ S05_PID00_SupportedIDs_01_20 m0 : 24|32@1+ (1,0) [0|0] "" TOOL
 SG_ S06_PID00_SupportedIDs_01_20 m0 : 24|32@1+ (1,0) [0|0] "" TOOL
 SG_ S07_PID00_SupportedIDs_01_20 m0 : 24|32@1+ (1,0) [0|0] "" TOOL
 SG_ S08_PID00_SupportedIDs_01_20 m0 : 24|32@1+ (1,0) [0|0] "" TOOL
 SG_ S09_PID00_SupportedIDs_01_20 m0 : 24|32@1+ (1,0) [0|0] "" TOOL
 SG_ S0A_PID00_SupportedIDs_01_20 m0 : 24|32@1+ (1,0) [0|0] "" TOOL
 SG_ S01_PID20_SupportedIDs_21_40 m32 : 24|32@1+ (1,0) [0|0] "" TOOL
 SG_ S02_PID20_SupportedIDs_21_40 m32 : 24|32@1+ (1,0) [0|0] "" TOOL
 SG_ S03_PID20_SupportedIDs_21_40 m32 : 24|32@1+ (1,0) [0|0] "" TOOL
 SG_ S04_PID20_SupportedIDs_21_40 m32 : 24|32@1+ (1,0) [0|0] "" TOOL
 SG_ S05_PID20_SupportedIDs_21_40 m32 : 24|32@1+ (1,0) [0|0] "" TOOL
 SG_ S06_PID20_SupportedIDs_21_40 m32 : 24|32@1+ (1,0) [0|0] "" TOOL
 SG_ S07_PID20_SupportedIDs_21_40 m32 : 24|32@1+ (1,0) [0|0] "" TOOL
 SG_ S08_PID20_SupportedIDs_21_40 m32 : 24|32@1+ (1,0) [0|0] "" TOOL
 SG_ S09_PID20_SupportedIDs_21_40 m32 : 24|32@1+ (1,0) [0|0] "" TOOL
 SG_ S0A_PID20_SupportedIDs_21_40 m32 : 24|32@1+ (1,0) [0|0] "" TOOL
 SG_ S01_PID40_SupportedIDs_41_60 m64 : 24|32@1+ (1,0) [0|0] "" TOOL
 SG_ S02_PID40_SupportedIDs_41_60 m64 : 24|32@1+ (1,0) [0|0] "" TOOL
 SG_ S03_PID40_SupportedIDs_41_60 m64 : 24|32@1+ (1,0) [0|0] "" TOOL
 SG_ S04_PID40_SupportedIDs_41_60 m64 : 24|32@1+ (1,0) [0|0] "" TOOL
 SG_ S05_PID40_SupportedIDs_41_60 m64 : 24|32@1+ (1,0) [0|0] "" TOOL
 SG_ S06_PID40_SupportedIDs_41_60 m64 : 24|32@1+ (1,0) [0|0] "" TOOL
 SG_ S07_PID40_SupportedIDs_41_60 m64 : 24|32@1+ (1,0) [0|0] "" TOOL
 SG_ S08_PID40_SupportedIDs_41_60 m64 : 24|32@1+ (1,0) [0|0] "" TOOL
 SG_ S09_PID40_SupportedIDs_41_60 m64 : 24|32@1+ (1,0) [0|0] "" TOOL
 SG_ S0A_PID40_SupportedIDs_41_60 m64 : 24|32@1+ (1,0) [0|0] "" TOOL
 SG_ S01_PID60_SupportedIDs_61_80 m96 : 24|32@1+ (1,0) [0|0] "" TOOL
 SG_ S02_PID60_SupportedIDs_61_80 m96 : 24|32@1+ (1,0) [0|0] "" TOOL
 SG_ S03_PID60_SupportedIDs_61_80 m96 : 24|32@1+ (1,0) [0|0] "" TOOL
 SG_ S04_PID60_SupportedIDs_61_80 m96 : 24|32@1+ (1,0) [0|0] "" TOOL
 SG_ S05_PID60_SupportedIDs_61_80 m96 : 24|32@1+ (1,0) [0|0] "" TOOL
 SG_ S06_PID60_SupportedIDs_61_80 m96 : 24|32@1+ (1,0) [0|0] "" TOOL
 SG_ S07_PID60_SupportedIDs_61_80 m96 : 24|32@1+ (1,0) [0|0] "" TOOL
 SG_ S08_PID60_SupportedIDs_61_80 m96 : 24|32@1+ (1,0) [0|0] "" TOOL
 SG_ S09_PID60_SupportedIDs_61_80 m96 : 24|32@1+ (1,0) [0|0] "" TOOL
 SG_ S0A_PID60_SupportedIDs_61_80 m96 : 24|32@1+ (1,0) [0|0] "" TOOL
 SG_ S01_PID80_SupportedIDs_81_A0 m128 : 24|32@1+ (1,0) [0|0] "" TOOL
 SG_ S02_PID80_SupportedIDs_81_A0 m128 : 24|32@1+ (1,0) [0|0] "" TOOL
 SG_ S03_PID80_SupportedIDs_81_A0 m128 : 24|32@1+ (1,0) [0|0] "" TOOL
 SG_ S04_PID80_SupportedIDs_81_A0 m128 : 24|32@1+ (1,0) [0|0] "" TOOL
 SG_ S05_PID80_SupportedIDs_81_A0 m128 : 24|32@1+ (1,0) [0|0] "" TOOL
 SG_ S06_PID80_SupportedIDs_81_A0 m128 : 24|32@1+ (1,0) [0|0] "" TOOL
 SG_ S07_PID80_SupportedIDs_81_A0 m128 : 24|32@1+ (1,0) [0|0] "" TOOL
 SG_ S08_PID80_SupportedIDs_81_A0 m128 : 24|32@1+ (1,0) [0|0] "" TOOL
 SG_ S09_PID80_SupportedIDs_81_A0 m128 : 24|32@1+ (1,0) [0|0] "" TOOL
 SG_ S0A_PID80_SupportedIDs_81_A0 m128 : 24|32@1+ (1,0) [0|0] "" TOOL
 SG_ S01_PIDA0_SupportedIDs_A1_C0 m160 : 24|32@1+ (1,0) [0|0] "" TOOL
 SG_ S02_PIDA0_SupportedIDs_A1_C0 m160 : 24|32@1+ (1,0) [0|0] "" TOOL
 SG_ S03_PIDA0_SupportedIDs_A1_C0 m160 : 24|32@1+ (1,0) [0|0] "" TOOL
 SG_ S04_PIDA0_SupportedIDs_A1_C0 m160 : 24|32@1+ (1,0) [0|0] "" TOOL
 SG_ S05_PIDA0_SupportedIDs_A1_C0 m160 : 24|32@1+ (1,0) [0|0] "" TOOL
 SG_ S06_PIDA0_SupportedIDs_A1_C0 m160 : 24|32@1+ (1,0) [0|0] "" TOOL
 SG_ S07_PIDA0_SupportedIDs_A1_C0 m160 : 24|32@1+ (1,0) [0|0] "" TOOL
 SG_ S08_PIDA0_SupportedIDs_A1_C0 m160 : 24|32@1+ (1,0) [0|0] "" TOOL
 SG_ S09_PIDA0_SupportedIDs_A1_C0 m160 : 24|32@1+ (1,0) [0|0] "" TOOL
 SG_ S0A_PIDA0_SupportedIDs_A1_C0 m160 : 24|32@1+ (1,0) [0|0] "" TOOL
 SG_ S01_PIDC0_SupportedIDs_C1_E0 m192 : 24|32@1+ (1,0) [0|0] "" TOOL
 SG_ S02_PIDC0_SupportedIDs_C1_E0 m192 : 24|32@1+ (1,0) [0|0] "" TOOL
 SG_ S03_PIDC0_SupportedIDs_C1_E0 m192 : 24|32@1+ (1,0) [0|0] "" TOOL
 SG_ S04_PIDC0_SupportedIDs_C1_E0 m192 : 24|32@1+ (1,0) [0|0] "" TOOL
 SG_ S05_PIDC0_SupportedIDs_C1_E0 m192 : 24|32@1+ (1,0) [0|0] "" TOOL
 SG_ S06_PIDC0_SupportedIDs_C1_E0 m192 : 24|32@1+ (1,0) [0|0] "" TOOL
 SG_ S07_PIDC0_SupportedIDs_C1_E0 m192 : 24|32@1+ (1,0) [0|0] "" TOOL
 SG_ S08_PIDC0_SupportedIDs_C1_E0 m192 : 24|32@1+ (1,0) [0|0] "" TOOL
 SG_ S09_PIDC0_SupportedIDs_C1_E0 m192 : 24|32@1+ (1,0) [0|0] "" TOOL
 SG_ S0A_PIDC0_SupportedIDs_C1_E0 m192 : 24|32@1+ (1,0) [0|0] "" TOOL
 SG_ DTC_CNT m1 : 24|7@1+ (1,0) [0|0] "" TOOL
 SG_ MIL m1 : 31|1@1+ (1,0) [0|0] "" TOOL
 SG_ MIS_SUP m1 : 32|1@1+ (1,0) [0|0] "" TOOL
 SG_ FUEL_SUP m1 : 33|1@1+ (1,0) [0|0] "" TOOL
 SG_ CCM_SUP m1 : 34|1@1+ (1,0) [0|0] "" TOOL
 SG_ CIM_SUP m1M : 35|1@1+ (1,0) [0|0] "" TOOL
 SG_ MIS_RDY m1 : 36|1@1+ (1,0) [0|0] "" TOOL
 SG_ FUEL_RDY m1 : 37|1@1+ (1,0) [0|0] "" TOOL
 SG_ CCM_RDY m1 : 38|1@1+ (1,0) [0|0] "" TOOL
 SG_ CAT_SUP m0 : 40|1@1+ (1,0) [0|0] "" TOOL
 SG_ HCAT_SUP m0 : 41|1@1+ (1,0) [0|0] "" TOOL
 SG_ EVAP_SUP m0 : 42|1@1+ (1,0) [0|0] "" TOOL
 SG_ AIR_SUP m0 : 43|1@1+ (1,0) [0|0] "" TOOL
 SG_ GPF_SUP m0 : 44|1@1+ (1,0) [0|0] "" TOOL
 SG_ O2S_SUP m0 : 45|1@1+ (1,0) [0|0] "" TOOL
 SG_ HTR_SUP m0 : 46|1@1+ (1,0) [0|0] "" TOOL
 SG_ EGR_SUP m0 : 47|1@1+ (1,0) [0|0] "" TOOL
 SG_ CAT_RDY m0 : 48|1@1+ (1,0) [0|0] "" TOOL
 SG_ HCAT_RDY m0 : 49|1@1+ (1,0) [0|0] "" TOOL
 SG_ EVAP_RDY m0 : 50|1@1+ (1,0) [0|0] "" TOOL
 SG_ AIR_RDY m0 : 51|1@1+ (1,0) [0|0] "" TOOL
 SG_ GPF_RDY m0 : 52|1@1+ (1,0) [0|0] "" TOOL
 SG_ O2S_RDY m0 : 53|1@1+ (1,0) [0|0] "" TOOL
 SG_ HTR_RDY m0 : 54|1@1+ (1,0) [0|0] "" TOOL
 SG_ EGR_RDY m0 : 55|1@1+ (1,0) [0|0] "" TOOL
 SG_ HCCATSUP m1 : 56|1@1+ (1,0) [0|0] "" TOOL
 SG_ NCAT_SUP m1 : 57|1@1+ (1,0) [0|0] "" TOOL
 SG_ BP_SUP m1 : 59|1@1+ (1,0) [0|0] "" TOOL
 SG_ EGS_SUP m1 : 61|1@1+ (1,0) [0|0] "" TOOL
 SG_ PM_SUP m1 : 62|1@1+ (1,0) [0|0] "" TOOL
 SG_ HCCATRDY m1 : 64|1@1+ (1,0) [0|0] "" TOOL
 SG_ NCAT_RDY m1 : 65|1@1+ (1,0) [0|0] "" TOOL
 SG_ BP_RDY m1 : 67|1@1+ (1,0) [0|0] "" TOOL
 SG_ EGS_RDY m1 : 69|1@1+ (1,0) [0|0] "" TOOL
 SG_ PM_RDY m1 : 70|1@1+ (1,0) [0|0] "" TOOL
 SG_ DTCFRZF m2 : 31|16@0+ (1,0) [0|0] "" TOOL
 SG_ FUELSYSA_OL m3 : 24|1@1+ (1,0) [0|0] "" TOOL
 SG_ FUELSYSA_CL m3 : 25|1@1+ (1,0) [0|0] "" TOOL
 SG_ FUELSYSA_OL_Drive m3 : 26|1@1+ (1,0) [0|0] "" TOOL
 SG_ FUELSYSA_OL_Fault m3 : 27|1@1+ (1,0) [0|0] "" TOOL
 SG_ FUELSYSA_CL_Fault m3 : 28|1@1+ (1,0) [0|0] "" TOOL
 SG_ FUELSYSA_OL_B2 m3 : 29|1@1+ (1,0) [0|0] "" TOOL
 SG_ FUELSYSA_OL_Drive_B2 m3 : 30|1@1+ (1,0) [0|0] "" TOOL
 SG_ FUELSYSA_OL_Fault_B2 m3 : 31|1@1+ (1,0) [0|0] "" TOOL
 SG_ FUELSYSB_OL m3 : 32|1@1+ (1,0) [0|0] "" TOOL
 SG_ FUELSYSB_CL m3 : 33|1@1+ (1,0) [0|0] "" TOOL
 SG_ FUELSYSB_OL_Drive m3 : 34|1@1+ (1,0) [0|0] "" TOOL
 SG_ FUELSYSB_OL_Fault m3 : 35|1@1+ (1,0) [0|0] "" TOOL
 SG_ FUELSYSB_CL_Fault m3 : 36|1@1+ (1,0) [0|0] "" TOOL
 SG_ FUELSYSB_OL_B2 m3 : 37|1@1+ (1,0) [0|0] "" TOOL
 SG_ FUELSYSB_OL_Drive_B2 m3 : 38|1@1+ (1,0) [0|0] "" TOOL
 SG_ FUELSYSB_OL_Fault_B2 m3 : 39|1@1+ (1,0) [0|0] "" TOOL
 SG_ LOAD_PCT m4 : 24|8@1+ (0.39216,0) [0|100] "%" TOOL
 SG_ ECT m5 : 24|8@1+ (1,-40) [-40|215] "°C " TOOL
 SG_ SHRTFT1 m6 : 24|8@1+ (0.78125,-100) [-100|99.21875] "%" TOOL
 SG_ SHRTFT3 m6 : 32|8@1+ (0.78125,-100) [-100|99.21875] "%" TOOL
 SG_ LONGFT1 m7 : 24|8@1+ (0.78125,-100) [-100|99.21875] "%" TOOL
 SG_ LONGFT3 m7 : 32|8@1+ (0.78125,-100) [-100|99.21875] "%" TOOL
 SG_ SHRTFT2 m8 : 24|8@1+ (0.78125,-100) [-100|99.21875] "%" TOOL
 SG_ SHRTFT4 m8 : 32|8@1+ (0.78125,-100) [-100|99.21875] "%" TOOL
 SG_ LONGFT2 m9 : 24|8@1+ (0.78125,-100) [-100|99.21875] "%" TOOL
 SG_ LONGFT4 m9 : 32|8@1+ (0.78125,-100) [-100|99.21875] "%" TOOL
 SG_ FP m10 : 24|8@1+ (3,0) [0|0] "kPa" TOOL
 SG_ MAP m11 : 24|8@1+ (1,0) [0|0] "kPa" TOOL
 SG_ RPM m12 : 31|16@0+ (0.25,0) [0|0] "rpm" TOOL
 SG_ VSS m13 : 24|8@1+ (1,0) [0|0] "km/h" TOOL
 SG_ SPARKADV m14 : 24|8@1- (0.5,0) [0|0] "°" TOOL
 SG_ IAT m15 : 24|8@1+ (1,-40) [0|0] "°C " TOOL
 SG_ MAF m16 : 31|16@0+ (0.01,0) [0|0] "g/s" TOOL
 SG_ TP m17 : 24|8@1+ (0.3921569,0) [0|0] "%" TOOL
 SG_ AIR_STAT_UPS m18 : 24|1@1+ (1,0) [0|0] "" TOOL
 SG_ AIR_STAT_DNS m18 : 25|1@1+ (1,0) [0|0] "" TOOL
 SG_ AIR_STAT_OFF m18 : 26|1@1+ (1,0) [0|0] "" TOOL
 SG_ AIR_STAT_DIAG m18 : 27|1@1+ (1,0) [0|0] "" TOOL
 SG_ O2S11 m19 : 24|1@1+ (1,0) [0|0] "" TOOL
 SG_ O2S12 m19 : 25|1@1+ (1,0) [0|0] "" TOOL
 SG_ O2S13 m19 : 26|1@1+ (1,0) [0|0] "" TOOL
 SG_ O2S14 m19 : 27|1@1+ (1,0) [0|0] "" TOOL
 SG_ O2S21 m19 : 28|1@1+ (1,0) [0|0] "" TOOL
 SG_ O2S22 m19 : 29|1@1+ (1,0) [0|0] "" TOOL
 SG_ O2S23 m19 : 30|1@1+ (1,0) [0|0] "" TOOL
 SG_ O2S24 m19 : 31|1@1+ (1,0) [0|0] "" TOOL

 SG_ VIN m2 : 32|136@1+ (1,0) [0|0] "" TOOL

SG_MUL_VAL_ 2024 S01_PID SERVICE 1-1;
SG_MUL_VAL_ 2024 S02_PID SERVICE 2-2;
SG_MUL_VAL_ 2024 S03_PID SERVICE 3-3;
SG_MUL_VAL_ 2024 S04_PID SERVICE 4-4;
SG_MUL_VAL_ 2024 S05_PID SERVICE 5-5;
SG_MUL_VAL_ 2024 S06_PID SERVICE 6-6;
SG_MUL_VAL_ 2024 S07_PID SERVICE 7-7;
SG_MUL_VAL_ 2024 S08_PID SERVICE 8-8;
SG_MUL_VAL_ 2024 S09_PID SERVICE 9-9;
SG_MUL_VAL_ 2024 S0A_PID SERVICE 10-10;

SG_MUL_VAL_ 2024 S01_PID00_SupportedIDs_01_20 S01_PID 0-0;
SG_MUL_VAL_ 2024 S02_PID00_SupportedIDs_01_20 S02_PID 0-0;
SG_MUL_VAL_ 2024 S03_PID00_SupportedIDs_01_20 S03_PID 0-0;
SG_MUL_VAL_ 2024 S04_PID00_SupportedIDs_01_20 S04_PID 0-0;
SG_MUL_VAL_ 2024 S05_PID00_SupportedIDs_01_20 S05_PID 0-0;
SG_MUL_VAL_ 2024 S06_PID00_SupportedIDs_01_20 S06_PID 0-0;
SG_MUL_VAL_ 2024 S07_PID00_SupportedIDs_01_20 S07_PID 0-0;
SG_MUL_VAL_ 2024 S08_PID00_SupportedIDs_01_20 S08_PID 0-0;
SG_MUL_VAL_ 2024 S09_PID00_SupportedIDs_01_20 S09_PID 0-0;
SG_MUL_VAL_ 2024 S0A_PID00_SupportedIDs_01_20 S0A_PID 0-0;
SG_MUL_VAL_ 2024 S01_PID20_SupportedIDs_21_40 S01_PID 32-32;
SG_MUL_VAL_ 2024 S02_PID20_SupportedIDs_21_40 S02_PID 32-32;
SG_MUL_VAL_ 2024 S03_PID20_SupportedIDs_21_40 S03_PID 32-32;
SG_MUL_VAL_ 2024 S04_PID20_SupportedIDs_21_40 S04_PID 32-32;
SG_MUL_VAL_ 2024 S05_PID20_SupportedIDs_21_40 S05_PID 32-32;
SG_MUL_VAL_ 2024 S06_PID20_SupportedIDs_21_40 S06_PID 32-32;
SG_MUL_VAL_ 2024 S07_PID20_SupportedIDs_21_40 S07_PID 32-32;
SG_MUL_VAL_ 2024 S08_PID20_SupportedIDs_21_40 S08_PID 32-32;
SG_MUL_VAL_ 2024 S09_PID20_SupportedIDs_21_40 S09_PID 32-32;
SG_MUL_VAL_ 2024 S0A_PID20_SupportedIDs_21_40 S0A_PID 32-32;
SG_MUL_VAL_ 2024 S01_PID40_SupportedIDs_41_60 S01_PID 64-64;
SG_MUL_VAL_ 2024 S02_PID40_SupportedIDs_41_60 S02_PID 64-64;
SG_MUL_VAL_ 2024 S03_PID40_SupportedIDs_41_60 S03_PID 64-64;
SG_MUL_VAL_ 2024 S04_PID40_SupportedIDs_41_60 S04_PID 64-64;
SG_MUL_VAL_ 2024 S05_PID40_SupportedIDs_41_60 S05_PID 64-64;
SG_MUL_VAL_ 2024 S06_PID40_SupportedIDs_41_60 S06_PID 64-64;
SG_MUL_VAL_ 2024 S07_PID40_SupportedIDs_41_60 S07_PID 64-64;
SG_MUL_VAL_ 2024 S08_PID40_SupportedIDs_41_60 S08_PID 64-64;
SG_MUL_VAL_ 2024 S09_PID40_SupportedIDs_41_60 S09_PID 64-64;
SG_MUL_VAL_ 2024 S0A_PID40_SupportedIDs_41_60 S0A_PID 64-64;
SG_MUL_VAL_ 2024 S01_PID60_SupportedIDs_61_80 S01_PID 96-96;
SG_MUL_VAL_ 2024 S02_PID60_SupportedIDs_61_80 S02_PID 96-96;
SG_MUL_VAL_ 2024 S03_PID60_SupportedIDs_61_80 S03_PID 96-96;
SG_MUL_VAL_ 2024 S04_PID60_SupportedIDs_61_80 S04_PID 96-96;
SG_MUL_VAL_ 2024 S05_PID60_SupportedIDs_61_80 S05_PID 96-96;
SG_MUL_VAL_ 2024 S06_PID60_SupportedIDs_61_80 S06_PID 96-96;
SG_MUL_VAL_ 2024 S07_PID60_SupportedIDs_61_80 S07_PID 96-96;
SG_MUL_VAL_ 2024 S08_PID60_SupportedIDs_61_80 S08_PID 96-96;
SG_MUL_VAL_ 2024 S09_PID60_SupportedIDs_61_80 S09_PID 96-96;
SG_MUL_VAL_ 2024 S0A_PID60_SupportedIDs_61_80 S0A_PID 96-96;
SG_MUL_VAL_ 2024 S01_PID80_SupportedIDs_81_A0 S01_PID 128-128;
SG_MUL_VAL_ 2024 S02_PID80_SupportedIDs_81_A0 S02_PID 128-128;
SG_MUL_VAL_ 2024 S03_PID80_SupportedIDs_81_A0 S03_PID 128-128;
SG_MUL_VAL_ 2024 S04_PID80_SupportedIDs_81_A0 S04_PID 128-128;
SG_MUL_VAL_ 2024 S05_PID80_SupportedIDs_81_A0 S05_PID 128-128;
SG_MUL_VAL_ 2024 S06_PID80_SupportedIDs_81_A0 S06_PID 128-128;
SG_MUL_VAL_ 2024 S07_PID80_SupportedIDs_81_A0 S07_PID 128-128;
SG_MUL_VAL_ 2024 S08_PID80_SupportedIDs_81_A0 S08_PID 128-128;
SG_MUL_VAL_ 2024 S09_PID80_SupportedIDs_81_A0 S09_PID 128-128;
SG_MUL_VAL_ 2024 S0A_PID80_SupportedIDs_81_A0 S0A_PID 128-128;
SG_MUL_VAL_ 2024 S01_PIDA0_SupportedIDs_A1_C0 S01_PID 160-160;
SG_MUL_VAL_ 2024 S02_PIDA0_SupportedIDs_A1_C0 S02_PID 160-160;
SG_MUL_VAL_ 2024 S03_PIDA0_SupportedIDs_A1_C0 S03_PID 160-160;
SG_MUL_VAL_ 2024 S04_PIDA0_SupportedIDs_A1_C0 S04_PID 160-160;
SG_MUL_VAL_ 2024 S05_PIDA0_SupportedIDs_A1_C0 S05_PID 160-160;
SG_MUL_VAL_ 2024 S06_PIDA0_SupportedIDs_A1_C0 S06_PID 160-160;
SG_MUL_VAL_ 2024 S07_PIDA0_SupportedIDs_A1_C0 S07_PID 160-160;
SG_MUL_VAL_ 2024 S08_PIDA0_SupportedIDs_A1_C0 S08_PID 160-160;
SG_MUL_VAL_ 2024 S09_PIDA0_SupportedIDs_A1_C0 S09_PID 160-160;
SG_MUL_VAL_ 2024 S0A_PIDA0_SupportedIDs_A1_C0 S0A_PID 160-160;
SG_MUL_VAL_ 2024 S01_PIDC0_SupportedIDs_C1_E0 S01_PID 192-192;
SG_MUL_VAL_ 2024 S02_PIDC0_SupportedIDs_C1_E0 S02_PID 192-192;
SG_MUL_VAL_ 2024 S03_PIDC0_SupportedIDs_C1_E0 S03_PID 192-192;
SG_MUL_VAL_ 2024 S04_PIDC0_SupportedIDs_C1_E0 S04_PID 192-192;
SG_MUL_VAL_ 2024 S05_PIDC0_SupportedIDs_C1_E0 S05_PID 192-192;
SG_MUL_VAL_ 2024 S06_PIDC0_SupportedIDs_C1_E0 S06_PID 192-192;
SG_MUL_VAL_ 2024 S07_PIDC0_SupportedIDs_C1_E0 S07_PID 192-192;
SG_MUL_VAL_ 2024 S08_PIDC0_SupportedIDs_C1_E0 S08_PID 192-192;
SG_MUL_VAL_ 2024 S09_PIDC0_SupportedIDs_C1_E0 S09_PID 192-192;
SG_MUL_VAL_ 2024 S0A_PIDC0_SupportedIDs_C1_E0 S0A_PID 192-192;

SG_MUL_VAL_ 2024 DTC_CNT S01_PID 1-1;
SG_MUL_VAL_ 2024 MIL S01_PID 1-1;
SG_MUL_VAL_ 2024 MIS_SUP S01_PID 1-1;
SG_MUL_VAL_ 2024 FUEL_SUP S01_PID 1-1;
SG_MUL_VAL_ 2024 CCM_SUP S01_PID 1-1;
SG_MUL_VAL_ 2024 CIM_SUP S01_PID 1-1;
SG_MUL_VAL_ 2024 MIS_RDY S01_PID 1-1;
SG_MUL_VAL_ 2024 FUEL_RDY S01_PID 1-1;
SG_MUL_VAL_ 2024 CCM_RDY S01_PID 1-1;

SG_MUL_VAL_ 2024 CAT_SUP CIM_SUP 0-0;
SG_MUL_VAL_ 2024 HCAT_SUP CIM_SUP 0-0;
SG_MUL_VAL_ 2024 EVAP_SUP CIM_SUP 0-0;
SG_MUL_VAL_ 2024 AIR_SUP CIM_SUP 0-0;
SG_MUL_VAL_ 2024 GPF_SUP CIM_SUP 0-0;
SG_MUL_VAL_ 2024 O2S_SUP CIM_SUP 0-0;
SG_MUL_VAL_ 2024 HTR_SUP CIM_SUP 0-0;
SG_MUL_VAL_ 2024 EGR_SUP CIM_SUP 0-0;
SG_MUL_VAL_ 2024 CAT_RDY CIM_SUP 0-0;
SG_MUL_VAL_ 2024 HCAT_RDY CIM_SUP 0-0;
SG_MUL_VAL_ 2024 EVAP_RDY CIM_SUP 0-0;
SG_MUL_VAL_ 2024 AIR_RDY CIM_SUP 0-0;
SG_MUL_VAL_ 2024 GPF_RDY CIM_SUP 0-0;
SG_MUL_VAL_ 2024 O2S_RDY CIM_SUP 0-0;
SG_MUL_VAL_ 2024 HTR_RDY CIM_SUP 0-0;
SG_MUL_VAL_ 2024 EGR_RDY CIM_SUP 0-0;
SG_MUL_VAL_ 2024 HCCATSUP CIM_SUP 1-1;
SG_MUL_VAL_ 2024 NCAT_SUP CIM_SUP 1-1;
SG_MUL_VAL_ 2024 BP_SUP CIM_SUP 1-1;
SG_MUL_VAL_ 2024 EGS_SUP CIM_SUP 1-1;
SG_MUL_VAL_ 2024 PM_SUP CIM_SUP 1-1;
SG_MUL_VAL_ 2024 HCCATRDY CIM_SUP 1-1;
SG_MUL_VAL_ 2024 NCAT_RDY CIM_SUP 1-1;
SG_MUL_VAL_ 2024 BP_RDY CIM_SUP 1-1;
SG_MUL_VAL_ 2024 EGS_RDY CIM_SUP 1-1;
SG_MUL_VAL_ 2024 PM_RDY CIM_SUP 1-1;
SG_MUL_VAL_ 2024 DTCFRZF S01_PID 2-2;
SG_MUL_VAL_ 2024 FUELSYSA_OL S01_PID 3-3;
SG_MUL_VAL_ 2024 FUELSYSA_CL S01_PID 3-3;
SG_MUL_VAL_ 2024 FUELSYSA_OL_Drive S01_PID 3-3;
SG_MUL_VAL_ 2024 FUELSYSA_OL_Fault S01_PID 3-3;
SG_MUL_VAL_ 2024 FUELSYSA_CL_Fault S01_PID 3-3;
SG_MUL_VAL_ 2024 FUELSYSA_OL_B2 S01_PID 3-3;
SG_MUL_VAL_ 2024 FUELSYSA_OL_Drive_B2 S01_PID 3-3;
SG_MUL_VAL_ 2024 FUELSYSA_OL_Fault_B2 S01_PID 3-3;
SG_MUL_VAL_ 2024 FUELSYSB_OL S01_PID 3-3;
SG_MUL_VAL_ 2024 FUELSYSB_CL S01_PID 3-3;
SG_MUL_VAL_ 2024 FUELSYSB_OL_Drive S01_PID 3-3;
SG_MUL_VAL_ 2024 FUELSYSB_OL_Fault S01_PID 3-3;
SG_MUL_VAL_ 2024 FUELSYSB_CL_Fault S01_PID 3-3;
SG_MUL_VAL_ 2024 FUELSYSB_OL_B2 S01_PID 3-3;
SG_MUL_VAL_ 2024 FUELSYSB_OL_Drive_B2 S01_PID 3-3;
SG_MUL_VAL_ 2024 FUELSYSB_OL_Fault_B2 S01_PID 3-3;
SG_MUL_VAL_ 2024 LOAD_PCT S01_PID 4-4;
SG_MUL_VAL_ 2024 ECT S01_PID 5-5;
SG_MUL_VAL_ 2024 SHRTFT1 S01_PID 6-6;
SG_MUL_VAL_ 2024 SHRTFT3 S01_PID 6-6;
SG_MUL_VAL_ 2024 LONGFT1 S01_PID 7-7;
SG_MUL_VAL_ 2024 LONGFT3 S01_PID 7-7;
SG_MUL_VAL_ 2024 SHRTFT2 S01_PID 8-8;
SG_MUL_VAL_ 2024 SHRTFT4 S01_PID 8-8;
SG_MUL_VAL_ 2024 LONGFT2 S01_PID 9-9;
SG_MUL_VAL_ 2024 LONGFT4 S01_PID 9-9;
SG_MUL_VAL_ 2024 FP S01_PID 10-10;
SG_MUL_VAL_ 2024 MAP S01_PID 11-11;
SG_MUL_VAL_ 2024 RPM S01_PID 12-12;
SG_MUL_VAL_ 2024 VSS S01_PID 13-13;
SG_MUL_VAL_ 2024 SPARKADV S01_PID 14-14;
SG_MUL_VAL_ 2024 IAT S01_PID 15-15;
SG_MUL_VAL_ 2024 MAF S01_PID 16-16;
SG_MUL_VAL_ 2024 TP S01_PID 17-17;
SG_MUL_VAL_ 2024 AIR_STAT_UPS S01_PID 18-18;
SG_MUL_VAL_ 2024 AIR_STAT_DNS S01_PID 18-18;
SG_MUL_VAL_ 2024 AIR_STAT_OFF S01_PID 18-18;
SG_MUL_VAL_ 2024 AIR_STAT_DIAG S01_PID 18-18;
SG_MUL_VAL_ 2024 O2S11 S01_PID 19-19;
SG_MUL_VAL_ 2024 O2S12 S01_PID 19-19;
SG_MUL_VAL_ 2024 O2S13 S01_PID 19-19;
SG_MUL_VAL_ 2024 O2S14 S01_PID 19-19;
SG_MUL_VAL_ 2024 O2S21 S01_PID 19-19;
SG_MUL_VAL_ 2024 O2S22 S01_PID 19-19;
SG_MUL_VAL_ 2024 O2S23 S01_PID 19-19;
SG_MUL_VAL_ 2024 O2S24 S01_PID 19-19;

SG_MUL_VAL_ 2024 VIN S09_PID 2-2;
